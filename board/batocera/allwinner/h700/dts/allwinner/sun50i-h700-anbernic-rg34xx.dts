// SPDX-License-Identifier: (GPL-2.0-only OR BSD-2-Clause)
/*
 * Copyright (C) 2024 Ryan Walklin <ryan@testtoast.com>.
 * Copyright (C) 2024 Chris Morgan <macroalpha82@gmail.com>.
 */

#include "sun50i-h700-anbernic-rg35xx-plus.dts"

/ {
	model = "Anbernic RG34XX";
	compatible = "anbernic,rg34xx", "allwinner,sun50i-h700";
	rocknix-dt-id = "sun50i-h700-anbernic-rg34xx";
};

&panel {
	compatible = "anbernic,rg34xx-panel", "panel-mipi-dpi-spi";
};
