// SPDX-License-Identifier: (GPL-2.0-only OR BSD-2-Clause)
/*
 * Copyright (C) 2024 Ryan Walklin <ryan@testtoast.com>.
 * Copyright (C) 2024 Chris Morgan <macroalpha82@gmail.com>.
 */

#include "sun50i-h700-anbernic-rg35xx-sp.dts"

/ {
	model = "Anbernic RG34XX-SP";
	compatible = "anbernic,rg34xx-sp", "allwinner,sun50i-h700";
	rocknix-dt-id = "sun50i-h700-anbernic-rg34xx-sp";
};

&panel {
	compatible = "anbernic,rg34xx-sp-panel", "panel-mipi-dpi-spi";
};

&joypad {
	invert-absrx;
	invert-absry;
	amux-count = <4>;
};
