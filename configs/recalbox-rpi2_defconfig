## configs/recalbox-rpi2_defconfig
```kconfig
BR2_arm=y
BR2_cortex_a7=y
BR2_ARM_EABIHF=y
BR2_ARM_FPU_NEON_VFPV4=y
BR2_OPTIMIZE_3=y
BR2_SHARED_STATIC_LIBS=y
BR2_KERNEL_HEADERS_VERSION=y
BR2_DEFAULT_KERNEL_VERSION="3.19.8"
BR2_PACKAGE_HOST_LINUX_HEADERS_CUSTOM_3_19=y
BR2_TOOLCHAIN_BUILDROOT_GLIBC=y
BR2_TOOLCHAIN_BUILDROOT_CXX=y
BR2_ENABLE_LOCALE_PURGE=y
BR2_ENABLE_LOCALE_WHITELIST="C en fr es pt de it"
BR2_GENERATE_LOCALE="fr_FR.UTF-8 en_US.UTF-8 es_ES.UTF-8 pt_BR.UTF-8 de_DE.UTF-8 it_IT.UTF-8"
BR2_TARGET_OPTIMIZATION="-pipe -mhard-float -mfloat-abi=hard -mfpu=neon-vfpv4 -mcpu=cortex-a7 -fsigned-char"
BR2_TARGET_GENERIC_HOSTNAME="RECALBOX"
BR2_TARGET_GENERIC_ISSUE="PLAY AGAIN"
BR2_ROOTFS_DEVICE_CREATION_DYNAMIC_EUDEV=y
BR2_TARGET_GENERIC_ROOT_PASSWD="recalboxroot"
BR2_SYSTEM_BIN_SH_BASH=y
BR2_TARGET_GENERIC_GETTY_PORT="tty1"
BR2_TARGET_GENERIC_GETTY_BAUDRATE_115200=y
BR2_TARGET_TZ_INFO=y
BR2_TARGET_LOCALTIME="Europe/Paris"
BR2_ROOTFS_OVERLAY="board/recalbox/fsoverlay"
BR2_ROOTFS_POST_IMAGE_SCRIPT="board/recalbox/copy-recalbox-archives.sh"
BR2_LINUX_KERNEL=y
BR2_LINUX_KERNEL_CUSTOM_GIT=y
BR2_LINUX_KERNEL_CUSTOM_REPO_URL="https://github.com/digitallumberjack/linux"
BR2_LINUX_KERNEL_CUSTOM_REPO_VERSION="108e489c19d92800dfc7f04ec93f57468ffff751"
BR2_LINUX_KERNEL_PATCH="board/recalbox/kernel_patches_3.19"
BR2_LINUX_KERNEL_USE_CUSTOM_CONFIG=y
BR2_LINUX_KERNEL_CUSTOM_CONFIG_FILE="board/recalbox/kernel.3.19-v7.config"
BR2_LINUX_KERNEL_ZIMAGE=y
BR2_PACKAGE_BUSYBOX_SHOW_OTHERS=y
BR2_PACKAGE_ALSA_UTILS=y
BR2_PACKAGE_ALSA_UTILS_AMIXER=y
BR2_PACKAGE_KODI=y
BR2_PACKAGE_KODI_ALSA_LIB=y
BR2_PACKAGE_KODI_DBUS=y
BR2_PACKAGE_KODI_LIBCEC=y
BR2_PACKAGE_KODI_LIBMICROHTTPD=y
BR2_PACKAGE_KODI_LIBNFS=y
BR2_PACKAGE_KODI_RTMPDUMP=y
BR2_PACKAGE_KODI_LIBSMBCLIENT=y
BR2_PACKAGE_KODI_LIBTHEORA=y
BR2_PACKAGE_KODI_LIBUSB=y
BR2_PACKAGE_KODI_LIBVA=y
BR2_PACKAGE_KODI_WAVPACK=y
BR2_PACKAGE_KODI_ADDON_XVDR=y
BR2_PACKAGE_KODI_PVR_ADDONS=y
BR2_PACKAGE_BINUTILS=y
BR2_PACKAGE_CIFS_UTILS=y
BR2_PACKAGE_EXFAT=y
BR2_PACKAGE_EXFAT_UTILS=y
BR2_PACKAGE_NTFS_3G=y
BR2_PACKAGE_NTFS_3G_NTFSPROGS=y
BR2_PACKAGE_RECALBOX_SYSTEM=y
BR2_PACKAGE_RECALBOX_CONFIGGEN=y
BR2_PACKAGE_RECALBOX_EMULATIONSTATION2=y
BR2_PACKAGE_PYTHON_ES_SCRAPER=y
BR2_PACKAGE_QTSIXA=y
BR2_PACKAGE_MK_ARCADE_JOYSTICK_RPI=y
BR2_PACKAGE_DB9_GPIO_RPI=y
BR2_PACKAGE_GAMECON_GPIO_RPI=y
BR2_PACKAGE_XBOXDRV=y
BR2_PACKAGE_RECALBOX_RETROGAME=y
BR2_PACKAGE_VIRTUALGAMEPADS=y
BR2_PACKAGE_MUPEN64PLUS_CORE=y
BR2_PACKAGE_MUPEN64PLUS_UICONSOLE=y
BR2_PACKAGE_MUPEN64PLUS_GLES2=y
BR2_PACKAGE_MUPEN64PLUS_OMX=y
BR2_PACKAGE_MUPEN64PLUS_INPUT_SDL=y
BR2_PACKAGE_MUPEN64PLUS_AUDIO_SDL=y
BR2_PACKAGE_MUPEN64PLUS_RSPHLE=y
BR2_PACKAGE_MUPEN64PLUS_RICE=y
BR2_PACKAGE_PIFBA=y
BR2_PACKAGE_RETROARCH=y
BR2_PACKAGE_SCUMMVM_VANFANEL=y
BR2_PACKAGE_ARMSNES=y
BR2_PACKAGE_LIBRETRO_POCKETSNES=y
BR2_PACKAGE_LIBRETRO_CATSFC=y
BR2_PACKAGE_LIBRETRO_BEETLE_VB=y
BR2_PACKAGE_LIBRETRO_SNES9X_NEXT=y
BR2_PACKAGE_LIBRETRO_PICODRIVE=y
BR2_PACKAGE_LIBRETRO_GENESISPLUSGX=y
BR2_PACKAGE_LIBRETRO_GAMBATTE=y
BR2_PACKAGE_LIBRETRO_STELLA=y
BR2_PACKAGE_LIBRETRO_PCSX=y
BR2_PACKAGE_LIBRETRO_FCEUMM=y
BR2_PACKAGE_LIBRETRO_FCEUNEXT=y
BR2_PACKAGE_LIBRETRO_NESTOPIA=y
BR2_PACKAGE_LIBRETRO_IMAME=y
BR2_PACKAGE_LIBRETRO_SCUMMVM=y
BR2_PACKAGE_LIBRETRO_BEETLE_PCE=y
BR2_PACKAGE_LIBRETRO_BEETLE_PCFX=y
BR2_PACKAGE_LIBRETRO_METEOR=y
BR2_PACKAGE_LIBRETRO_VIRTUALJAGUAR=y
BR2_PACKAGE_LIBRETRO_FMSX=y
BR2_PACKAGE_LIBRETRO_BLUEMSX=y
BR2_PACKAGE_LIBRETRO_GPSP=y
BR2_PACKAGE_LIBRETRO_4DO=y
BR2_PACKAGE_LIBRETRO_FBA=y
BR2_PACKAGE_LIBRETRO_GW=y
BR2_PACKAGE_LIBRETRO_PRBOOM=y
BR2_PACKAGE_LIBRETRO_BEETLE_NGP=y
BR2_PACKAGE_LIBRETRO_VECX=y
BR2_PACKAGE_LIBRETRO_BEETLE_LYNX=y
BR2_PACKAGE_LIBRETRO_LUTRO=y
BR2_PACKAGE_LIBRETRO_BEETLE_WSWAN=y
BR2_PACKAGE_LIBRETRO_MUPEN64=y
BR2_PACKAGE_LIBRETRO_BEETLE_SUPERGRAFX=y
BR2_PACKAGE_LIBRETRO_NXENGINE=y
BR2_PACKAGE_LIBRETRO_PROSYSTEM=y
BR2_PACKAGE_LIBRETRO_TGBDUAL=y
BR2_PACKAGE_LIBRETRO_MGBA=y
BR2_PACKAGE_PRBOOM=y
BR2_PACKAGE_DOOM_WAD=y
BR2_PACKAGE_SDL2=y
BR2_PACKAGE_SDL2_MIXER=y
BR2_PACKAGE_LINUX_FIRMWARE=y
BR2_PACKAGE_LINUX_FIRMWARE_ATHEROS_6002=y
BR2_PACKAGE_LINUX_FIRMWARE_ATHEROS_6003=y
BR2_PACKAGE_LINUX_FIRMWARE_ATHEROS_6004=y
BR2_PACKAGE_LINUX_FIRMWARE_ATHEROS_7010=y
BR2_PACKAGE_LINUX_FIRMWARE_ATHEROS_9170=y
BR2_PACKAGE_LINUX_FIRMWARE_ATHEROS_9271=y
BR2_PACKAGE_LINUX_FIRMWARE_BRCM_BCM43XX=y
BR2_PACKAGE_LINUX_FIRMWARE_BRCM_BCM43XXX=y
BR2_PACKAGE_LINUX_FIRMWARE_IWLWIFI_3160=y
BR2_PACKAGE_LINUX_FIRMWARE_IWLWIFI_5000=y
BR2_PACKAGE_LINUX_FIRMWARE_IWLWIFI_7260=y
BR2_PACKAGE_LINUX_FIRMWARE_IWLWIFI_7265=y
BR2_PACKAGE_LINUX_FIRMWARE_LIBERTAS_SD8686_V8=y
BR2_PACKAGE_LINUX_FIRMWARE_LIBERTAS_SD8686_V9=y
BR2_PACKAGE_LINUX_FIRMWARE_LIBERTAS_SD8688=y
BR2_PACKAGE_LINUX_FIRMWARE_MWIFIEX_SD8787=y
BR2_PACKAGE_LINUX_FIRMWARE_RALINK_RT61=y
BR2_PACKAGE_LINUX_FIRMWARE_RALINK_RT73=y
BR2_PACKAGE_LINUX_FIRMWARE_RALINK_RT2XX=y
BR2_PACKAGE_LINUX_FIRMWARE_RTL_81XX=y
BR2_PACKAGE_LINUX_FIRMWARE_RTL_87XX=y
BR2_PACKAGE_LINUX_FIRMWARE_RTL_88XX=y
BR2_PACKAGE_LINUX_FIRMWARE_TI_WL127X=y
BR2_PACKAGE_LINUX_FIRMWARE_TI_WL128X=y
BR2_PACKAGE_LINUX_FIRMWARE_TI_WL18XX=y
BR2_PACKAGE_RPI_FIRMWARE=y
BR2_PACKAGE_EUDEV_RULES_GEN=y
BR2_PACKAGE_EVTEST=y
BR2_PACKAGE_INPUT_TOOLS=y
# BR2_PACKAGE_INPUT_TOOLS_INPUTATTACH is not set
BR2_PACKAGE_KBD=y
BR2_PACKAGE_RPI_USERLAND=y
BR2_PACKAGE_USBMOUNT=y
BR2_PACKAGE_USBUTILS=y
BR2_PACKAGE_NODEJS=y
BR2_PACKAGE_PYTHON_PSUTIL=y
BR2_PACKAGE_CA_CERTIFICATES=y
BR2_PACKAGE_MYSQL=y
BR2_PACKAGE_LIBDAEMON=y
BR2_PACKAGE_BLUEZ_UTILS=y
BR2_PACKAGE_BLUEZ_UTILS_COMPAT=y
BR2_PACKAGE_BLUEZ_UTILS_AUDIO=y
BR2_PACKAGE_BLUEZ_UTILS_USB=y
BR2_PACKAGE_BLUEZ_UTILS_GATT=y
BR2_PACKAGE_DROPBEAR=y
BR2_PACKAGE_NTP=y
BR2_PACKAGE_RSYNC=y
BR2_PACKAGE_WGET=y
BR2_PACKAGE_WPA_SUPPLICANT=y
BR2_PACKAGE_NANO=y
BR2_PACKAGE_MOONLIGHT_EMBEDDED=y
BR2_TARGET_ROOTFS_TAR_XZ=y
```

## configs/recalbox-rpi3_defconfig
```kconfig
BR2_arm=y
BR2_cortex_a8=y
BR2_ARM_FPU_NEON=y
BR2_OPTIMIZE_3=y
BR2_SHARED_STATIC_LIBS=y
BR2_KERNEL_HEADERS_4_4=y
BR2_TOOLCHAIN_BUILDROOT_GLIBC=y
BR2_TOOLCHAIN_BUILDROOT_CXX=y
BR2_ENABLE_LOCALE_PURGE=y
BR2_ENABLE_LOCALE_WHITELIST="C en fr es pt de it tr eu_ES zh_CN sv_SE"
BR2_GENERATE_LOCALE="fr_FR.UTF-8 en_US.UTF-8 es_ES.UTF-8 pt_BR.UTF-8 de_DE.UTF-8 it_IT.UTF-8 tr_TR.UTF-8 zh_CN.UTF-8 eu_ES.UTF-8 sv_SE.UTF-8"
BR2_TARGET_OPTIMIZATION="-pipe -fsigned-char"
BR2_TARGET_GENERIC_HOSTNAME="RECALBOX"
BR2_TARGET_GENERIC_ISSUE="PLAY AGAIN"
BR2_INIT_SYSV=y
BR2_ROOTFS_DEVICE_CREATION_DYNAMIC_EUDEV=y
BR2_TARGET_GENERIC_ROOT_PASSWD="recalboxroot"
BR2_SYSTEM_BIN_SH_BASH=y
BR2_TARGET_GENERIC_GETTY_PORT="tty1"
BR2_TARGET_GENERIC_GETTY_BAUDRATE_115200=y
# BR2_TARGET_GENERIC_REMOUNT_ROOTFS_RW is not set
BR2_TARGET_TZ_INFO=y
BR2_TARGET_LOCALTIME="Europe/Paris"
BR2_ROOTFS_OVERLAY="board/recalbox/fsoverlay board/recalbox/fsoverlay_rpi_all"
BR2_ROOTFS_POST_BUILD_SCRIPT="board/recalbox/recalbox-patch-target.sh"
BR2_ROOTFS_POST_IMAGE_SCRIPT="board/recalbox/copy-recalbox-archives.sh"
BR2_LINUX_KERNEL=y
BR2_LINUX_KERNEL_CUSTOM_GIT=y
BR2_LINUX_KERNEL_CUSTOM_REPO_URL="https://github.com/raspberrypi/linux.git"
BR2_LINUX_KERNEL_CUSTOM_REPO_VERSION="26f3b72a9c049be10e6af196252283e1f6ab9d1f"
BR2_LINUX_KERNEL_PATCH="board/recalbox/kernel_patches_4.4"
BR2_LINUX_KERNEL_DEFCONFIG="bcm2709"
BR2_LINUX_KERNEL_CONFIG_FRAGMENT_FILES="board/recalbox/kernel-4.4-defconfig-fragment.config"
BR2_LINUX_KERNEL_ZIMAGE=y
BR2_LINUX_KERNEL_DTS_SUPPORT=y
BR2_LINUX_KERNEL_INTREE_DTS_NAME="bcm2710-rpi-3-b"
BR2_PACKAGE_ALSA_UTILS=y
BR2_PACKAGE_ALSA_UTILS_AMIXER=y
BR2_PACKAGE_BUSYBOX_CONFIG_FRAGMENT_FILES="board/recalbox/busybox.custom.config"
BR2_PACKAGE_KODI=y
BR2_PACKAGE_KODI_ALSA_LIB=y
BR2_PACKAGE_KODI_AVAHI=y
BR2_PACKAGE_KODI_DBUS=y
BR2_PACKAGE_KODI_LIBCEC=y
BR2_PACKAGE_KODI_LIRC=y
BR2_PACKAGE_KODI_LIBMICROHTTPD=y
BR2_PACKAGE_KODI_LIBNFS=y
BR2_PACKAGE_KODI_RTMPDUMP=y
BR2_PACKAGE_KODI_LIBSHAIRPLAY=y
BR2_PACKAGE_KODI_LIBSMBCLIENT=y
BR2_PACKAGE_KODI_LIBSSH=y
BR2_PACKAGE_KODI_LIBTHEORA=y
BR2_PACKAGE_KODI_LIBUSB=y
BR2_PACKAGE_KODI_LIBVA=y
BR2_PACKAGE_KODI_AUDIODECODER_MODPLUG=y
BR2_PACKAGE_KODI_AUDIODECODER_NOSEFART=y
BR2_PACKAGE_KODI_AUDIODECODER_OPUS=y
BR2_PACKAGE_KODI_AUDIODECODER_SIDPLAY=y
BR2_PACKAGE_KODI_AUDIODECODER_SNESAPU=y
BR2_PACKAGE_KODI_AUDIODECODER_STSOUND=y
BR2_PACKAGE_KODI_AUDIODECODER_TIMIDITY=y
BR2_PACKAGE_KODI_AUDIODECODER_VGMSTREAM=y
BR2_PACKAGE_KODI_AUDIOENCODER_FLAC=y
BR2_PACKAGE_KODI_AUDIOENCODER_LAME=y
BR2_PACKAGE_KODI_AUDIOENCODER_VORBIS=y
BR2_PACKAGE_KODI_AUDIOENCODER_WAV=y
BR2_PACKAGE_KODI_ADDON_XVDR=y
BR2_PACKAGE_KODI_PVR_ARGUSTV=y
BR2_PACKAGE_KODI_PVR_DVBLINK=y
BR2_PACKAGE_KODI_PVR_DVBVIEWER=y
BR2_PACKAGE_KODI_PVR_FILMON=y
BR2_PACKAGE_KODI_PVR_HDHOMERUN=y
BR2_PACKAGE_KODI_PVR_HTS=y
BR2_PACKAGE_KODI_PVR_IPTVSIMPLE=y
BR2_PACKAGE_KODI_PVR_MEDIAPORTAL_TVSERVER=y
BR2_PACKAGE_KODI_PVR_MYTHTV=y
BR2_PACKAGE_KODI_PVR_NEXTPVR=y
BR2_PACKAGE_KODI_PVR_NJOY=y
BR2_PACKAGE_KODI_PVR_PCTV=y
BR2_PACKAGE_KODI_PVR_STALKER=y
BR2_PACKAGE_KODI_PVR_VBOX=y
BR2_PACKAGE_KODI_PVR_VDR_VNSI=y
BR2_PACKAGE_KODI_PVR_VUPLUS=y
BR2_PACKAGE_KODI_PVR_WMC=y
BR2_PACKAGE_OMXPLAYER=y
BR2_PACKAGE_UNZIP=y
BR2_PACKAGE_XZ=y
BR2_PACKAGE_ZIP=y
BR2_PACKAGE_P7ZIP=y
BR2_PACKAGE_BINUTILS=y
BR2_PACKAGE_CIFS_UTILS=y
BR2_PACKAGE_DOSFSTOOLS=y
BR2_PACKAGE_DOSFSTOOLS_FSCK_FAT=y
BR2_PACKAGE_DOSFSTOOLS_MKFS_FAT=y
BR2_PACKAGE_EXFAT=y
BR2_PACKAGE_EXFAT_UTILS=y
BR2_PACKAGE_NTFS_3G=y
BR2_PACKAGE_NTFS_3G_NTFSPROGS=y
BR2_PACKAGE_RECALBOX_SYSTEM=y
BR2_PACKAGE_RECALBOX_TARGET_RPI3=y
BR2_PACKAGE_RECALBOX_THEMES=y
BR2_PACKAGE_RECALBOX_CONFIGGEN=y
BR2_PACKAGE_MOONLIGHT_EMBEDDED=y
BR2_PACKAGE_LIBENET=y
BR2_PACKAGE_RECALBOX_MANAGER=y
BR2_PACKAGE_RECALBOX_API=y
BR2_PACKAGE_RECALBOX_EMULATIONSTATION2=y
BR2_PACKAGE_PYTHON_ES_SCRAPER=y
BR2_PACKAGE_QTSIXA_SHANWAN=y
BR2_PACKAGE_MK_ARCADE_JOYSTICK_RPI=y
BR2_PACKAGE_DB9_GPIO_RPI=y
BR2_PACKAGE_GAMECON_GPIO_RPI=y
BR2_PACKAGE_XBOXDRV=y
BR2_PACKAGE_XARCADE2JSTICK=y
BR2_PACKAGE_RECALBOX_RETROGAME=y
BR2_PACKAGE_VIRTUALGAMEPADS=y
BR2_PACKAGE_LINAPPLE_PIE=y
BR2_PACKAGE_MUPEN64PLUS_CORE=y
BR2_PACKAGE_MUPEN64PLUS_UICONSOLE=y
BR2_PACKAGE_MUPEN64PLUS_GLES2=y
BR2_PACKAGE_MUPEN64PLUS_GLES2RICE=y
BR2_PACKAGE_MUPEN64PLUS_OMX=y
BR2_PACKAGE_MUPEN64PLUS_INPUT_SDL=y
BR2_PACKAGE_MUPEN64PLUS_AUDIO_SDL=y
BR2_PACKAGE_MUPEN64PLUS_RSPHLE=y
BR2_PACKAGE_MUPEN64PLUS_GLIDEN64=y
BR2_PACKAGE_REICAST=y
BR2_PACKAGE_PPSSPP=y
BR2_PACKAGE_PIFBA=y
BR2_PACKAGE_RETROARCH=y
BR2_PACKAGE_SCUMMVM=y
BR2_PACKAGE_ARMSNES=y
BR2_PACKAGE_LIBRETRO_POCKETSNES=y
BR2_PACKAGE_LIBRETRO_CATSFC=y
BR2_PACKAGE_LIBRETRO_BEETLE_VB=y
BR2_PACKAGE_LIBRETRO_SNES9X_NEXT=y
BR2_PACKAGE_LIBRETRO_PICODRIVE=y
BR2_PACKAGE_LIBRETRO_GENESISPLUSGX=y
BR2_PACKAGE_LIBRETRO_GAMBATTE=y
BR2_PACKAGE_LIBRETRO_STELLA=y
BR2_PACKAGE_LIBRETRO_PCSX=y
BR2_PACKAGE_LIBRETRO_FCEUMM=y
BR2_PACKAGE_LIBRETRO_FCEUNEXT=y
BR2_PACKAGE_LIBRETRO_NESTOPIA=y
BR2_PACKAGE_LIBRETRO_IMAME=y
BR2_PACKAGE_LIBRETRO_SCUMMVM=y
BR2_PACKAGE_LIBRETRO_BEETLE_PCE=y
BR2_PACKAGE_LIBRETRO_BEETLE_PCFX=y
BR2_PACKAGE_LIBRETRO_METEOR=y
BR2_PACKAGE_LIBRETRO_VIRTUALJAGUAR=y
BR2_PACKAGE_LIBRETRO_FMSX=y
BR2_PACKAGE_LIBRETRO_BLUEMSX=y
BR2_PACKAGE_LIBRETRO_GPSP=y
BR2_PACKAGE_LIBRETRO_4DO=y
BR2_PACKAGE_LIBRETRO_FBA=y
BR2_PACKAGE_LIBRETRO_GW=y
BR2_PACKAGE_LIBRETRO_PRBOOM=y
BR2_PACKAGE_LIBRETRO_BEETLE_NGP=y
BR2_PACKAGE_LIBRETRO_VECX=y
BR2_PACKAGE_LIBRETRO_BEETLE_LYNX=y
BR2_PACKAGE_LIBRETRO_LUTRO=y
BR2_PACKAGE_LIBRETRO_BEETLE_WSWAN=y
BR2_PACKAGE_LIBRETRO_UAE=y
BR2_PACKAGE_LIBRETRO_MUPEN64=y
BR2_PACKAGE_LIBRETRO_BEETLE_SUPERGRAFX=y
BR2_PACKAGE_LIBRETRO_NXENGINE=y
BR2_PACKAGE_LIBRETRO_PROSYSTEM=y
BR2_PACKAGE_LIBRETRO_TGBDUAL=y
BR2_PACKAGE_LIBRETRO_MGBA=y
BR2_PACKAGE_LIBRETRO_MAME2003=y
BR2_PACKAGE_LIBRETRO_FUSE=y
BR2_PACKAGE_LIBRETRO_CAP32=y
BR2_PACKAGE_LIBRETRO_81=y
BR2_PACKAGE_LIBRETRO_IMAGEVIEWER=y
BR2_PACKAGE_LIBRETRO_O2EM=y
BR2_PACKAGE_LIBRETRO_HATARI=y
BR2_PACKAGE_LIBRETRO_QUICKNES=y
BR2_PACKAGE_RASPI2PNG=y
BR2_PACKAGE_MEGATOOLS=y
BR2_PACKAGE_FBDUMP=y
BR2_PACKAGE_FBGRAB=y
BR2_PACKAGE_FBV=y
BR2_PACKAGE_SDL2_MIXER=y
BR2_PACKAGE_SDL_IMAGE=y
BR2_PACKAGE_SDL_IMAGE_JPEG=y
BR2_PACKAGE_SDL_IMAGE_PNG=y
BR2_PACKAGE_SDL_IMAGE_XPM=y
BR2_PACKAGE_SDL_MIXER=y
BR2_PACKAGE_SDL_NET=y
BR2_PACKAGE_LINUX_FIRMWARE=y
BR2_PACKAGE_LINUX_FIRMWARE_ATHEROS_6002=y
BR2_PACKAGE_LINUX_FIRMWARE_ATHEROS_6003=y
BR2_PACKAGE_LINUX_FIRMWARE_ATHEROS_6004=y
BR2_PACKAGE_LINUX_FIRMWARE_ATHEROS_7010=y
BR2_PACKAGE_LINUX_FIRMWARE_ATHEROS_9170=y
BR2_PACKAGE_LINUX_FIRMWARE_ATHEROS_9271=y
BR2_PACKAGE_LINUX_FIRMWARE_BRCM_BCM43XX=y
BR2_PACKAGE_LINUX_FIRMWARE_BRCM_BCM43XXX=y
BR2_PACKAGE_LINUX_FIRMWARE_IWLWIFI_3160=y
BR2_PACKAGE_LINUX_FIRMWARE_IWLWIFI_5000=y
BR2_PACKAGE_LINUX_FIRMWARE_IWLWIFI_7260=y
BR2_PACKAGE_LINUX_FIRMWARE_IWLWIFI_7265=y
BR2_PACKAGE_LINUX_FIRMWARE_LIBERTAS_SD8686_V8=y
BR2_PACKAGE_LINUX_FIRMWARE_LIBERTAS_SD8686_V9=y
BR2_PACKAGE_LINUX_FIRMWARE_LIBERTAS_SD8688=y
BR2_PACKAGE_LINUX_FIRMWARE_MWIFIEX_SD8787=y
BR2_PACKAGE_LINUX_FIRMWARE_RALINK_RT61=y
BR2_PACKAGE_LINUX_FIRMWARE_RALINK_RT73=y
BR2_PACKAGE_LINUX_FIRMWARE_RALINK_RT2XX=y
BR2_PACKAGE_LINUX_FIRMWARE_RTL_81XX=y
BR2_PACKAGE_LINUX_FIRMWARE_RTL_87XX=y
BR2_PACKAGE_LINUX_FIRMWARE_RTL_88XX=y
BR2_PACKAGE_LINUX_FIRMWARE_TI_WL127X=y
BR2_PACKAGE_LINUX_FIRMWARE_TI_WL128X=y
BR2_PACKAGE_LINUX_FIRMWARE_TI_WL18XX=y
BR2_PACKAGE_RPI_FIRMWARE=y
BR2_PACKAGE_EUDEV_RULES_GEN=y
BR2_PACKAGE_EVTEST=y
BR2_PACKAGE_I2C_TOOLS=y
BR2_PACKAGE_INPUT_TOOLS=y
# BR2_PACKAGE_INPUT_TOOLS_INPUTATTACH is not set
BR2_PACKAGE_KBD=y
BR2_PACKAGE_LIRC_TOOLS=y
BR2_PACKAGE_PARTED=y
BR2_PACKAGE_USBMOUNT=y
BR2_PACKAGE_USBUTILS=y
BR2_PACKAGE_NODEJS=y
BR2_PACKAGE_NODEJS_MODULES_COFFEESCRIPT=y
BR2_PACKAGE_NODEJS_MODULES_ADDITIONAL="request"
BR2_PACKAGE_PYTHON_PY_PYC=y
BR2_PACKAGE_PYTHON_RPIGPIO=y
BR2_PACKAGE_LIBZIP=y
BR2_PACKAGE_CA_CERTIFICATES=y
BR2_PACKAGE_OPENSSL_BIN=y
BR2_PACKAGE_MYSQL=y
BR2_PACKAGE_CURL=y
BR2_PACKAGE_BOOST_ATOMIC=y
# BR2_PACKAGE_AVAHI_AUTOIPD is not set
BR2_PACKAGE_BLUEZ_UTILS=y
BR2_PACKAGE_BLUEZ_UTILS_COMPAT=y
BR2_PACKAGE_BLUEZ_UTILS_AUDIO=y
BR2_PACKAGE_BLUEZ_UTILS_USB=y
BR2_PACKAGE_BLUEZ_UTILS_GATT=y
BR2_PACKAGE_CONNMAN=y
BR2_PACKAGE_CONNMAN_WIFI=y
BR2_PACKAGE_CONNMAN_CLIENT=y
BR2_PACKAGE_DROPBEAR=y
BR2_PACKAGE_GESFTPSERVER=y
BR2_PACKAGE_NTP=y
BR2_PACKAGE_RSYNC=y
BR2_PACKAGE_WGET=y
BR2_PACKAGE_WPA_SUPPLICANT=y
BR2_PACKAGE_WPA_SUPPLICANT_CLI=y
BR2_PACKAGE_WPA_SUPPLICANT_DBUS_INTROSPECTION=y
BR2_PACKAGE_NANO=y
BR2_PACKAGE_VIM=y
BR2_TARGET_ROOTFS_TAR_XZ=y
BR2_PACKAGE_WIRINGPI=y
```

## package/adafruit-retrogame/Config.in
```kconfig
config BR2_PACKAGE_ADAFRUIT_RETROGAME
        bool "adafruit-retrogame"
	depends on BR2_INSTALL_LIBSTDCPP
        help
          Raspberry Pi GPIO-to-USB utility for classic game emulators.

	  https://github.com/adafruit/Adafruit-Retrogame

comment "ADAFRUIT_RETROGAME needs a toolchain w/ C++"
	depends on !BR2_INSTALL_LIBSTDCPP
```

## package/advancemame/Config.in
```kconfig
config BR2_PACKAGE_ADVANCEMAME
	bool "advancemame"
	help
	  A MAME 0.106-based emulator
	  http://www.advancemame.it

# Looks like we can't compile both at the same time, and MESS would require its own package
#if BR2_PACKAGE_ADVANCEMAME
#config BR2_PACKAGE_ADVANCEMAME_MESS
#	bool "advancemess"
#	help
#	  Compile MESS with AdvanceMAME
#endif
```
