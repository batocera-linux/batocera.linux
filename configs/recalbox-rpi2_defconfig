## package/batocera/audio/zmusic/Config.in
```kconfig
config BR2_PACKAGE_ZMUSIC
    bool "zmusic"
    select BR2_PACKAGE_ALSA_LIB
    select BR2_PACKAGE_FLUIDSYNTH
    select BR2_PACKAGE_LIBSNDFILE
    select BR2_PACKAGE_MPG123
    select BR2_PACKAGE_ZLIB
    help
      ZMusic is a music system as a standalone library.

	    https://zdoom.org
```

## package/batocera/batocera-bezel/Config.in
```kconfig
config BR2_PACKAGE_BATOCERA_BEZEL
        bool "batocera bezel"
        help
          Batocera bezel

	  https://github.com/batocera-linux/batocera-bezel
```

## package/batocera/batocera-emulationstation/Config.in
```kconfig
config BR2_PACKAGE_BATOCERA_EMULATIONSTATION
        bool "batocera Emulationstation"
	depends on BR2_INSTALL_LIBSTDCPP
	select BR2_PACKAGE_SDL2
	select BR2_PACKAGE_SDL2_MIXER
	select BR2_PACKAGE_BOOST
	select BR2_PACKAGE_ALSA_LIB
	select BR2_PACKAGE_ALSA_UTILS_AMIXER
	depends on (BR2_PACKAGE_HAS_LIBGLES || BR2_PACKAGE_HAS_LIBGL)
	select BR2_PACKAGE_LIBFREEIMAGE
	select BR2_PACKAGE_FREETYPE
	select BR2_PACKAGE_EIGEN
	select BR2_PACKAGE_BOOST_FILESYSTEM
	select BR2_PACKAGE_BOOST_DATE_TIME
	select BR2_PACKAGE_BOOST_REGEX
	select BR2_PACKAGE_BOOST_LOCALE
	select BR2_PACKAGE_BOOST_SYSTEM
	select BR2_PACKAGE_BOOST_THREAD
	select BR2_PACKAGE_DEJAVU
	select BR2_PACKAGE_OPENSSL
	select BR2_PACKAGE_LIBCURL
	select BR2_PACKAGE_XMLSTARLET
	select BR2_PACKAGE_NANUM_FONT
        help
          A multi emulator frontend.

	  https://github.com/Aloshi/EmulationStation

if BR2_PACKAGE_BATOCERA_EMULATIONSTATION
choice
    prompt "ES version to compile"
    config BR2_PACKAGE_BATOCERA_EMULATIONSTATION_STANDARD
          bool "standard"
    config BR2_PACKAGE_BATOCERA_EMULATIONSTATION_ARCADE
          bool "arcade"
 endchoice
endif

comment "Emulation station 2 needs a toolchain w/ C++, ALSA, Boost, GLES and SDL2"
	depends on !BR2_INSTALL_LIBSTDCPP || !BR2_PACKAGE_SDL2 || !BR2_PACKAGE_SDL2_MIXER || \
		!BR2_PACKAGE_BOOST || !BR2_PACKAGE_ALSA_LIB || \
		(!BR2_PACKAGE_HAS_LIBGLES || !BR2_PACKAGE_HAS_LIBGL)
```

## package/batocera/batocera-linux/Config.in
```kconfig
source "package/batocera/batocera-linux/batocera-es-system/Config.in"	
source "package/batocera/batocera-linux/batocera-system/Config.in"
source "package/batocera/batocera-linux/recalbox-api/Config.in"
source "package/batocera/batocera-linux/recalbox-configgen/Config.in"
source "package/batocera/batocera-linux/recalbox-initramfs/Config.in"
source "package/batocera/batocera-linux/recalbox-retrogame/Config.in"
source "package/batocera/batocera-linux/recalbox-x86_64_efi/Config.in"
source "package/batocera/batocera-linux/uboot-odroid-xu4/Config.in"
source "package/batocera/batocera-linux/uboot-odroid-c2/Config.in"
```
