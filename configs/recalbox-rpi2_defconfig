## package/batocera/Config.in
```kconfig
menu "batocera.linux"

menu "System"
  source "package/batocera/core/batocera-system/Config.in"
  source "package/batocera/core/batocera-configgen/Config.in"
  source "package/batocera/core/batocera-retrogame/Config.in"
  source "package/batocera/core/batocera-desktopapps/Config.in"
  source "package/batocera/alllinuxfirmwares/Config.in"

  menu "Boot"
    source "package/batocera/boot/batocera-initramfs/Config.in"
    source "package/batocera/boot/batocera-x86_64_efi/Config.in"
    source "package/batocera/boot/uboot-odroid-xu4/Config.in"
    source "package/batocera/boot/uboot-odroid-c2/Config.in"
  endmenu

  menu "Fonts"
    source "package/batocera/fonts/nanum-font/Config.in"
  endmenu

  menu "Gpu"
    source "package/batocera/gpu/android-headers/Config.in"
    source "package/batocera/gpu/gpu-aml/Config.in"
    source "package/batocera/gpu/gpu-aml-t8xx/Config.in"
    source "package/batocera/gpu/libhybris/Config.in"
    source "package/batocera/gpu/mali-450/Config.in"
    source "package/batocera/gpu/mali-opengles-sdk/Config.in"
    source "package/batocera/gpu/mali-t62x-fbdev/Config.in"
    source "package/batocera/gpu/mali-t62x-wayland/Config.in"
    source "package/batocera/gpu/opengl-meson-t82x/Config.in"
  endmenu

  menu "Device trees"
    source "package/batocera/device-trees/device-trees-aml-s9xx/Config.in"
  endmenu
endmenu

menu "Emulationstation"
  source "package/batocera/emulationstation/batocera-emulationstation/Config.in"
  source "package/batocera/emulationstation/batocera-es-system/Config.in"	
  source "package/batocera/emulationstation/python-es-scraper/Config.in"
  source "package/batocera/emulationstation/recalbox-themes/Config.in"
  source "package/batocera/emulationstation/sselph-scraper/Config.in"
endmenu

menu "Controllers"
  source "package/batocera/controllers/db9_gpio_rpi/Config.in"
  source "package/batocera/controllers/gamecon_gpio_rpi/Config.in"
  source "package/batocera/controllers/mk_arcade_joystick_rpi/Config.in"
  source "package/batocera/controllers/qtsixa/Config.in"
  source "package/batocera/controllers/qtsixa-shanwan/Config.in"
  source "package/batocera/controllers/virtualgamepads/Config.in"
  source "package/batocera/controllers/xarcade2jstick/Config.in"
  source "package/batocera/controllers/xboxdrv/Config.in"	
endmenu

menu "Emulators"
  menu "Retroarch"
    source "package/batocera/emulators/retroarch/retroarch/Config.in"
    source "package/batocera/emulators/retroarch/batocera-bezel/Config.in"
    menu "cores"
    source "package/batocera/emulators/retroarch/libretro/libretro-atari800/Config.in"
    source "package/batocera/emulators/retroarch/libretro/libretro-pocketsnes/Config.in"
    source "package/batocera/emulators/retroarch/libretro/libretro-catsfc/Config.in"
    source "package/batocera/emulators/retroarch/libretro/libretro-beetle-vb/Config.in"
    source "package/batocera/emulators/retroarch/libretro/libretro-snes9x/Config.in"
    source "package/batocera/emulators/retroarch/libretro/libretro-snes9x-next/Config.in"
    source "package/batocera/emulators/retroarch/libretro/libretro-desmume/Config.in"
    source "package/batocera/emulators/retroarch/libretro/libretro-picodrive/Config.in"
    source "package/batocera/emulators/retroarch/libretro/libretro-genesisplusgx/Config.in"
    source "package/batocera/emulators/retroarch/libretro/libretro-gambatte/Config.in"
    source "package/batocera/emulators/retroarch/libretro/libretro-stella/Config.in"
    source "package/batocera/emulators/retroarch/libretro/libretro-pcsx/Config.in"
    source "package/batocera/emulators/retroarch/libretro/libretro-beetle-psx/Config.in"
    source "package/batocera/emulators/retroarch/libretro/libretro-beetle-saturn/Config.in"
    source "package/batocera/emulators/retroarch/libretro/libretro-fceumm/Config.in"
    source "package/batocera/emulators/retroarch/libretro/libretro-fceunext/Config.in"
    source "package/batocera/emulators/retroarch/libretro/libretro-nestopia/Config.in"
    source "package/batocera/emulators/retroarch/libretro/libretro-imame/Config.in"
    source "package/batocera/emulators/retroarch/libretro/libretro-scummvm/Config.in"
    source "package/batocera/emulators/retroarch/libretro/libretro-beetle-pce/Config.in"
    source "package/batocera/emulators/retroarch/libretro/libretro-beetle-pcfx/Config.in"
    source "package/batocera/emulators/retroarch/libretro/libretro-meteor/Config.in"
    source "package/batocera/emulators/retroarch/libretro/libretro-virtualjaguar/Config.in"
    source "package/batocera/emulators/retroarch/libretro/libretro-fmsx/Config.in"
    source "package/batocera/emulators/retroarch/libretro/libretro-bluemsx/Config.in"
    source "package/batocera/emulators/retroarch/libretro/libretro-gpsp/Config.in"
    source "package/batocera/emulators/retroarch/libretro/libretro-4do/Config.in"
    source "package/batocera/emulators/retroarch/libretro/libretro-fba/Config.in"
    source "package/batocera/emulators/retroarch/libretro/libretro-gw/Config.in"
    source "package/batocera/emulators/retroarch/libretro/libretro-prboom/Config.in"
    source "package/batocera/emulators/retroarch/libretro/libretro-beetle-ngp/Config.in"
    source "package/batocera/emulators/retroarch/libretro/libretro-vecx/Config.in"
    source "package/batocera/emulators/retroarch/libretro/libretro-beetle-lynx/Config.in"
    source "package/batocera/emulators/retroarch/libretro/libretro-lutro/Config.in"
    source "package/batocera/emulators/retroarch/libretro/libretro-beetle-wswan/Config.in"
    source "package/batocera/emulators/retroarch/libretro/libretro-uae/Config.in"
    source "package/batocera/emulators/retroarch/libretro/libretro-parallel-n64/Config.in"
    source "package/batocera/emulators/retroarch/libretro/libretro-beetle-supergrafx/Config.in"
    source "package/batocera/emulators/retroarch/libretro/libretro-nxengine/Config.in"
    source "package/batocera/emulators/retroarch/libretro/libretro-prosystem/Config.in"
    source "package/batocera/emulators/retroarch/libretro/libretro-tgbdual/Config.in"
    source "package/batocera/emulators/retroarch/libretro/libretro-mgba/Config.in"
    source "package/batocera/emulators/retroarch/libretro/libretro-mame2003/Config.in"
    source "package/batocera/emulators/retroarch/libretro/libretro-mame2003-plus/Config.in"
    source "package/batocera/emulators/retroarch/libretro/libretro-mame2010/Config.in"
    source "package/batocera/emulators/retroarch/libretro/libretro-fuse/Config.in"
    source "package/batocera/emulators/retroarch/libretro/libretro-cap32/Config.in"
    source "package/batocera/emulators/retroarch/libretro/libretro-81/Config.in"
    source "package/batocera/emulators/retroarch/libretro/libretro-imageviewer/Config.in"
    source "package/batocera/emulators/retroarch/libretro/libretro-o2em/Config.in"
    source "package/batocera/emulators/retroarch/libretro/libretro-hatari/Config.in"
    source "package/batocera/emulators/retroarch/libretro/libretro-quicknes/Config.in"
    source "package/batocera/emulators/retroarch/libretro/libretro-redream/Config.in"
    source "package/batocera/emulators/retroarch/libretro/libretro-yabause/Config.in"
    source "package/batocera/emulators/retroarch/libretro/libretro-freeintv/Config.in"
    source "package/batocera/emulators/retroarch/libretro/libretro-cheats/Config.in"
    source "package/batocera/emulators/retroarch/libretro/libretro-mupen64plus/Config.in"
    source "package/batocera/emulators/retroarch/libretro/libretro-reicast/Config.in"
    source "package/batocera/emulators/retroarch/libretro/libretro-reicast-oit/Config.in"
    source "package/batocera/emulators/retroarch/libretro/libretro-px68k/Config.in"
    source "package/batocera/emulators/retroarch/libretro/libretro-dolphin/Config.in"
    source "package/batocera/emulators/retroarch/libretro/libretro-ppsspp/Config.in"
    source "package/batocera/emulators/retroarch/libretro/libretro-dosbox/Config.in"
    source "package/batocera/emulators/retroarch/libretro/libretro-vice/Config.in"
    source "package/batocera/emulators/retroarch/libretro/libretro-mame2016/Config.in"
    endmenu
  endmenu
  
  source "package/batocera/emulators/advancemame/Config.in"
  source "package/batocera/emulators/amiberry/Config.in"
  source "package/batocera/emulators/dolphin-emu/Config.in"
  source "package/batocera/emulators/dosbox/Config.in"
  source "package/batocera/emulators/fsuae/Config.in"
  source "package/batocera/emulators/fsuae-capsimg-plugin/Config.in"
  source "package/batocera/emulators/gpsp/Config.in"
  source "package/batocera/emulators/linapple-pie/Config.in"
  source "package/batocera/emulators/moonlight-embedded/Config.in"

  menu "mupen64plus"
    source "package/batocera/emulators/mupen64plus/mupen64plus-core/Config.in"
    source "package/batocera/emulators/mupen64plus/mupen64plus-uiconsole/Config.in"
    source "package/batocera/emulators/mupen64plus/mupen64plus-gles2/Config.in"
    source "package/batocera/emulators/mupen64plus/mupen64plus-gles2rice/Config.in"
    source "package/batocera/emulators/mupen64plus/mupen64plus-video-glide64mk2/Config.in"
    source "package/batocera/emulators/mupen64plus/mupen64plus-omx/Config.in"
    source "package/batocera/emulators/mupen64plus/mupen64plus-input-sdl/Config.in"
    source "package/batocera/emulators/mupen64plus/mupen64plus-audio-sdl/Config.in"
    source "package/batocera/emulators/mupen64plus/mupen64plus-rsphle/Config.in"
    source "package/batocera/emulators/mupen64plus/mupen64plus-rice/Config.in"
    source "package/batocera/emulators/mupen64plus/mupen64plus-gliden64/Config.in"
  endmenu

  source "package/batocera/emulators/pcsx2/Config.in"
  source "package/batocera/emulators/pcsx2_avx2/Config.in"
  source "package/batocera/emulators/pcsx2-x86/Config.in"
  source "package/batocera/emulators/pifba/Config.in"
  source "package/batocera/emulators/ppsspp/Config.in"
  source "package/batocera/emulators/ppsspp15/Config.in"
  source "package/batocera/emulators/reicast/Config.in"
  source "package/batocera/emulators/scummvm/Config.in"
  source "package/batocera/emulators/vice/Config.in"
endmenu

menu "Kodi"
  source "package/batocera/kodi/kodi-joystick/Config.in"
  source "package/batocera/kodi/kodi-plugin-video-filmon/Config.in"
  source "package/batocera/kodi/kodi-superrepo-all/Config.in"
  source "package/batocera/kodi/kodi-superrepo-repositories/Config.in"
  source "package/batocera/kodi/kodi-resource-language-de_de/Config.in"
  source "package/batocera/kodi/kodi-resource-language-es_es/Config.in"
  source "package/batocera/kodi/kodi-resource-language-eu_es/Config.in"	
  source "package/batocera/kodi/kodi-resource-language-fr_fr/Config.in"
  source "package/batocera/kodi/kodi-resource-language-it_it/Config.in"
  source "package/batocera/kodi/kodi-resource-language-pt_br/Config.in"
  source "package/batocera/kodi/kodi-resource-language-sv_se/Config.in"
  source "package/batocera/kodi/kodi-resource-language-tr_tr/Config.in"
  source "package/batocera/kodi/kodi-resource-language-zh_cn/Config.in"
endmenu

menu "Utils"
  source "package/batocera/utils/raspi2png/Config.in"
  source "package/batocera/utils/megatools/Config.in"
  source "package/batocera/utils/jstest2/Config.in"
  source "package/batocera/utils/unclutter/Config.in"
  source "package/batocera/utils/fluidsynth/Config.in"
endmenu

menu "Libraries"
  source "package/batocera/libraries/guichan/Config.in"
  source "package/batocera/libraries/libcapsimage/Config.in"
  source "package/batocera/libraries/libenet/Config.in"
  source "package/batocera/libraries/openal-soft/Config.in"
  source "package/batocera/libraries/python-autobreadcrumbs/Config.in"
  source "package/batocera/libraries/python-rpigpio/Config.in"
  source "package/batocera/libraries/sfml/Config.in"
  source "package/batocera/libraries/wxwidgets/Config.in"
endmenu

endmenu
```

## package/batocera/alllinuxfirmwares/Config.in
```kconfig
config BR2_PACKAGE_ALLLINUXFIRMWARES
	bool "alllinuxfirmwares"
	help
	  This package provides various binary firmware files (closed
	  binary blobs) for such devices like LAN, WLAN cards etc.

	  https://git.kernel.org/?p=linux/kernel/git/firmware/linux-firmware.git
```

## package/batocera/amiberry/Config.in
```kconfig
config BR2_PACKAGE_AMIBERRY
        bool "amiberry"
        select BR2_PACKAGE_SDL
	select BR2_PACKAGE_SDL_IMAGE
	select BR2_PACKAGE_SDL_GFX
	select BR2_PACKAGE_SDL_TTF
	select BR2_PACKAGE_MPG123
	select BR2_PACKAGE_LIBXML2
	select BR2_PACKAGE_LIBMPEG2
	select BR2_PACKAGE_GUICHAN
	select BR2_PACKAGE_FLAC
	depends on BR2_PACKAGE_RPI_USERLAND
        help
          An amiga emulator for arm
```

## package/batocera/arch/firmware-wlan-aml/Config.in
```kconfig
config BR2_PACKAGE_FIRMWARE_WLAN_AML
	bool "firmware-wlan-aml"
	help
	  Provides binary firmware files for aml tv boxes.
```

## package/batocera/arch/firmware_nonfree_rpi/Config.in
```kconfig
config BR2_PACKAGE_FIRMWARE_NONFREE_RPI
	bool "firmware_nonfree_rpi"
	help
	  This package provides various binary firmware files (closed
	  binary blobs) for such devices like LAN, WLAN cards etc.

	  https://github.com/RPi-Distro/firmware-nonfree.git
```

## package/batocera/audio/alsa-topology-conf/Config.in
```kconfig
config BR2_PACKAGE_ALSA_TOPOLOGY_CONF
	bool "alsa-topology-conf"
	help
	  ALSA topology configuration files.

	  https://github.com/alsa-project/alsa-topology-conf
```

## package/batocera/audio/chromebook-linux-audio/Config.in
```kconfig
config BR2_PACKAGE_CHROMEBOOK_LINUX_AUDIO
	bool "chromebook-linux-audio"
	select BR2_PACKAGE_ALLLINUXFIRMWARES
	select BR2_PACKAGE_SOUND_OPEN_FIRMWARE
	help
	  Enable AMD firmware audio support on many Chromebook devices.

	  https://github.com/WeirdTreeThing/chromebook-linux-audio
```

## package/batocera/audio/libfreeaptx/Config.in
```kconfig
config BR2_PACKAGE_LIBFREEAPTX
	bool "libfreeaptx"
	help
	  Free implementation of Audio Processing Technology codec (aptX)
	  forked from libopenaptx 0.2.0.
	  
	  https://github.com/iamthehorker/libfreeaptx
```

## package/batocera/audio/liblc3/Config.in
```kconfig
config BR2_PACKAGE_LIBLC3
    bool "liblc3"
    help
      LC3 audio codec designed for low-latency audio transport.
      
      https://github.com/google/liblc3
```

## package/batocera/audio/libldac/Config.in
```kconfig
config BR2_PACKAGE_LIBLDAC
	bool "libldac"
	help
	  LDAC Bluetooth encoder library.
	  
	  https://github.com/EHfive/ldacBT
```

## package/batocera/audio/munt/Config.in
```kconfig
config BR2_PACKAGE_MUNT
	bool "munt"
	help
	  A multi-platform software synthesiser emulating pre-GM MIDI devices
	  such as the Roland MT-32, CM-32L, CM-64 and LAPC-I.
	  In no way endorsed by or affiliated with Roland Corp.
	  
	  https://sourceforge.net/projects/munt/
```

## package/batocera/audio/ossp/Config.in
```kconfig
config BR2_PACKAGE_OSSP
    bool "ossp"
    select BR2_PACKAGE_LIBFUSE3
    help
      Emulate OSS device(s) using CUSE.
      
      https://github.com/OpenMandrivaSoftware/ossp
```

## package/batocera/audio/rtmidi/Config.in
```kconfig
config BR2_PACKAGE_RTMIDI
    bool "rtmidi"
    select BR2_PACKAGE_ALSA_LIB
    help
      A set of C++ classes that provide a common API for realtime MIDI
      input/output across Linux (ALSA & JACK)
      
      https://github.com/thestk/rtmidi
```

## package/batocera/audio/wm8960-audio-hat/Config.in
```kconfig
comment "rwm8960-audio-hat needs a Linux kernel to be built"
	depends on !BR2_LINUX_KERNEL

config BR2_PACKAGE_WM8960_AUDIO_HAT
	bool "wm8960-audio-hat"
	depends on BR2_LINUX_KERNEL
	select BR2_PACKAGE_ALSA_LIB
	select BR2_PACKAGE_RPI_UTILS
	help
	  The drivers for the WM8960 Audio HAT for Raspberry Pi devices.

	  https://github.com/waveshareteam/WM8960-Audio-HAT
	  https://www.waveshare.com/wm8960-audio-hat.htm
```
