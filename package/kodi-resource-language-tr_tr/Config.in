## package/kodi-resource-language-tr_tr/Config.in
```kconfig
config BR2_PACKAGE_KODI_RESOURCE_LANGUAGE_tr_tr
    depends on BR2_PACKAGE_KODI
    bool "kodi-resource-language-tr_tr"
    default y
    help
      Kodi tr_tr language resource

      https://kodi.tv
```

## package/kodi-resource-language-zh_cn/Config.in
```kconfig
config BR2_PACKAGE_KODI_RESOURCE_LANGUAGE_zh_cn
    depends on BR2_PACKAGE_KODI
    bool "kodi-resource-language-zh_cn"
    default y
    help
      Kodi zh_cn language resource

      https://kodi.tv
```

## package/kodi-script.module.t0mm0.common/Config.in
```kconfig
config BR2_PACKAGE_KODI_SCRIPT_MODULE_T0MM0_COMMON
    depends on BR2_PACKAGE_KODI
    bool "kodi-script.module.t0mm0.common"
    default y
    help
      Kodi Collection of commonly used addon routines

      https://kodi.tv
```

## package/kodi-superrepo-all/Config.in
```kconfig
config BR2_PACKAGE_KODI_SUPERREPO_ALL
    depends on BR2_PACKAGE_KODI
    bool "kodi-superrepo-all"
    default y
    help
      Kodi SuperRepo All

      http://srp.nu
```

## package/kodi-superrepo-repositories/Config.in
```kconfig
config BR2_PACKAGE_KODI_SUPERREPO_REPOSITORIES
    depends on BR2_PACKAGE_KODI
    bool "kodi-superrepo-repositories"
    default y
    help
      Kodi SuperRepo Repositories

      http://srp.nu
```

## package/kodi-visualisation-spectrum/Config.in
```kconfig
config BR2_PACKAGE_KODI_VISUALISATION_SPECTRUM
    depends on BR2_PACKAGE_KODI
	bool "kodi-visualisation-spectrum"
	help
	  Spectrum visualiser for Kodi

	  https://github.com/notspiff/visualization.spectrum
```

## package/kodi-visualisation-waveforhue/Config.in
```kconfig
config BR2_PACKAGE_KODI_VISUALISATION_WAVEFORHUE
    depends on BR2_PACKAGE_KODI
	bool "kodi-visualisation-waveforhue"
	help
	  WaveForHue visualiser for Kodi

	  https://github.com/notspiff/visualization.waveforhue
```

## package/kodi-visualisation-waveform/Config.in
```kconfig
config BR2_PACKAGE_KODI_VISUALISATION_WAVEFORM
    depends on BR2_PACKAGE_KODI
	bool "kodi-visualisation-waveform"
	help
	  Waveform visualiser for Kodi

	  https://github.com/notspiff/visualization.waveform
```

## package/libcapsimage/Config.in
```kconfig
config BR2_PACKAGE_LIBCAPSIMAGE
        bool "libcapsimage"
	help
	  IPF library to enable IPF image
	  support in a third party application.

	  http://www.softpres.org/download
```

## package/libretro-4do/Config.in
```kconfig
config BR2_PACKAGE_LIBRETRO_4DO
        bool "libretro-4do"
	depends on BR2_PACKAGE_RETROARCH
	depends on BR2_INSTALL_LIBSTDCPP
        help
          A libretro 3DO emulator core for ARM.

	  http://www.libretro.com

comment "LIBRETRO_4DO needs a toolchain w/ C++"
	depends on !BR2_INSTALL_LIBSTDCPP
```

## package/libretro-81/Config.in
```kconfig
config BR2_PACKAGE_LIBRETRO_81
        bool "libretro-81"
	depends on BR2_PACKAGE_RETROARCH
	depends on BR2_INSTALL_LIBSTDCPP
        help
          A libretro EightyOne ZX81 emulator core.

	  http://www.libretro.com

comment "LIBRETRO_81 needs a toolchain w/ C++"
	depends on !BR2_INSTALL_LIBSTDCPP
```

## package/libretro-beetle-ngp/Config.in
```kconfig
config BR2_PACKAGE_LIBRETRO_BEETLE_NGP
        bool "libretro-beetle-ngp"
	depends on BR2_PACKAGE_RETROARCH
	depends on BR2_INSTALL_LIBSTDCPP
        help
          A libretro NGP emulator core for ARM.

	  http://www.libretro.com

comment "LIBRETRO_BEETLE_NGP needs a toolchain w/ C++"
	depends on !BR2_INSTALL_LIBSTDCPP
```

## package/libretro-beetle-pcfx/Config.in
```kconfig
config BR2_PACKAGE_LIBRETRO_BEETLE_PCFX
        bool "libretro-beetle-pcfx"
	depends on BR2_PACKAGE_RETROARCH
	depends on BR2_INSTALL_LIBSTDCPP
        help
          A libretro PCFX emulator core for ARM.

	  http://www.libretro.com

comment "LIBRETRO_BEETLE_PCFX needs a toolchain w/ C++"
	depends on !BR2_INSTALL_LIBSTDCPP
```

## package/libretro-beetle-vb/Config.in
```kconfig
config BR2_PACKAGE_LIBRETRO_BEETLE_VB
        bool "libretro-beetle-vb"
	depends on BR2_PACKAGE_RETROARCH
	depends on BR2_INSTALL_LIBSTDCPP
        help
          A libretro VIRTUAL BOY emulator core for ARM.

	  http://www.libretro.com

comment "LIBRETRO_BEETLE_VB needs a toolchain w/ C++"
	depends on !BR2_INSTALL_LIBSTDCPP
```

## package/libretro-beetle-wswan/Config.in
```kconfig
config BR2_PACKAGE_LIBRETRO_BEETLE_WSWAN
        bool "libretro-beetle-wswan"
	depends on BR2_PACKAGE_RETROARCH
	depends on BR2_INSTALL_LIBSTDCPP
        help
          A libretro Wonderswan emulator core for ARM.

	  http://www.libretro.com

comment "LIBRETRO_LIBRETRO_BEETLE_WSWAN needs a toolchain w/ C++"
	depends on !BR2_INSTALL_LIBSTDCPP
```

## package/libretro-bluemsx/Config.in
```kconfig
config BR2_PACKAGE_LIBRETRO_BLUEMSX
        bool "libretro-bluemsx"
	depends on BR2_PACKAGE_RETROARCH
	depends on BR2_INSTALL_LIBSTDCPP
        help
          A libretro MSX / ColecoVision emulator core for ARM.

	  http://www.libretro.com

comment "LIBRETRO_BLUEMSX needs a toolchain w/ C++"
	depends on !BR2_INSTALL_LIBSTDCPP
```

## package/libretro-cheats/Config.in
```kconfig
config BR2_PACKAGE_LIBRETRO_CHEATS
        bool "libretro-cheats"
	depends on BR2_PACKAGE_RETROARCH
        help
          Libretro cheats codes.

	  http://www.libretro.com
```

## package/libretro-fceumm/Config.in
```kconfig
config BR2_PACKAGE_LIBRETRO_FCEUMM
        bool "libretro-fceumm"
	depends on BR2_PACKAGE_RETROARCH
	depends on BR2_INSTALL_LIBSTDCPP
        help
          A libretro NES emulator core for ARM.

	  http://www.libretro.com

comment "LIBRETRO_FCEUMM needs a toolchain w/ C++"
	depends on !BR2_INSTALL_LIBSTDCPP
```

## package/libretro-fceunext/Config.in
```kconfig
config BR2_PACKAGE_LIBRETRO_FCEUNEXT
        bool "libretro-fceunext"
	depends on BR2_PACKAGE_RETROARCH
	depends on BR2_INSTALL_LIBSTDCPP
        help
          A libretro NES emulator core for ARM.

	  http://www.libretro.com

comment "LIBRETRO_FCEUNEXT needs a toolchain w/ C++"
	depends on !BR2_INSTALL_LIBSTDCPP
```

## package/libretro-fmsx/Config.in
```kconfig
config BR2_PACKAGE_LIBRETRO_FMSX
        bool "libretro-fmsx"
	depends on BR2_PACKAGE_RETROARCH
	depends on BR2_INSTALL_LIBSTDCPP
        help
          A libretro FMSX emulator core for ARM.

	  http://www.libretro.com

comment "LIBRETRO_FMSX needs a toolchain w/ C++"
	depends on !BR2_INSTALL_LIBSTDCPP
```

## package/libretro-fuse/Config.in
```kconfig
config BR2_PACKAGE_LIBRETRO_FUSE
        bool "libretro-fuse"
	depends on BR2_PACKAGE_RETROARCH
	depends on BR2_INSTALL_LIBSTDCPP
        help
          A libretro ZX SPECTRUM emulator core.

	  http://www.libretro.com

comment "LIBRETRO_FUSE needs a toolchain w/ C++"
	depends on !BR2_INSTALL_LIBSTDCPP
```

## package/libretro-genesisplusgx/Config.in
```kconfig
config BR2_PACKAGE_LIBRETRO_GENESISPLUSGX
        bool "libretro-genesisplusgx"
	depends on BR2_PACKAGE_RETROARCH
	depends on BR2_INSTALL_LIBSTDCPP
        help
          A libretro SEGA 8 / 16 bits emulator core for ARM.

	  http://www.libretro.com

comment "LIBRETRO_GENESISPLUSGX needs a toolchain w/ C++"
	depends on !BR2_INSTALL_LIBSTDCPP
```

## package/libretro-glupen64/Config.in
```kconfig
config BR2_PACKAGE_LIBRETRO_GLUPEN64
        bool "libretro-glupen64"
	depends on BR2_PACKAGE_RETROARCH
	depends on BR2_INSTALL_LIBSTDCPP
        help
          A alternative libretro N64 emulator core for ARM.

	  http://www.libretro.com

comment "LIBRETRO_GLUPEN64 needs a toolchain w/ C++"
	depends on !BR2_INSTALL_LIBSTDCPP
```

## package/libretro-gpsp/Config.in
```kconfig
config BR2_PACKAGE_LIBRETRO_GPSP
        bool "libretro-gpsp"
	depends on BR2_PACKAGE_RETROARCH
	depends on BR2_INSTALL_LIBSTDCPP
        help
          A libretro GBA emulator core for ARM.

	  http://www.libretro.com

comment "LIBRETRO_GPSP needs a toolchain w/ C++"
	depends on !BR2_INSTALL_LIBSTDCPP
```

## package/libretro-hatari/Config.in
```kconfig
config BR2_PACKAGE_LIBRETRO_HATARI
	bool "libretro-hatari"
	depends on BR2_PACKAGE_RETROARCH
	depends on BR2_INSTALL_LIBSTDCPP
	select BR2_PACKAGE_LIBCAPSIMAGE
	help
	  A libretro Atari ST emulator core.

	  http://www.libretro.com

comment "LIBRETRO_HATARI needs a toolchain w/ C++"
	depends on !BR2_INSTALL_LIBSTDCPP
```
