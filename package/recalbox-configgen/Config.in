## package/recalbox-configgen/Config.in
```kconfig
config BR2_PACKAGE_RECALBOX_CONFIGGEN
        bool "recalbox configgen"
	select BR2_PACKAGE_PYTHON
        help
          The configuration utility for recalbox

	  https://github.com/digitallumberjack/recalbox-configgen
```

## package/recalbox-emulationstation2/Config.in
```kconfig
config BR2_PACKAGE_RECALBOX_EMULATIONSTATION2
        bool "recalbox Emulationstation 2"
	depends on BR2_INSTALL_LIBSTDCPP
	depends on BR2_PACKAGE_SDL2
	depends on BR2_PACKAGE_SDL2_MIXER
	depends on BR2_PACKAGE_BOOST
	depends on BR2_PACKAGE_ALSA_LIB
	depends on BR2_PACKAGE_ALSA_UTILS_AMIXER
	depends on (BR2_PACKAGE_HAS_LIBGLES || BR2_PACKAGE_HAS_LIBGL)
	select BR2_PACKAGE_FREEIMAGE
	select BR2_PACKAGE_FREETYPE
	select BR2_PACKAGE_EIGEN
	select BR2_PACKAGE_BOOST_FILESYSTEM
	select BR2_PACKAGE_BOOST_DATE_TIME
	select BR2_PACKAGE_BOOST_REGEX
	select BR2_PACKAGE_BOOST_LOCALE
	select BR2_PACKAGE_BOOST_SYSTEM
	select BR2_PACKAGE_BOOST_THREAD
	select BR2_PACKAGE_DEJAVU
	select BR2_PACKAGE_OPENSSL
	select BR2_PACKAGE_LIBCURL
	select BR2_PACKAGE_XMLSTARLET
        help
          A multi emulator frontend.

	  https://github.com/Aloshi/EmulationStation

if BR2_PACKAGE_RECALBOX_EMULATIONSTATION2
choice
    prompt "ES version to compile"
    config BR2_PACKAGE_RECALBOX_EMULATIONSTATION2_STANDARD        
          bool "standard"
    config BR2_PACKAGE_RECALBOX_EMULATIONSTATION2_ARCADE        
          bool "arcade"
 endchoice
endif

comment "Emulation station 2 needs a toolchain w/ C++, ALSA, Boost, GLES and SDL2"
	depends on !BR2_INSTALL_LIBSTDCPP || !BR2_PACKAGE_SDL2 || !BR2_PACKAGE_SDL2_MIXER || \
		!BR2_PACKAGE_BOOST || !BR2_PACKAGE_ALSA_LIB || \
		(!BR2_PACKAGE_HAS_LIBGLES || !BR2_PACKAGE_HAS_LIBGL)
```

## package/recalbox-manager/Config.in
```kconfig
config BR2_RECALBOX_MANAGER
	bool "recalbox-manager"
	depends on BR2_PACKAGE_PYTHON_DJANGO
	depends on BR2_PACKAGE_PYTHON_PSUTIL
	depends on BR2_PACKAGE_PYTHON_AUTOBREADCRUMBS
	help
	 https://github.com/sveetch/recalbox-manager
```

## package/recalbox-system/Config.in
```kconfig
config BR2_PACKAGE_RECALBOX_SYSTEM
    bool "Recalbox System"
    help
      Install the recalbox system files

choice
	prompt "Recalbox target"
	default BR2_PACKAGE_RECALBOX_TARGET_RPI2
	help
	  Select Recalbox target hardware

config BR2_PACKAGE_RECALBOX_TARGET_RPI0
	bool "rpi0"

config BR2_PACKAGE_RECALBOX_TARGET_RPI1
	bool "rpi1"

config BR2_PACKAGE_RECALBOX_TARGET_RPI2
	bool "rpi2"

config BR2_PACKAGE_RECALBOX_TARGET_RPI3
	bool "rpi3"

config BR2_PACKAGE_RECALBOX_TARGET_XU4
	bool "xu4"

config BR2_PACKAGE_RECALBOX_TARGET_X86
	bool "x86"

endchoice
```

## package/reicast/Config.in
```kconfig
config BR2_PACKAGE_REICAST
        bool "reicast"
        depends on BR2_PACKAGE_SDL2
        depends on BR2_PACKAGE_LIBPNG
        help
          A  Dreamcast emulator
```

## package/retroarch/Config.in
```kconfig
config BR2_PACKAGE_RETROARCH
	depends on (BR2_PACKAGE_HAS_LIBGLES || BR2_PACKAGE_HAS_LIBEGL || BR2_PACKAGE_HAS_LIBGL)
        bool "Retroarch"
        help
          A multi emulator frontend.

	  http://www.libretro.com

#if BR2_PACKAGE_RETROARCH
#config BR2_PACKAGE_RETROARCH_RPI1
#        bool "Compile for RPI1"
#        help
#		Compile for rpi1
#endif

comment "Retroarch depends on EGL or OpenGLES"
	depends on !(BR2_PACKAGE_HAS_LIBEGL || BR2_PACKAGE_HAS_LIBGLES || BR2_PACKAGE_HAS_LIBGL)
```

## package/retrolx/emulators/flycast/Config.in
```kconfig
config BR2_PACKAGE_FLYCAST
    bool "flycast"
    depends on BR2_PACKAGE_SDL2
    depends on BR2_PACKAGE_LIBPNG
    depends on BR2_PACKAGE_LIBZIP
    depends on BR2_GCC_ENABLE_OPENMP
    
    help
        Flycast is a multiplatform Sega Dreamcast, Naomi and Atomiswave emulator
```

## package/retrolx/emulators/hatari/Config.in
```kconfig
config BR2_PACKAGE_HATARI
    bool "hatari"
    select BR2_PACKAGE_SDL2
    select BR2_PACKAGE_ZLIB
    select BR2_PACKAGE_LIBPNG
    select BR2_PACKAGE_LIBCAPSIMAGE

    help
    	An Atari ST/STe/TT/Falcon emulator
```

## package/retrolx/frontends/attractmode/Config.in
```kconfig
config BR2_PACKAGE_ATTRACTMODE
    bool "attractmode"
    select BR2_PACKAGE_SFML

    help
      Attract-Mode frontend

      https://github.com/mickelson/attract
```

## package/retrolx/frontends/retrofe/Config.in
```kconfig
config BR2_PACKAGE_RETROFE
    bool "retrofe"
    select BR2_PACKAGE_SDL2
    select BR2_PACKAGE_SDL2_IMAGE
    select BR2_PACKAGE_SDL2_MIXER
    select BR2_PACKAGE_SDL2_TTF
    select BR2_PACKAGE_GSTREAMER1
    select BR2_PACKAGE_GST1_PLUGINS_BASE

    help
      RetroFE frontend

      https://github.com/phulshof/RetroFE
```

## package/retrolx/libraries/libxmp/Config.in
```kconfig
config BR2_PACKAGE_LIBXMP
	bool "libxmp"
	help
	  Libxmp is a library that renders module files to PCM data. It supports
	  over 90 mainstream and obscure module formats including Protracker (MOD),
	  Scream Tracker 3 (S3M), Fast Tracker II (XM), and Impulse Tracker (IT).

	  https://github.com/libxmp/libxmp	  
```

## package/retrolx/libraries/sfml/Config.in
```kconfig
config BR2_PACKAGE_SFML
    bool "sfml"

    help
      SFML library

      https://github.com/SFML/SFML
```

## package/retrolx/linux/kernel-exynos5422/Config.in
```kconfig
config BR2_PACKAGE_KERNEL_EXYNOS5422
        bool "kernel-exynos5422"
        help
          Samsung Exynos 5422 kernel for RetroLX
```

## package/retrolx/linux/kernel-h616/Config.in
```kconfig
config BR2_PACKAGE_KERNEL_H616
        bool "kernel-h616"
        help
          Allwinner H616 kernel for RetroLX
```

## package/retrolx/linux/kernel-meson64/Config.in
```kconfig
config BR2_PACKAGE_KERNEL_MESON64
        bool "kernel-meson64"
        help
          Meson64 kernel for RetroLX
```

## package/retrolx/linux/kernel-rk3399/Config.in
```kconfig
config BR2_PACKAGE_KERNEL_RK3399
        bool "kernel-rk3399"
        help
          Rockchip RK3399 kernel for RetroLX
```

## package/retrolx/retrofe/Config.in
```kconfig
config BR2_PACKAGE_RETROFE
    bool "retrofe"
    depends on BR2_PACKAGE_SDL2
    select BR2_PACKAGE_GSTREAMER1
    select BR2_PACKAGE_GST1_PLUGINS_BASE

    help
      RetroFE frontend

      https://github.com/phulshof/RetroFE
```

## package/sdl2/Config.in
```kconfig
config BR2_PACKAGE_SDL2
	bool "SDL2"
	depends on BR2_PACKAGE_HAS_UDEV
	help
	  Simple DirectMedia Layer - Version 2
	  SDL is a library that allows programs portable low level
	  access to a video framebuffer, audio output, mouse, and keyboard.

	  http://www.libsdl.org/
```

## package/sdl2_mixer/Config.in
```kconfig
config BR2_PACKAGE_SDL2_MIXER
	bool "SDL2_MIXER"
	depends on BR2_PACKAGE_SDL2
	help
	  Simple DirectMedia Layer MIXER - Version 2
	  SDL is a library that allows programs portable low level
	  access to a video framebuffer, audio output, mouse, and keyboard.

	  http://www.libsdl.org/
```

## package/sfml/Config.in
```kconfig
config BR2_PACKAGE_SFML
        bool "sfml"
	select BR2_PACKAGE_XCB_UTIL_IMAGE
	select BR2_PACKAGE_OPENAL
        help
          Simple and Fast Multimedia Library
```

## package/sselph-scraper/Config.in
```kconfig
config BR2_PACKAGE_SSELPH_SCRAPER
    bool "sselph-scraper"
    help
      sselph-scraper scraper
```

## package/unclutter/Config.in
```kconfig
config BR2_PACKAGE_UNCLUTTER
        bool "unclutter"
	depends on BR2_PACKAGE_XORG7
        help
          Hide X11 Cursor
```

## package/vice/Config.in
```kconfig
config BR2_PACKAGE_VICE
       bool "vice"
         depends on BR2_PACKAGE_SDL
       help
	VICE is an emulator collection which emulates the C64, the C64-DTV, the C128, the VIC20, practically all PET models, the PLUS4 and the CBM-II (aka C610). It runs on Unix, MS-DOS, Win32, OS/2, Acorn RISC OS, BeOS, QNX 6.x, Amiga, GP2X or Mac OS X machines.

comment "Vice  needs a toolchain w/ OpenGl,  SDL"
         depends on BR2_PACKAGE_SDL
```

## package/virtualgamepads/Config.in
```kconfig
config BR2_PACKAGE_VIRTUALGAMEPADS
        bool "virtual-gamepads"
	depends on BR2_PACKAGE_NODEJS
        help
          Miroof's node virtual gamepads project

	  https://github.com/miroof/node-virtual-gamepads
```

## package/wiringpi/Config.in
```kconfig
config BR2_PACKAGE_WIRINGPI
	bool "wiringpi"
	depends on BR2_TOOLCHAIN_HAS_THREADS
	depends on BR2_INSTALL_LIBSTDCPP
	depends on BR2_arm || BR2_i386 || BR2_x86_64 || BR2_mipsel
	
	help
	 https://github.com/WiringPi/WiringPi
```
