## package/batocera/core/batocera-resolution/Config.in
```kconfig
config BR2_PACKAGE_BATOCERA_RESOLUTION
	bool "batocera-resolution"
	select BR2_PACKAGE_BASH
	select BR2_PACKAGE_PCIUTILS
	select BR2_PACKAGE_GRIM         if BR2_PACKAGE_BATOCERA_WAYLAND_SWAY
	select BR2_PACKAGE_WF_RECORDER  if BR2_PACKAGE_BATOCERA_WAYLAND_SWAY
	help
	  Scripts to help set resolution in Batocera
```

## package/batocera/core/batocera-retrogame/Config.in
```kconfig
config BR2_PACKAGE_BATOCERA_RETROGAME
    bool "batocera-retrogame"
    help
      Batocera-retrogame is optimized for Pi2 and manage a 2 player panel with an ESC key
```

## package/batocera/core/batocera-scripts/Config.in
```kconfig
config BR2_PACKAGE_BATOCERA_SCRIPTS
	bool "batocera-scripts"

	select BR2_PACKAGE_BASH
	select BR2_PACKAGE_PCIUTILS
	select BR2_PACKAGE_PYTHON3
	select BR2_PACKAGE_DBUS_PYTHON                          # required for bluetooth scripts
	select BR2_PACKAGE_JQ # for vulkan parsing
	select BR2_PACKAGE_PYTHON_GOBJECT # for bluetooth agent

	help
	  Batocera scripts
```

## package/batocera/core/batocera-settings/Config.in
```kconfig
config BR2_PACKAGE_BATOCERA_SETTINGS
	bool "batocera-settings"

	help
	  batocera-settings-get/set binaries
```

## package/batocera/core/batocera-triggerhappy/Config.in
```kconfig
config BR2_PACKAGE_BATOCERA_TRIGGERHAPPY
	bool "batocera-triggerhappy"

	select BR2_PACKAGE_TRIGGERHAPPY
```

## package/batocera/core/batocera-udev-rules/Config.in
```kconfig
config BR2_PACKAGE_BATOCERA_UDEV_RULES
	bool "batocera-udev-rules"

	select BR2_PACKAGE_USB_MODESWITCH_DATA
```

## package/batocera/core/recalbox-retrogame/Config.in
```kconfig
config BR2_PACKAGE_RECALBOX_RETROGAME
    bool "recalbox-retrogame"
    help
      Recalbox-retrogame is optimized for Pi2 and manage a 2 player panel with an ESC key
      see https://github.com/ian57/Recalbox-Retrogame-2Players-Pi2 for more on this software
```

## package/batocera/core/swapit/Config.in
```kconfig
config BR2_PACKAGE_SWAPIT
    bool "swapit"
    help
      add swap to the system
```

## package/batocera/database/influxdb/Config.in
```kconfig
config BR2_PACKAGE_INFLUXDB
	bool "influxdb"
	help
	  Scalable datastore for metrics, events, and real-time analytics.

	  https://influxdata.com/
```

## package/batocera/db9_gpio_rpi/Config.in
```kconfig
config BR2_PACKAGE_DB9_GPIO_RPI
	bool "db9 gpio driver"
	depends on BR2_LINUX_KERNEL
	help
	  Kernel module to support db9 joysticks on gpios

comment "db9 needs a kernel and headers"
	depends on !BR2_LINUX_KERNEL
```

## package/batocera/device-trees-aml-s9xx/Config.in
```kconfig
config BR2_PACKAGE_DEVICE_TREES_AML_S9XX
	bool "DEVICE_TREES_AML_S9XX"
	depends on BR2_LINUX_KERNEL

if BR2_PACKAGE_DEVICE_TREES_AML_S9XX

	if BR2_PACKAGE_RECALBOX_TARGET_S905
		config BR2_PACKAGE_DEVICE_TREES_AML_S9XX_GXBB_P200
			bool "gxbb_p200"
		config BR2_PACKAGE_DEVICE_TREES_AML_S9XX_GXBB_P201
			bool "gxbb_p201"
		config BR2_PACKAGE_DEVICE_TREES_AML_S9XX_GXL_P212
			bool "gxl_p212"
		config BR2_PACKAGE_DEVICE_TREES_AML_S9XX_GXL_P230
			bool "gxl_p230"
		config BR2_PACKAGE_DEVICE_TREES_AML_S9XX_GXL_P231
			bool "gxl_p231"
		config BR2_PACKAGE_DEVICE_TREES_AML_S9XX_GXL_P281
			bool "gxl_p281"
	endif

	if BR2_PACKAGE_RECALBOX_TARGET_S912
		config  BR2_PACKAGE_DEVICE_TREES_AML_S9XX_GXM_KVIM2
			bool "gxm_kvim2"
		config BR2_PACKAGE_DEVICE_TREES_AML_S9XX_GXM_Q20X
			bool "gxm_q20x"
	endif

endif
```

## package/batocera/display/sway/Config.in
```kconfig
config BR2_PACKAGE_SWAY
    bool "sway"

    depends on !BR2_STATIC_LIBS # wlroots
    depends on BR2_TOOLCHAIN_HAS_THREADS # wlroots
    depends on BR2_PACKAGE_HAS_LIBEGL # wlroots
    depends on BR2_PACKAGE_HAS_LIBEGL_WAYLAND # wlroots
    depends on BR2_PACKAGE_HAS_LIBGLES # wlroots
    depends on BR2_PACKAGE_HAS_UDEV # wlroots
    select BR2_PACKAGE_WLROOTS
    select BR2_PACKAGE_WLROOTS_X11  if BR2_PACKAGE_XWAYLAND
    select BR2_PACKAGE_CAIRO
    select BR2_PACKAGE_CAIRO_PNG
    select BR2_PACKAGE_PANGO
    select BR2_PACKAGE_LIBGLIB2
    select BR2_PACKAGE_PCRE2
    select BR2_PACKAGE_GRIM
    select BR2_PACKAGE_WF_RECORDER
    select BR2_PACKAGE_GDK_PIXBUF

    help
        Sway is a tiling Wayland compositor and a drop-in
        replacement for the i3 window manager for X11

	    https://swaywm.org/
```

## package/batocera/display/swaybg/Config.in
```kconfig
config BR2_PACKAGE_SWAYBG
    bool "swaybg"

    select BR2_PACKAGE_WAYLAND
    select BR2_PACKAGE_WAYLAND_PROTOCOLS
    select BR2_PACKAGE_CAIRO
    select BR2_PACKAGE_CAIRO_PNG

    help
        swaybg is a wallpaper utility for Wayland compositors.
        It is compatible with any Wayland compositor which implements
        the wlr-layer-shell protocol and wl_output version 4.

	    https://swaywm.org/
```

## package/batocera/display/xwayland/Config.in
```kconfig
config BR2_PACKAGE_XWAYLAND
    bool "xwayland"
    select BR2_PACKAGE_XORGPROTO
    select BR2_PACKAGE_PIXMAN
    select BR2_PACKAGE_XLIB_LIBXKBFILE
    select BR2_PACKAGE_XLIB_XTRANS
    select BR2_PACKAGE_XLIB_LIBXKBFILE
    select BR2_PACKAGE_DBUS
    select BR2_PACKAGE_WAYLAND
    select BR2_PACKAGE_WAYLAND_PROTOCOLS
    select BR2_PACKAGE_LIBDRM
    select BR2_PACKAGE_LIBEPOXY
    select BR2_PACKAGE_XFONT_FONT_UTIL
    select BR2_PACKAGE_XAPP_XKBCOMP
    select BR2_PACKAGE_WAYLANDPP
    select BR2_PACKAGE_XLIB_LIBXFONT2
    select BR2_PACKAGE_XLIB_LIBXCVT
    help
        Run X clients under Wayland.

	    https://xorg.freedesktop.org
```

## package/batocera/emulation-station/Config.in
```kconfig
config BR2_PACKAGE_EMULATION_STATION
        bool "Emulationstation"
	depends on BR2_INSTALL_LIBSTDCPP
	depends on BR2_PACKAGE_SDL
	depends on BR2_PACKAGE_BOOST
	depends on BR2_PACKAGE_ALSA_LIB
	depends on BR2_PACKAGE_HAS_LIBGLES
	select BR2_PACKAGE_FREEIMAGE
	select BR2_PACKAGE_FREETYPE
	select BR2_PACKAGE_EIGEN
	select BR2_PACKAGE_BOOST_FILESYSTEM
	select BR2_PACKAGE_DEJAVU
        help
          A multi emulator frontend.

	  https://github.com/Aloshi/EmulationStation

comment "Emulation station needs a toolchain w/ C++, ALSA, Boost, GLES and SDL"
	depends on !BR2_INSTALL_LIBSTDCPP || !BR2_PACKAGE_SDL || \
		!BR2_PACKAGE_BOOST || !BR2_PACKAGE_ALSA_LIB || \
		!BR2_PACKAGE_HAS_LIBGLES
```

## package/batocera/emulationstation/Config.in
```kconfig
source "package/batocera/emulationstation/batocera-bezel/Config.in"	
source "package/batocera/emulationstation/batocera-emulationstation/Config.in"
source "package/batocera/emulationstation/python-es-scraper/Config.in"
source "package/batocera/emulationstation/recalbox-themes/Config.in"
source "package/batocera/emulationstation/sselph-scraper/Config.in"
```

## package/batocera/emulationstation/batocera-emulationstation-fonts/Config.in
```kconfig
config BR2_PACKAGE_BATOCERA_EMULATIONSTATION_FONTS
    bool "batocera-emulationstation-fonts"
    help
      font required for batocera-emulationstation
```

## package/batocera/emulationstation/batocera-emulationstation/Config.in
```kconfig
config BR2_PACKAGE_BATOCERA_EMULATIONSTATION
        bool "batocera Emulationstation"
	depends on BR2_INSTALL_LIBSTDCPP
	select BR2_PACKAGE_SDL2
	select BR2_PACKAGE_SDL2_MIXER
	select BR2_PACKAGE_ALSA_LIB
	select BR2_PACKAGE_ALSA_UTILS_AMIXER
	depends on (BR2_PACKAGE_HAS_LIBGLES || BR2_PACKAGE_HAS_LIBGL)
	select BR2_PACKAGE_LIBFREEIMAGE
	select BR2_PACKAGE_FREETYPE
	select BR2_PACKAGE_DEJAVU
	select BR2_PACKAGE_OPENSSL
	select BR2_PACKAGE_LIBCURL
	select BR2_PACKAGE_NANUM_FONT
	select BR2_PACKAGE_FPING
	select BR2_PACKAGE_BATOCERA_EMULATIONSTATION_FONTS
	select BR2_PACKAGE_VLC
	select BR2_PACKAGE_RAPIDJSON
	select BR2_PACKAGE_POPPLER
	select BR2_PACKAGE_POPPLER_UTILS
	select BR2_PACKAGE_OPENJPEG # for poppler
	select BR2_PACKAGE_JPEG     # for poppler
	select BR2_PACKAGE_BATOCERA_ES_SYSTEM
    select BR2_PACKAGE_FFMPEG
	select BR2_PACKAGE_FFMPEG4
    select BR2_PACKAGE_FFMPEG_GPL
	select BR2_PACKAGE_FFMPEG_FFPROBE
	select BR2_PACKAGE_FFMPEG_AVRESAMPLE
	select BR2_PACKAGE_FFMPEG_SWSCALE
	select BR2_PACKAGE_FFMPEG_POSTPROC

        help
          A multi emulator frontend.

	  https://github.com/Aloshi/EmulationStation

if BR2_PACKAGE_BATOCERA_EMULATIONSTATION
choice
    prompt "ES version to compile"
    config BR2_PACKAGE_BATOCERA_EMULATIONSTATION_STANDARD
          bool "standard"
    config BR2_PACKAGE_BATOCERA_EMULATIONSTATION_ARCADE
          bool "arcade"
 endchoice
endif

comment "Emulation station 2 needs a toolchain w/ C++"
```

## package/batocera/emulationstation/batocera-es-system/Config.in.host
```kconfig
config BR2_PACKAGE_HOST_BATOCERA_ES_SYSTEM
	bool "host batocera-es-system"
	help
	  Host script to generate es_system.cfg file and the roms folder
```

## package/batocera/emulationstation/batocera-es-web-ui/Config.in
```kconfig
config BR2_PACKAGE_BATOCERA_ES_WEB_UI
        bool "batocera Emulationstation Web UI"
	depends on BR2_PACKAGE_BATOCERA_EMULATIONSTATION

        help
          A modern UI for ES web services
```

## package/batocera/emulationstation/batocera-themes/Config.in
```kconfig
config BR2_PACKAGE_BATOCERA_THEMES
        bool "batocera ES themes"
        help
          Emulationstation themes for batocera.

	  https://github.com/batocera-linux/batocera-themes
```

## package/batocera/emulationstation/es-background-musics/Config.in
```kconfig
config BR2_PACKAGE_ES_BACKGROUND_MUSICS
        bool "es-background-musics"

        help
         Emulationstation background musics
```
