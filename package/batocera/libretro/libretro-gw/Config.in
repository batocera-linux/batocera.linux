## package/batocera/libretro/libretro-gw/Config.in
```kconfig
config BR2_PACKAGE_LIBRETRO_GW
        bool "libretro-gw"
	depends on BR2_PACKAGE_RETROARCH
	depends on BR2_INSTALL_LIBSTDCPP
        help
          A libretro core for Game & Watch simulators

	  http://www.libretro.com

comment "LIBRETRO_GW needs a toolchain w/ C++"
	depends on !BR2_INSTALL_LIBSTDCPP
```

## package/batocera/libretro/libretro-imageviewer/Config.in
```kconfig
config BR2_PACKAGE_LIBRETRO_IMAGEVIEWER
        bool "libretro-imageviewer"
	depends on BR2_PACKAGE_RETROARCH
	depends on BR2_INSTALL_LIBSTDCPP
        help
          A libretro imageviewer core.

	  http://www.libretro.com

comment "LIBRETRO_IMAGEVIEWER needs a toolchain w/ C++"
	depends on !BR2_INSTALL_LIBSTDCPP
```

## package/batocera/libretro/libretro-lutro/Config.in
```kconfig
config BR2_PACKAGE_LIBRETRO_LUTRO
        bool "libretro-lutro"
	depends on BR2_PACKAGE_RETROARCH
	depends on BR2_INSTALL_LIBSTDCPP
        help
          An experimental lua game framework for libretro.

	  http://www.libretro.com

comment "LIBRETRO_LUTRO needs a toolchain w/ C++"
	depends on !BR2_INSTALL_LIBSTDCPP
```

## package/batocera/libretro/libretro-mame2003-plus/Config.in
```kconfig
config BR2_PACKAGE_LIBRETRO_MAME2003_PLUS
        bool "libretro-mame2003-plus"
	depends on BR2_PACKAGE_RETROARCH
	depends on BR2_INSTALL_LIBSTDCPP
        help
          A libretro mame2003+ core for ARM.

	  http://www.libretro.com

comment "LIBRETRO_MAME2003+ needs a toolchain w/ C++"
	depends on !BR2_INSTALL_LIBSTDCPP
```

## package/batocera/libretro/libretro-o2em/Config.in
```kconfig
config BR2_PACKAGE_LIBRETRO_O2EM
        bool "libretro-o2em"
	depends on BR2_PACKAGE_RETROARCH
	depends on BR2_INSTALL_LIBSTDCPP
        help
          A libretro Odyssey 2/VideoPac emulator core.

	  http://www.libretro.com

comment "LIBRETRO_O2EM needs a toolchain w/ C++"
	depends on !BR2_INSTALL_LIBSTDCPP
```

## package/batocera/libretro/libretro-prosystem/Config.in
```kconfig
config BR2_PACKAGE_LIBRETRO_PROSYSTEM
        bool "libretro-prosystem"
	depends on BR2_PACKAGE_RETROARCH
	depends on BR2_INSTALL_LIBSTDCPP
        help
          A libretro ATARI 7800 emulator for ARM.

	  http://www.libretro.com

comment "LIBRETRO_PROSYSTEM needs a toolchain w/ C++"
	depends on !BR2_INSTALL_LIBSTDCPP
```

## package/batocera/libretro/libretro-vecx/Config.in
```kconfig
config BR2_PACKAGE_LIBRETRO_VECX
        bool "libretro-vecx"
	depends on BR2_PACKAGE_RETROARCH
	depends on BR2_INSTALL_LIBSTDCPP
        help
          A libretro Vectrex emulator core for ARM.

	  http://www.libretro.com

comment "LIBRETRO_VECX needs a toolchain w/ C++"
	depends on !BR2_INSTALL_LIBSTDCPP
```

## package/batocera/libretro/libretro-virtualjaguar/Config.in
```kconfig
config BR2_PACKAGE_LIBRETRO_VIRTUALJAGUAR
        bool "libretro-virtualjaguar"
	depends on BR2_PACKAGE_RETROARCH
	depends on BR2_INSTALL_LIBSTDCPP
        help
          A libretro VIRTUALJAGUAR emulator core for ARM.

	  http://www.libretro.com

comment "LIBRETRO_GAMBATTE needs a toolchain w/ C++"
	depends on !BR2_INSTALL_LIBSTDCPP
```

## package/batocera/linapple-pie/Config.in
```kconfig
config BR2_PACKAGE_LINAPPLE_PIE
	bool "LinApple-Pie"
	depends on BR2_INSTALL_LIBSTDCPP
	select BR2_PACKAGE_SDL
	select BR2_PACKAGE_SDL_IMAGE
	select BR2_PACKAGE_SDL_IMAGE_BMP
	select BR2_PACKAGE_SDL_IMAGE_XPM
	select BR2_PACKAGE_LIBCURL
	select BR2_PACKAGE_ZLIB
	select BR2_PACKAGE_LIBZIP
	help
	  Linapple on Raspberry Pi
	  Great thanks to Mark Ormond for fine tuning LinApple and 
	  publishing his work on GitHub

	  https://github.com/dabonetn/linapple-pie

comment "LinApple-pie needs a toolchain w/ C++, and following librarie : sdl, sdl_image (bmp, xpm), curl, zlib and libzip"
	depends on !BR2_INSTALL_LIBSTDCPP || !BR2_PACKAGE_SDL || !BR2_PACKAGE_SDL_IMAGE || !BR2_PACKAGE_SDL_IMAGE_BMP || !BR2_PACKAGE_SDL_IMAGE_XPM || !BR2_PACKAGE_CURL || !BR2_PACKAGE_ZLIB || !BR2_PACKAGE_LIBZIP
```

## package/batocera/looks/adwaita-icon-theme-light/Config.in
```kconfig
config BR2_PACKAGE_ADWAITA_ICON_THEME_LIGHT
	bool "adwaita icon theme light"
	depends on BR2_PACKAGE_LIBGTK2 || BR2_PACKAGE_LIBGTK3
	help
	  Adwaita icon theme light
```

## package/batocera/looks/hypseus-singe-bezels/Config.in
```kconfig
config BR2_PACKAGE_HYPSEUS_SINGE_BEZELS
	bool "hypseus-singe-bezels"
	select BR2_PACKAGE_HYPSEUS_SINGE
	select BR2_PACKAGE_FFMPEG_PYTHON
	help
	  A collection of bezels for various Daphne & Singe based games.
	  
	  https://github.com/Tovarichtch/hypseus_singe_daphne_bezels
```

## package/batocera/looks/lightgun-controllers-art/Config.in
```kconfig
config BR2_PACKAGE_LIGHTGUN_CONTROLLERS_ART
	bool "lightgun-controllers-art"
	help
	  A collection of images for guns bcc
	  
	  https://github.com/batocera-linux/lightgun-controllers-art
```

## package/batocera/mali-t62x-fbdev/Config.in
```kconfig
config BR2_PACKAGE_MALI_T62X_FBDEV
	bool "MALI_T62X_FBDEV"
	depends on BR2_arm
	select BR2_PACKAGE_MALI_OPENGLES_SDK
	select BR2_PACKAGE_HAS_LIBEGL
	select BR2_PACKAGE_HAS_LIBGLES
	help
	  Install the binary user-space components for the ARM Mali Midgard
	  T62X GPU. This package requires a kernel with the ARM Mali Midgard
	  GPU Kernel Drivers enabled.

if BR2_PACKAGE_MALI_T62X_FBDEV

config BR2_PACKAGE_PROVIDES_LIBEGL
	default "mali-t62x-fbdev"

config BR2_PACKAGE_PROVIDES_LIBGLES
	default "mali-t62x-fbdev"

endif

comment "mali-t62x-fbdev"
	depends on !BR2_arm || !BR2_PACKAGE_MALI_OPENGLES_SDK
```

## package/batocera/mali-t62x/Config.in
```kconfig
config BR2_PACKAGE_MALI_T62X
	bool "MALI_T62X"
	depends on BR2_arm
	select BR2_PACKAGE_MALI_OPENGLES_SDK
	select BR2_PACKAGE_HAS_LIBEGL
	select BR2_PACKAGE_HAS_LIBGLES
	help
	  Install the binary user-space components for the ARM Mali Midgard
	  T62X GPU. This package requires a kernel with the ARM Mali Midgard
	  GPU Kernel Drivers enabled.

if BR2_PACKAGE_MALI_T62X

config BR2_PACKAGE_PROVIDES_LIBEGL
	default "mali-t62x"

config BR2_PACKAGE_PROVIDES_LIBGLES
	default "mali-t62x"

endif

comment "mali-t62x"
	depends on !BR2_arm || !BR2_PACKAGE_MALI_OPENGLES_SDK
```

## package/batocera/megatools/Config.in
```kconfig
config BR2_PACKAGE_MEGATOOLS
        bool "megatools"
	select BR2_PACKAGE_OPENSSL
	select BR2_PACKAGE_LIBCURL
        help
          A command line client for Mega.nz

          https://github.com/megous/megatools
```

## package/batocera/network/esp8089/Config.in
```kconfig
comment "esp8089 needs a Linux kernel to be built"
	depends on !BR2_LINUX_KERNEL

config BR2_PACKAGE_ESP8089
	bool "esp8089"
	depends on BR2_LINUX_KERNEL
	help
	  esp8089 wifi driver

	  https://github.com/al177/esp8089
```

## package/batocera/network/qualcomm/pd-mapper/Config.in
```kconfig
config BR2_PACKAGE_PD_MAPPER
	bool "pd-mapper"
	select BR2_PACKAGE_QRTR
	select BR2_PACKAGE_XZ
	help
	  Qualcomm Protection Domain mapper.

	  https://github.com/andersson/pd-mapper
```

## package/batocera/network/qualcomm/qrtr/Config.in
```kconfig
config BR2_PACKAGE_QRTR
	bool "qrtr"
	select BR2_PACKAGE_LINUX_HEADERS
	help
	  Userspace reference for net/qrtr in the Linux kernel.

	  https://github.com/andersson/qrtr
```

## package/batocera/network/qualcomm/rmtfs/Config.in
```kconfig
config BR2_PACKAGE_RMTFS
	bool "rmtfs"
	depends on BR2_PACKAGE_HAS_UDEV # libudev is build dependency
	select BR2_PACKAGE_QRTR
	help
	  Qualcomm Remote Filesystem Service Implementation.

	  https://github.com/andersson/rmtfs

comment "rmtfs requires udev to be enabled"
	depends on !BR2_PACKAGE_HAS_UDEV
```

## package/batocera/network/qualcomm/tqftpserv/Config.in
```kconfig
config BR2_PACKAGE_TQFTPSERV
	bool "tqftpserv"
	select BR2_PACKAGE_QRTR
	select BR2_PACKAGE_ZSTD
	help
	  Trivial File Transfer Protocol server over AF_QIPCRTR.

	  https://github.com/andersson/tqftpserv
```

## package/batocera/network/rk915/Config.in
```kconfig
comment "rk915 needs a Linux kernel to be built"
	depends on !BR2_LINUX_KERNEL

config BR2_PACKAGE_RK915
	bool "rk915"
	depends on BR2_LINUX_KERNEL
	help
	  Rockchip RK915 SDIO WiFi driver, ported from BSP kernel 4.4
	  to mainline Linux 6.x. The RK915 is an internal 2.4 GHz
	  802.11 b/g/n WiFi chip found in some Anbernic/eeclone handhelds
	  (e.g. R36 Ultra).

	  Requires firmware files rk915_fw.bin and rk915_patch.bin
	  in /lib/firmware/.

	  The SDIO controller must be configured in the device tree
	  with mmc-pwrseq-simple for power sequencing.
```

## package/batocera/network/rtl8188fu/Config.in
```kconfig
comment "rtl8188fu needs a Linux kernel to be built"
	depends on !BR2_LINUX_KERNEL

config BR2_PACKAGE_RTL8188FU
	bool "rtl8188fu"
	depends on BR2_LINUX_KERNEL
	help
	  Linux Driver for USB WiFi Adapters that are based on the RTL8188FU chipsets.

	  https://github.com/kelebek333/rtl8188fu
```

## package/batocera/network/rtl8192eu/Config.in
```kconfig
comment "rtl8192eu needs a Linux kernel to be built"
	depends on !BR2_LINUX_KERNEL

config BR2_PACKAGE_RTL8192EU
	bool "rtl8192eu"
	depends on BR2_LINUX_KERNEL
	help
	  rtl8192eu wifi driver

	  https://github.com/Mange/rtl8192eu-linux-driver
```

## package/batocera/network/rtl8723ds/Config.in
```kconfig
comment "rtl8723ds needs a Linux kernel to be built"
	depends on !BR2_LINUX_KERNEL

config BR2_PACKAGE_RTL8723DS
	bool "rtl8723ds"
	depends on BR2_LINUX_KERNEL
	help
	  rtl8723ds wifi driver

	  https://github.com/lwfinger/rtl8732ds
```

## package/batocera/network/rtl8812au/Config.in
```kconfig
comment "rtl8812au needs a Linux kernel to be built"
	depends on !BR2_LINUX_KERNEL

config BR2_PACKAGE_RTL8812AU
	bool "rtl8812au"
	depends on BR2_LINUX_KERNEL
	help
	  Linux Driver for USB WiFi Adapters that are based on
	  the RTL8812AU Chipset. Use for Kernels below 5.4.

	  https://github.com/morrownr/8812au-20210820
```
