## package/batocera/ports/dhewm3/eldoom/Config.in
```kconfig
config BR2_PACKAGE_ELDOOM
    bool "eldoom"
    select BR2_PACKAGE_LIBCURL
    select BR2_PACKAGE_LIBJPEG
    select BR2_PACKAGE_LIBOGG
    select BR2_PACKAGE_LIBVORBIS
    select BR2_PACKAGE_OPENAL
    select BR2_PACKAGE_SDL2
    select BR2_PACKAGE_ZLIB
    help
      Eldoom, a mod for Dhewm3.

      https://github.com/dhewm/dhewm3-sdk/tree/eldoom
```

## package/batocera/ports/dhewm3/fitz/Config.in
```kconfig
config BR2_PACKAGE_FITZ
    bool "fitz"
    select BR2_PACKAGE_LIBCURL
    select BR2_PACKAGE_LIBJPEG
    select BR2_PACKAGE_LIBOGG
    select BR2_PACKAGE_LIBVORBIS
    select BR2_PACKAGE_OPENAL
    select BR2_PACKAGE_SDL2
    select BR2_PACKAGE_ZLIB
    help
      Fitz, a mod for Dhewm3.

      https://github.com/dhewm/dhewm3-sdk/tree/fitz
```

## package/batocera/ports/dhewm3/rivensin/Config.in
```kconfig
config BR2_PACKAGE_RIVENSIN
    bool "rivensin"
    select BR2_PACKAGE_LIBCURL
    select BR2_PACKAGE_LIBJPEG
    select BR2_PACKAGE_LIBOGG
    select BR2_PACKAGE_LIBVORBIS
    select BR2_PACKAGE_OPENAL
    select BR2_PACKAGE_SDL2
    select BR2_PACKAGE_ZLIB
    help
      Rivensin, a mod for Dhewm3.

      https://github.com/dhewm/dhewm3-sdk/tree/rivensin
```

## package/batocera/ports/dhewm3/sikkmod/Config.in
```kconfig
config BR2_PACKAGE_SIKKMOD
    bool "sikkmod"
    select BR2_PACKAGE_LIBCURL
    select BR2_PACKAGE_LIBJPEG
    select BR2_PACKAGE_LIBOGG
    select BR2_PACKAGE_LIBVORBIS
    select BR2_PACKAGE_OPENAL
    select BR2_PACKAGE_SDL2
    select BR2_PACKAGE_ZLIB
    help
      Sikkmod, a mod for Dhewm3.

      https://github.com/dhewm/dhewm3-sdk/tree/sikkmod
```

## package/batocera/ports/dxx-rebirth/Config.in
```kconfig
config BR2_PACKAGE_DXX_REBIRTH
	bool "dxx-rebirth"
	select BR2_PACKAGE_HOST_SCONS
	select BR2_PACKAGE_LIBPNG
	select BR2_PACKAGE_PHYSFS
	select BR2_PACKAGE_SDL2
	select BR2_PACKAGE_SDL2_IMAGE
	select BR2_PACKAGE_SDL2_MIXER
	select BR2_PACKAGE_LIBGLEW    if BR2_PACKAGE_XORG7 && BR2_PACKAGE_HAS_LIBGL
	select BR2_PACKAGE_LIBGLU     if BR2_PACKAGE_HAS_LIBGL
	help
	  dxx-rebirth is an opensource port of Descent 1 & 2

	  https://github.com/dxx-rebirth/dxx-rebirth
```

## package/batocera/ports/ecwolf/Config.in
```kconfig
config BR2_PACKAGE_ECWOLF
    bool "ecwolf"
    select BR2_PACKAGE_HOST_ECWOLF
    select BR2_PACKAGE_SDL2
    select BR2_PACKAGE_SDL2_NET
    select BR2_PACKAGE_SDL2_MIXER
    select BR2_PACKAGE_ZLIB
    select BR2_PACKAGE_BZIP2
    select BR2_PACKAGE_LIBJPEG
    select BR2_PACKAGE_FLUIDSYNTH
    select BR2_PACKAGE_LIBMODPLUG
    select BR2_PACKAGE_OPUSFILE
    select BR2_PACKAGE_FLAC
    select BR2_PACKAGE_LIBVORBIS
    help
      ECWolf is a port of the Wolfenstein 3D engine based of Wolf4SDL.

	    http://maniacsvault.net/ecwolf/
```

## package/batocera/ports/ecwolf/Config.in.host
```kconfig
config BR2_PACKAGE_HOST_ECWOLF
	bool "host ecwolf tools"
	select BR2_PACKAGE_HOST_ZLIB
	select BR2_PACKAGE_HOST_BZIP2
	help
	  This package is required for building ecwolf.
```

## package/batocera/ports/eduke32/Config.in
```kconfig
config BR2_PACKAGE_EDUKE32
    bool "eduke32"
    depends on BR2_INSTALL_LIBSTDCPP
    select BR2_PACKAGE_SDL2
    select BR2_PACKAGE_FLAC
    select BR2_PACKAGE_LIBVPX

    help
      EDuke32 is a Build Engine source port for playing games like Duke Nukem 3D and Ion Fury

      https://www.eduke32.com/
```

## package/batocera/ports/etlegacy/Config.in
```kconfig
config BR2_PACKAGE_ETLEGACY
	bool "etlegacy"
	select BR2_PACKAGE_FREETYPE
	select BR2_PACKAGE_LIBCURL
	select BR2_PACKAGE_LIBGLEW
	select BR2_PACKAGE_LIBGLU
	select BR2_PACKAGE_LIBPNG
	select BR2_PACKAGE_LIBTHEORA
	select BR2_PACKAGE_LIBVORBIS
	select BR2_PACKAGE_LUA
	select BR2_PACKAGE_OPENAL
	select BR2_PACKAGE_OPENSSL
	select BR2_PACKAGE_SDL2
	help
	  ET: Legacy is an open source project based on the code of Wolfenstein: Enemy Territory
	  which was released in 2010 under the terms of the GPLv3 license.

	  www.etlegacy.com
```

## package/batocera/ports/fallout1-ce/Config.in
```kconfig
config BR2_PACKAGE_FALLOUT1_CE
	bool "fallout1-ce"
	select BR2_PACKAGE_SDL2

	help
	  Fallout 1 CE - Open Source Fallout 1 engine

	  https://github.com/alexbatalov/fallout1-ce
```

## package/batocera/ports/fheroes2/Config.in
```kconfig
config BR2_PACKAGE_FHEROES2
	bool "fheroes2"
	select BR2_PACKAGE_SDL2
	select BR2_PACKAGE_SDL2_IMAGE

	help
	  Free Heroes of Might and Magic 2.

	  https://github.com/ihhub/fheroes2
```

## package/batocera/ports/gzdoom/Config.in
```kconfig
config BR2_PACKAGE_GZDOOM
    bool "gzdoom"
    select BR2_PACKAGE_HOST_GZDOOM
    select BR2_PACKAGE_SDL2
    select BR2_PACKAGE_SDL2_NET
    select BR2_PACKAGE_SDL2_MIXER
    select BR2_PACKAGE_LIBJPEG
    select BR2_PACKAGE_LIBGL
    select BR2_PACKAGE_OPENAL
    select BR2_PACKAGE_ZMUSIC
    select BR2_PACKAGE_LIBVPX
    select BR2_PACKAGE_WEBP
    select BR2_PACKAGE_WEBP_DEMUX
    select BR2_PACKAGE_WEBP_MUX
    help
      GZDoom is a 3D-accelerated Doom source port based on ZDoom.

	    https://zdoom.org
```

## package/batocera/ports/gzdoom/Config.in.host
```kconfig
config BR2_PACKAGE_HOST_GZDOOM
	bool "host gzdoom tools"
	select BR2_PACKAGE_HOST_ZLIB
	select BR2_PACKAGE_HOST_BZIP2
	help
	  This package is required for building gzdoom.
```

## package/batocera/ports/hcl/Config.in
```kconfig
config BR2_PACKAGE_HCL
	bool "hcl"
	select BR2_PACKAGE_SDL2
	select BR2_PACKAGE_SDL2_MIXER
	depends on BR2_INSTALL_LIBSTDCPP
	help
	  Hydra Castle Labyrinth is a platform game with some old school action. Its also reminiscent of games of the 16 bit era.

	  http://ptitseb.github.io/hydracastlelabyrinth

comment "BR2_PACKAGE_HCL needs a toolchain w/ C++"
	depends on !BR2_INSTALL_LIBSTDCPP
```

## package/batocera/ports/hurrican/Config.in
```kconfig
config BR2_PACKAGE_HURRICAN
	bool "hurrican"
	select BR2_PACKAGE_SDL2
	select BR2_PACKAGE_SDL2_MIXER
	select BR2_PACKAGE_SDL2_IMAGE
	select BR2_PACKAGE_LIBEPOXY
	depends on BR2_INSTALL_LIBSTDCPP
	help
	 A fork of Hurrican, freeware jump and shoot game created by Poke53280,
	 with SDL2 enabled by default, support for libopenmpt and CRT simulation.

	  https://github.com/drfiemost/Hurrican

comment "BR2_PACKAGE_HURRICAN needs a toolchain w/ C++"
	depends on !BR2_INSTALL_LIBSTDCPP
```

## package/batocera/ports/ionfury/Config.in
```kconfig
config BR2_PACKAGE_IONFURY
    bool "ionfury"
    depends on BR2_INSTALL_LIBSTDCPP
    select BR2_PACKAGE_SDL2
    select BR2_PACKAGE_FLAC
    select BR2_PACKAGE_LIBVPX

    help
      Ion Fury is a new Build Engine game from the creators of the EDuke32 source port

      https://www.eduke32.com/
```

## package/batocera/ports/ioquake3/Config.in
```kconfig
config BR2_PACKAGE_IOQUAKE3
    bool "ioquake3"
    select BR2_PACKAGE_LIBCURL
    select BR2_PACKAGE_LIBOGG
    select BR2_PACKAGE_LIBVORBIS
    select BR2_PACKAGE_LIBZLIB
    select BR2_PACKAGE_OPENAL
    select BR2_PACKAGE_OPUS
    select BR2_PACKAGE_SDL2
    select BR2_PACKAGE_SDL2_NET
    help
      The ioquake3 community effort to continue supporting/developing id's Quake III Arena.
      
      https://www.ioquake3.org/
```

## package/batocera/ports/iortcw/Config.in
```kconfig
config BR2_PACKAGE_IORTCW
    bool "iortcw"
    select BR2_PACKAGE_SDL2
    select BR2_PACKAGE_OPENAL
    help
      Return to Castle Wolfenstein port using IOQuake3 functionality.

      https://github.com/iortcw/iortcw
```

## package/batocera/ports/jazz2-native/Config.in
```kconfig
config BR2_PACKAGE_JAZZ2_NATIVE
	bool "jazz2-native"
	select BR2_PACKAGE_LIBGLEW        if BR2_PACKAGE_XORG7 && BR2_PACKAGE_HAS_LIBGL
	select BR2_PACKAGE_SDL2
	select BR2_PACKAGE_OPENAL
	select BR2_PACKAGE_LIBOPENMPT
	select BR2_PACKAGE_ZLIB
	help
	  Jazz² Resurrection: Native C++ reimplementation of Jazz Jackrabbit 2.

	  https://github.com/deathkiller/jazz2-native
```

## package/batocera/ports/openjk/Config.in
```kconfig
config BR2_PACKAGE_OPENJK
	bool "openjk"
	select BR2_PACKAGE_LIBJPEG_BATO
	select BR2_PACKAGE_LIBPNG
	select BR2_PACKAGE_SDL2
	select BR2_PACKAGE_ZLIB
	help
	  Community effort to maintain and improve Jedi Academy (SP & MP)
	  and Jedi Outcast (SP only) released by Raven Software.

	  https://github.com/JACoders/OpenJK
```

## package/batocera/ports/openjkdf2/Config.in
```kconfig
config BR2_PACKAGE_OPENJKDF2
	bool "openjkdf2"
	select BR2_PACKAGE_GAMENETWORKINGSOCKETS
	select BR2_PACKAGE_OPENAL
	select BR2_PACKAGE_SDL2
	help
	  A cross-platform reimplementation of
	  Jedi Knight Dark Forces 2 written in C.

	  https://github.com/shinyquagsire23/OpenJKDF2
```

## package/batocera/ports/prototype/Config.in
```kconfig
config BR2_PACKAGE_PROTOTYPE
	bool "Prototype"
	depends on BR2_PACKAGE_SDL2
	depends on BR2_PACKAGE_SDL2_MIXER
	depends on BR2_PACKAGE_SDL2_IMAGE
	depends on BR2_PACKAGE_GL4ES
	depends on BR2_PACKAGE_GLU

	depends on BR2_INSTALL_LIBSTDCPP
	help
	 This is ProtoType, an RType remake from Dark Castle Software.

	  http://ptitseb.github.io/prototype

comment "BR2_PACKAGE_PROTOTYPE needs a toolchain w/ C++"
	depends on !BR2_INSTALL_LIBSTDCPP
```

## package/batocera/ports/raze/Config.in
```kconfig
config BR2_PACKAGE_RAZE
    bool "raze"
    depends on BR2_INSTALL_LIBSTDCPP
    select BR2_PACKAGE_SDL2
    select BR2_PACKAGE_SDL2_NET
    select BR2_PACKAGE_SDL2_MIXER
    select BR2_PACKAGE_LIBJPEG
    select BR2_PACKAGE_LIBGL
    select BR2_PACKAGE_OPENAL
    select BR2_PACKAGE_ZMUSIC
    help
      Raze is a source port, powered by GZDoom tech, for playing classic Build Engine games like Duke Nukem 3D.

      https://raze.zdoom.org/about
```

## package/batocera/ports/raze/Config.in.host
```kconfig
config BR2_PACKAGE_HOST_RAZE
	bool "host raze tools"
	select BR2_PACKAGE_HOST_BZIP2
	help
	  This package is required for building raze.
```

## package/batocera/ports/sonic-mania/Config.in
```kconfig
config BR2_PACKAGE_SONIC_MANIA
	bool "sonic-mania"
	select BR2_PACKAGE_LIBGLU
	select BR2_PACKAGE_LIBGLEW
	select BR2_PACKAGE_LIBGLFW
	select BR2_PACKAGE_LIBOGG
	select BR2_PACKAGE_LIBTHEORA
	select BR2_PACKAGE_PORTAUDIO
	select BR2_PACKAGE_PORTAUDIO_ALSA
	help
	  A complete decompilation of Sonic Mania (2017).

	  https://github.com/Rubberduckycooly/Sonic-Mania-Decompilation
```
