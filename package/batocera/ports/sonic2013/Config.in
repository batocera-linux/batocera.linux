## package/batocera/ports/sonic2013/Config.in
```kconfig
config BR2_PACKAGE_SONIC2013
	bool "sonic2013"
	select BR2_PACKAGE_SDL2
	select BR2_PACKAGE_SDL2_NET
	select BR2_PACKAGE_SDL2_MIXER
	select BR2_PACKAGE_LIBOGG
	select BR2_PACKAGE_LIBVORBIS
	select BR2_PACKAGE_LIBGLEW    if BR2_PACKAGE_XORG7 && BR2_PACKAGE_HAS_LIBGL
    help
      The Sonic 2013 decompilation is for the Android & iOS ports of Sonic 1 and 2

	  https://github.com/Rubberduckycooly/Sonic-1-2-2013-Decompilation
```

## package/batocera/ports/sonic3-air/Config.in
```kconfig
config BR2_PACKAGE_SONIC3_AIR
	bool "sonic3-air"
	select BR2_PACKAGE_ALSA_LIB
	select BR2_PACKAGE_PULSEAUDIO
	select BR2_PACKAGE_LIBCURL
	select BR2_PACKAGE_LIBGLU
	select BR2_PACKAGE_XLIB_LIBXCOMPOSITE
	select BR2_PACKAGE_XLIB_LIBXXF86VM
	select BR2_PACKAGE_ZLIB
	help
	  Sonic 3 A.I.R. (Angel Island Revisited) and the Oxygen Engine.

	  https://github.com/Eukaryot/sonic3air
```

## package/batocera/ports/soniccd/Config.in
```kconfig
config BR2_PACKAGE_SONICCD
	bool "soniccd"
	select BR2_PACKAGE_SDL2
	select BR2_PACKAGE_SDL2_NET
	select BR2_PACKAGE_SDL2_MIXER
	select BR2_PACKAGE_LIBOGG
	select BR2_PACKAGE_LIBVORBIS
	select BR2_PACKAGE_LIBTHEORA
	select BR2_PACKAGE_LIBGLEW    if BR2_PACKAGE_XORG7 && BR2_PACKAGE_HAS_LIBGL
    help
      The Sonic CD 2011 decompilation is for the Android, iOS, & Steam ports of Sonic 1 and 2

	  https://github.com/Rubberduckycooly/Sonic-CD-11-Decompilation
```

## package/batocera/ports/stuntcar/Config.in
```kconfig
config BR2_PACKAGE_STUNTCAR
	bool "StuntCar"
	depends on BR2_PACKAGE_SDL2
	depends on BR2_PACKAGE_SDL2_MIXER
	depends on BR2_PACKAGE_SDL2_TTF
	depends on BR2_PACKAGE_OPENAL
	depends on BR2_PACKAGE_GL4ES
	depends on BR2_PACKAGE_GLU
	depends on BR2_INSTALL_LIBSTDCPP
	help
	 This is a port of the old Stunt Car Racer from the AtariST/Amiga time.

	  http://ptitseb.github.io/stuntcarremake

comment "BR2_PACKAGE_STUNTCAR needs a toolchain w/ C++"
	depends on !BR2_INSTALL_LIBSTDCPP
```

## package/batocera/ports/taradino/Config.in
```kconfig
config BR2_PACKAGE_TARADINO
    bool "taradino"
    select BR2_PACKAGE_SDL2
    select BR2_PACKAGE_SDL2_MIXER
    help
      SDL2 port of Rise of the Triad.
      
      https://github.com/fabiangreffrath/taradino
```

## package/batocera/ports/theforceengine/Config.in
```kconfig
config BR2_PACKAGE_THEFORCEENGINE
    bool "theforceengine"
    select BR2_PACKAGE_LIBGLEW
    select BR2_PACKAGE_SDL2
    select BR2_PACKAGE_SDL2_IMAGE
    help
      Modern "Jedi Engine" replacement supporting Dark Forces, mods,
      and in the future Outlaws.
      
      https://theforceengine.github.io/
```

## package/batocera/ports/tr1x/Config.in
```kconfig
config BR2_PACKAGE_TR1X
	bool "tr1x"
	select BR2_PACKAGE_FFMPEG
	select BR2_PACKAGE_LIBGLEW
	select BR2_PACKAGE_PCRE2
	select BR2_PACKAGE_SDL2
	select BR2_PACKAGE_UTHASH
	help
	  Open source re-implementation of Tomb Raider I 
	  along with additional enhancements and bugfixes.

	  https://github.com/LostArtefacts/TRX
```

## package/batocera/ports/tr2x/Config.in
```kconfig
config BR2_PACKAGE_TR2X
	bool "tr2x"
	select BR2_PACKAGE_FFMEPG
	select BR2_PACKAGE_LIBGLEW
	select BR2_PACKAGE_PCRE2
	select BR2_PACKAGE_SDL2
	select BR2_PACKAGE_UTHASH
	help
	  Open source re-implementation of Tomb Raider II 
	  along with additional enhancements and bugfixes.

	  https://github.com/LostArtefacts/TRX
```

## package/batocera/ports/trx/Config.in
```kconfig
config BR2_PACKAGE_TRX
	bool "trx"
	select BR2_PACKAGE_FFMPEG
	select BR2_PACKAGE_LIBGLEW
	select BR2_PACKAGE_PCRE2
	select BR2_PACKAGE_SDL2
	select BR2_PACKAGE_UTHASH
	select BR2_PACKAGE_LUA
	help
	  Open source re-implementation of Tomb Raider I,
	  Tomb Raider II and Tomb Raider III, along with 
	  additional enhancements and bugfixes.

	  https://github.com/LostArtefacts/TRX
```

## package/batocera/ports/tyrian/Config.in
```kconfig
config BR2_PACKAGE_TYRIAN
	bool "tyrian"
	depends on BR2_PACKAGE_SDL2
	depends on BR2_PACKAGE_SDL2_NET
	help
	  OpenTyrian is an open-source port of the DOS game Tyrian.

          https://github.com/opentyrian/opentyrian
```

## package/batocera/ports/uqm/Config.in
```kconfig
config BR2_PACKAGE_UQM
    bool "uqm"
    depends on !BR2_STATIC_LIBS # sdl2
	select BR2_PACKAGE_SDL2
    select BR2_PACKAGE_LIBPNG
    select BR2_PACKAGE_LIBVORBIS
    select BR2_PACKAGE_LIBZIP
    help
        The Ur-Quan Masters

        https://sc2.sourceforge.net/
```

## package/batocera/ports/vcmi/Config.in
```kconfig
config BR2_PACKAGE_VCMI
	bool "vcmi"
	select BR2_PACKAGE_SDL2
	select BR2_PACKAGE_SDL2_IMAGE
	select BR2_PACKAGE_SDL2_MIXER
	select BR2_PACKAGE_SDL2_TTF
	select BR2_PACKAGE_FFMPEG
	select BR2_PACKAGE_TBB
	select BR2_PACKAGE_BOOST
	select BR2_PACKAGE_BOOST_DATE_TIME
	select BR2_PACKAGE_BOOST_FILESYSTEM
	select BR2_PACKAGE_BOOST_LOCALE
	select BR2_PACKAGE_BOOST_PROGRAM_OPTIONS
	select BR2_PACKAGE_BOOST_THREAD
	select BR2_PACKAGE_BATOCERA_QT6
	help
	  Heroes of Might and Magic 3 engine.

	  https://vcmi.eu
```

## package/batocera/ports/vkquake/Config.in
```kconfig
config BR2_PACKAGE_VKQUAKE
	bool "vkquake"
	select BR2_PACKAGE_ALSA_LIB
	select BR2_PACKAGE_FLAC
	select BR2_PACKAGE_GLSLANG
	select BR2_PACKAGE_LIBVORBIS
	select BR2_PACKAGE_MPG123
	select BR2_PACKAGE_OPUS
	select BR2_PACKAGE_SDL2
	select BR2_PACKAGE_SPIRV_TOOLS
	select BR2_PACKAGE_VULKAN_HEADERS
	select BR2_PACKAGE_VULKAN_LOADER
	help
	  Vulkan Quake port based on QuakeSpasm.

	  https://github.com/Novum/vkQuake
```

## package/batocera/ports/vkquake2/Config.in
```kconfig
config BR2_PACKAGE_VKQUAKE2
    bool "vkquake2"
    select BR2_PACKAGE_ALSA_LIB
    select BR2_PACKAGE_GLSLANG
    select BR2_PACKAGE_LIBGLU
    select BR2_PACKAGE_VULKAN_HEADERS
    select BR2_PACKAGE_VULKAN_LOADER
    select BR2_PACKAGE_XLIB_LIBXXF86DGA
    help
      id Software's Quake 2 v3.21 with mission packs and Vulkan support.
      
      https://github.com/kondrak/vkQuake2
```

## package/batocera/ports/vkquake3/Config.in
```kconfig
config BR2_PACKAGE_VKQUAKE3
    bool "vkquake3"
    select BR2_PACKAGE_GL4ES    if (!BR2_PACKAGE_HAS_LIBGL) && BR2_PACKAGE_HAS_LIBGLES
    select BR2_PACKAGE_GLSLANG
    select BR2_PACKAGE_SDL2
    select BR2_PACKAGE_SDL2_NET
    select BR2_PACKAGE_VULKAN_HEADERS
    select BR2_PACKAGE_VULKAN_LOADER
    help
      Based on ioq3 with a vulkan based modular render back end
      which originally from https://github.com/kennyalive/Quake-III-Arena-Kenny-Edition.
      
      https://github.com/suijingfeng/vkQuake3
```

## package/batocera/ports/xash3d/hlsdk-xash3d-dmc/Config.in
```kconfig
config BR2_PACKAGE_HLSDK_XASH3D_DMC
	bool "Xash3D-FWGS Support Libraries for Half-Life: Deathmatch Classic"
	depends on BR2_INSTALL_LIBSTDCPP
    select BR2_PACKAGE_SDL2
    select BR2_PACKAGE_SDL2_MIXER
	select BR2_PACKAGE_SDL2_IMAGE
    select BR2_PACKAGE_SDL2_TTF
	select BR2_PACKAGE_LIBSODIUM

	help
	  Half-Life SDK for Xash3D & GoldSource.

	  Includes client and server libraries needed to run Half-Life: Deathmatch Classic with Xash3D.

	  https://github.com/FWGS/hlsdk-xash3d/tree/dmc
```

## package/batocera/ports/xash3d/hlsdk-xash3d-opfor/Config.in
```kconfig
config BR2_PACKAGE_HLSDK_XASH3D_OPFOR
	bool "Xash3D-FWGS Support Libraries for Half-Life: Opposing Force"
	depends on BR2_INSTALL_LIBSTDCPP
    select BR2_PACKAGE_SDL2
    select BR2_PACKAGE_SDL2_MIXER
	select BR2_PACKAGE_SDL2_IMAGE
    select BR2_PACKAGE_SDL2_TTF
	select BR2_PACKAGE_LIBSODIUM

	help
	  Half-Life SDK for Xash3D & GoldSource.

	  Includes client and server libraries needed to run Half-Life: Opposing Force with Xash3D.

	  https://github.com/FWGS/hlsdk-xash3d/tree/opfor
```

## package/batocera/ports/xash3d/hlsdk-xash3d/Config.in
```kconfig
config BR2_PACKAGE_HLSDK_XASH3D
	bool "Xash3D-FWGS Support Libraries for Half-Life"
	depends on BR2_INSTALL_LIBSTDCPP
    select BR2_PACKAGE_SDL2
    select BR2_PACKAGE_SDL2_MIXER
	select BR2_PACKAGE_SDL2_IMAGE
    select BR2_PACKAGE_SDL2_TTF
	select BR2_PACKAGE_LIBSODIUM

	help
	  Half-Life SDK for Xash3D & GoldSource.

	  Includes client and server libraries needed to run Half-Life with Xash3D.

	  Provides support for several Half-Life-based mods, including the ones listed here:

	  https://github.com/FWGS/hlsdk-xash3d/blob/mobile_hacks/dlls/moddef.h

	  https://github.com/FWGS/hlsdk-xash3d
```

## package/batocera/ports/xash3d/xash3d-fwgs/Config.in
```kconfig
config BR2_PACKAGE_XASH3D_FWGS
	bool "xash3d-fwgs"
	select BR2_PACKAGE_SDL2
	select BR2_PACKAGE_SDL2_MIXER
    select BR2_PACKAGE_SDL2_IMAGE
	select BR2_PACKAGE_SDL2_TTF
	select BR2_PACKAGE_FREETYPE
	select BR2_PACKAGE_FONTCONFIG
	select BR2_PACKAGE_HLSDK_XASH3D
	select BR2_PACKAGE_HLSDK_XASH3D_DMC
	select BR2_PACKAGE_HLSDK_XASH3D_OPFOR
	depends on BR2_INSTALL_LIBSTDCPP
	help
	  Half-Life 1 Engine.

	  https://github.com/FWGS/xash3d-fwgs
```

## package/batocera/ports/yquake2/Config.in
```kconfig
config BR2_PACKAGE_YQUAKE2
    bool "yquake2"
    depends on BR2_PACKAGE_BATOCERA_HAS_SDL
    help
      Quake II port, focused on authenticity to the original.

      https://www.yamagi.org/quake2/
```

## package/batocera/ports/yquake2/yquake2-rogue/Config.in
```kconfig
config BR2_PACKAGE_YQUAKE2_ROGUE
    bool "yquake2-rogue"
    depends on BR2_PACKAGE_YQUAKE2
    help
      Mission Pack 2 - Ground Zero, for Yamagi Quake 2 port.

      https://www.yamagi.org/quake2/
```

## package/batocera/ports/yquake2/yquake2-xatrix/Config.in
```kconfig
config BR2_PACKAGE_YQUAKE2_XATRIX
    bool "yquake2-xatrix"
    depends on BR2_PACKAGE_YQUAKE2
    help
      Mission Pack 1 - The Reckoning, for Yamagi Quake 2 port.

      https://www.yamagi.org/quake2/
```

## package/batocera/ports/yquake2/yquake2-zaero/Config.in
```kconfig
config BR2_PACKAGE_YQUAKE2_ZAERO
    bool "yquake2-zaero"
    depends on BR2_PACKAGE_YQUAKE2
    help
      Unofficial Mission Pack "Zaero", for Yamagi Quake 2 port.

      https://www.yamagi.org/quake2/
```

## package/batocera/python-autobreadcrumbs/Config.in
```kconfig
config BR2_PACKAGE_PYTHON_AUTOBREADCRUMBS
	bool "python-autobreadcrumbs"
	select BR2_PACKAGE_PYTHON_UNICODEDATA if BR2_PACKAGE_PYTHON
	select BR2_PACKAGE_PYTHON_PYEXPAT if BR2_PACKAGE_PYTHON
	select BR2_PACKAGE_PYTHON3_UNICODEDATA if BR2_PACKAGE_PYTHON3
	select BR2_PACKAGE_PYTHON3_PYEXPAT if BR2_PACKAGE_PYTHON3
	help
	 https://pypi.python.org/pypi/autobreadcrumbs
```

## package/batocera/python-es-scraper/Config.in
```kconfig
config BR2_PACKAGE_PYTHON_ES_SCRAPER
	bool "python-es-scraper"
	depends on BR2_PACKAGE_PYTHON
	help
		Scrapper for emulationstation in commandline
```
