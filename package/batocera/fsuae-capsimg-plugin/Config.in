## package/batocera/gpu/mali-bifrost/Config.in
```kconfig
config BR2_PACKAGE_MALI_BIFROST
	bool "MALI_BIFROST_LIB"
	depends on BR2_arm
	select BR2_PACKAGE_HAS_LIBEGL
	select BR2_PACKAGE_HAS_LIBGLES
	select BR2_PACKAGE_WAYLAND

if BR2_PACKAGE_MALI_BIFROST

config BR2_PACKAGE_PROVIDES_LIBEGL
	default "mali-bifrost"

config BR2_PACKAGE_PROVIDES_LIBGLES
	default "mali-bifrost"

endif

comment "mali-bifrost"
```

## package/batocera/gpu/mali-g31-gbm/Config.in
```kconfig
config BR2_PACKAGE_MALI_G31_GBM
	bool "mali-g31-gbm"
	depends on BR2_arm || BR2_aarch64
	select BR2_PACKAGE_HAS_LIBEGL
	select BR2_PACKAGE_HAS_LIBGLES
	select BR2_PACKAGE_HAS_LIBMALI

if BR2_PACKAGE_MALI_G31_GBM

config BR2_PACKAGE_PROVIDES_LIBEGL
	default "mali-g31-gbm"

config BR2_PACKAGE_PROVIDES_LIBGLES
	default "mali-g31-gbm"

config BR2_PACKAGE_PROVIDES_LIBMALI
	default "mali-g31-gbm"

endif

comment "mali-g31-gbm"
```

## package/batocera/gpu/mali-g31/Config.in
```kconfig
config BR2_PACKAGE_MALI_G31
	bool "mali-g31"
	depends on BR2_arm || BR2_aarch64
	select BR2_PACKAGE_HAS_LIBEGL
	select BR2_PACKAGE_HAS_LIBGLES
	select BR2_PACKAGE_HAS_LIBMALI
	select BR2_PACKAGE_MALI_BIFROST_MODULE

if BR2_PACKAGE_MALI_G31

config BR2_PACKAGE_PROVIDES_LIBEGL
	default "mali-g31"

config BR2_PACKAGE_PROVIDES_LIBGLES
	default "mali-g31"

config BR2_PACKAGE_PROVIDES_LIBMALI
	default "mali-g31"

endif

comment "mali-g31"
```
