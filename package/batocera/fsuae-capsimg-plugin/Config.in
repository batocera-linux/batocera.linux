## package/batocera/fsuae-capsimg-plugin/Config.in
```kconfig
config BR2_PACKAGE_FSUAE_CAPSIMG_PLUGIN
        bool "fsuae-capsimg-plugin"
        help
          A fsuae emulator plugin
```

## package/batocera/gpsp/Config.in
```kconfig
config BR2_PACKAGE_GPSP
	depends on BR2_PACKAGE_SDL
	depends on BR2_PACKAGE_RPI_USERLAND
        bool "gpsp"
        help
          A Gameboy Advance emulator.

comment "gpsp depends on SDL"
	depends on !BR2_PACKAGE_SDL || !BR2_PACKAGE_RPI_USERLAND
```

## package/batocera/gpu-aml-t8xx/Config.in
```kconfig
config BR2_PACKAGE_GPU_AML_T8XX
	bool "amlogic t8xx gpu driver"
	depends on BR2_LINUX_KERNEL
```

## package/batocera/gpu-aml/Config.in
```kconfig
config BR2_PACKAGE_GPU_AML
	bool "amlogic gpu driver"
	depends on BR2_LINUX_KERNEL

config BR2_PACKAGE_GPU_AML_STANDALONE
	bool "standalone kernel module"
	depends on BR2_PACKAGE_GPU_AML
	help
	  compile ko directly

config BR2_PACKAGE_GPU_AML_UMP
	bool "enable ump"
	depends on BR2_PACKAGE_GPU_AML
	help
	  enable ump on standalone ko

config BR2_PACKAGE_GPU_AML_MALI_DRM
	bool "enable mali_drm"
	depends on BR2_PACKAGE_GPU_AML
	help
	  build mali_drm.ko

config BR2_PACKAGE_GPU_AML_MALI_DMA_SHARED_BUFFER
	bool "enable mali dma shared buffer"
	depends on BR2_PACKAGE_GPU_AML
	help
	  enable shared buffer
```

## package/batocera/gpu/Config.in
```kconfig
source "package/batocera/gpu/android-headers/Config.in"
source "package/batocera/gpu/gpu-aml/Config.in"
source "package/batocera/gpu/gpu-aml-t8xx/Config.in"
source "package/batocera/gpu/libhybris/Config.in"
source "package/batocera/gpu/mali-450/Config.in"
source "package/batocera/gpu/mali-opengles-sdk/Config.in"
source "package/batocera/gpu/mali-t62x-fbdev/Config.in"
source "package/batocera/gpu/mali-t62x-wayland/Config.in"
source "package/batocera/gpu/opengl-meson-t82x/Config.in"
```

## package/batocera/gpu/batocera-amd/Config.in
```kconfig
config BR2_PACKAGE_BATOCERA_AMD
    bool "batocera-amd"
    select BR2_PACKAGE_MESA3D
    help
      This package helps switch between the different mesa amd drivers
```

## package/batocera/gpu/batocera-nvidia-lists/Config.in
```kconfig
config BR2_PACKAGE_BATOCERA_NVIDIA_LISTS
	bool "batocera-nvidia-lists"
    help
      This package provides list files to correlate
      PCI device ID's for Nvidia drivers that Batocera supports.
```

## package/batocera/gpu/batocera-nvidia/Config.in
```kconfig
config BR2_PACKAGE_BATOCERA_NVIDIA
    bool "batocera-nvidia"

    depends on BR2_PACKAGE_XSERVER_XORG_SERVER

    # drivers
    select BR2_PACKAGE_NVIDIA_OPEN_DRIVER      # the latest driver
    select BR2_PACKAGE_NVIDIA470_LEGACY_DRIVER # the legacy 470.xx driver
    select BR2_PACKAGE_NVIDIA390_LEGACY_DRIVER # the legacy 390.xx driver
    select BR2_PACKAGE_NVIDIA340_LEGACY_DRIVER # the legacy 340.xx driver

    # xorg
    select BR2_PACKAGE_NVIDIA_OPEN_DRIVER_XORG
    select BR2_PACKAGE_NVIDIA470_LEGACY_DRIVER_XORG
    select BR2_PACKAGE_NVIDIA390_LEGACY_DRIVER_XORG
    select BR2_PACKAGE_NVIDIA340_LEGACY_DRIVER_XORG

    # kernel modules
    select BR2_PACKAGE_NVIDIA_OPEN_DRIVER_MODULE
    select BR2_PACKAGE_NVIDIA_PROPRIETARY_DRIVER_MODULE # addition production kernel modules
    select BR2_PACKAGE_NVIDIA470_LEGACY_DRIVER_MODULE
    select BR2_PACKAGE_NVIDIA390_LEGACY_DRIVER_MODULE
    select BR2_PACKAGE_NVIDIA340_LEGACY_DRIVER_MODULE

    # cuda
    select BR2_PACKAGE_NVIDIA_OPEN_DRIVER_CUDA
    select BR2_PACKAGE_NVIDIA340_LEGACY_DRIVER_CUDA

    help
      This package a switch between the different nvidia drivers
```

## package/batocera/gpu/gl4es/Config.in
```kconfig
config BR2_PACKAGE_GL4ES
  bool "gl4es"
  depends on BR2_PACKAGE_HAS_LIBGLES
  help
    GL4ES emulation layer

    https://github.com/ptitSeb/gl4es
```

## package/batocera/gpu/gl4es/gl4es/Config.in
```kconfig
config BR2_PACKAGE_GL4ES
  bool "gl4es"
  help
    GL4ES is a OpenGL 2.1 1.5 to GL ES 2.01.1 translation library

    https://github.com/ptitSeb/gl4es
```

## package/batocera/gpu/gl4es/glu/Config.in
```kconfig
config BR2_PACKAGE_GLU
  bool "glu"
	depends on BR2_PACKAGE_GL4ES
  help
    Graphics Library Utilities (GLU)y

    https://github.com/ptitSeb/GLU
```

## package/batocera/gpu/img-gpu-powervr/Config.in
```kconfig
comment "img-gpu-powervr needs a glibc toolchain"
	depends on BR2_riscv
	depends on !BR2_TOOLCHAIN_USES_GLIBC

config BR2_PACKAGE_IMG_GPU_POWERVR
	bool "img-gpu-powervr"
	# Pre-built binaries only available for RISCV
	depends on BR2_riscv
	# Library binaries are linked against libc.so.6
	depends on BR2_TOOLCHAIN_USES_GLIBC
	# Library binaries are linked against libdrm.so.2, except framebuffer
	# output on RISCV
	select BR2_PACKAGE_LIBDRM if !(BR2_riscv && BR2_PACKAGE_IMG_GPU_POWERVR_OUTPUT_FB)
	select BR2_PACKAGE_HAS_LIBGBM
	select BR2_PACKAGE_HAS_LIBEGL
	select BR2_PACKAGE_HAS_LIBGLES
	select BR2_PACKAGE_HAS_LIBOPENCL
	select BR2_PACKAGE_HAS_LIBVULKAN
	select BR2_PACKAGE_IMG_MESA3D
	select BR2_PACKAGE_IMG_MESA3D_GBM
	select BR2_PACKAGE_IMG_MESA3D_OPENGL_EGL
	select BR2_PACKAGE_IMG_MESA3D_GALLIUM_DRIVER_PVR
	select BR2_PACKAGE_WAYLAND
	select BR2_PACKAGE_HAS_LIBEGL_WAYLAND
	help
	  Userspace libraries for Imagination PowerGPU GPU on StarFive platforms

	  It contains libraries and headers for GLES, OpenCL, and
	  Vulkan. It also contains a DRI plugin for X11. It also
	  contains a plugin for DirectFB-1.4.0.

	  This library is provided by StarFive as-is and doesn't have
	  an upstream.

if BR2_PACKAGE_IMG_GPU_POWERVR

#config BR2_PACKAGE_PROVIDES_LIBEGL
#	default "img-gpu-powervr"

config BR2_PACKAGE_PROVIDES_LIBGLES
	default "img-gpu-powervr"

config BR2_PACKAGE_PROVIDES_LIBOPENCL
	default "img-gpu-powervr"

endif

config BR2_PACKAGE_IMG_GPU_POWERVR_EXAMPLES
	bool "install examples"
	depends on BR2_INSTALL_LIBSTDCPP
	help
	  Copy the PowerVR examples to the target.

	  Warning: examples take approximately 150 MB of disk space.

comment "img-gpu-powervr-examples need a toolchain w/ C++ support"
	depends on !BR2_INSTALL_LIBSTDCPP

config BR2_PACKAGE_IMG_GPU_POWERVR_GMEM_INFO
	bool "install gmem_info tool"
	help
	  Copy the gmem_info tool to the target which provides
	  information about GPU memory consumption.
```

## package/batocera/gpu/img-mesa3d/Config.in
```kconfig
menuconfig BR2_PACKAGE_IMG_MESA3D
	bool "img-mesa3d"
	depends on BR2_INSTALL_LIBSTDCPP
	depends on !BR2_STATIC_LIBS
	depends on BR2_TOOLCHAIN_HAS_SYNC_1
	depends on BR2_TOOLCHAIN_HAS_THREADS_NPTL
	depends on !BR2_m68k || BR2_TOOLCHAIN_GCC_AT_LEAST_7 # m68k needs gcc >= 7.x
	select BR2_PACKAGE_EXPAT
	select BR2_PACKAGE_LIBDRM
	select BR2_PACKAGE_WAYLAND_PROTOCOLS if BR2_PACKAGE_WAYLAND
	select BR2_PACKAGE_ZLIB
	help
	  Mesa 3D, an open-source implementation of the OpenGL
	  specification.

	  http://mesa3d.org

if BR2_PACKAGE_IMG_MESA3D

# Some Gallium driver needs libelf when built with LLVM support
config BR2_PACKAGE_IMG_MESA3D_NEEDS_ELFUTILS
	bool

# inform the .mk file of gallium, dri, dri3 or vulkan driver selection
config BR2_PACKAGE_IMG_MESA3D_DRI3
	bool
	select BR2_PACKAGE_XLIB_LIBXSHMFENCE

config BR2_PACKAGE_IMG_MESA3D_GALLIUM_DRIVER
	bool
	select BR2_PACKAGE_IMG_MESA3D_DRIVER

config BR2_PACKAGE_IMG_MESA3D_VULKAN_DRIVER
	bool
	select BR2_PACKAGE_IMG_MESA3D_DRIVER

config BR2_PACKAGE_IMG_MESA3D_DRIVER
	bool

# Gallium xa state tracker.
# Quote from mesa3d meson.build: "XA state tracker requires at least
# one of the following gallium drivers: nouveau, freedreno, i915, svga.
config BR2_PACKAGE_IMG_MESA3D_NEEDS_XA
	bool

# OpenGL GLX and Gallium VDPAU both needs X11
config BR2_PACKAGE_IMG_MESA3D_NEEDS_X11
	bool
	depends on BR2_PACKAGE_XORG7
	select BR2_PACKAGE_LIBXCB
	select BR2_PACKAGE_XLIB_LIBX11
	select BR2_PACKAGE_XLIB_LIBXDAMAGE
	select BR2_PACKAGE_XLIB_LIBXEXT
	select BR2_PACKAGE_XLIB_LIBXFIXES
	select BR2_PACKAGE_XLIB_LIBXRANDR
	select BR2_PACKAGE_XLIB_LIBXXF86VM
	select BR2_PACKAGE_XORGPROTO

comment "Gallium drivers"

config BR2_PACKAGE_IMG_MESA3D_GALLIUM_DRIVER_PVR
	bool "Gallium pvr driver"
	depends on BR2_PACKAGE_IMG_GPU_POWERVR
	select BR2_PACKAGE_IMG_MESA3D_GALLIUM_DRIVER
	select BR2_PACKAGE_IMG_MESA3D_OPENGL_EGL
	help
	  pvr is the 3D acceleration backend for Imagination PowerVR GPUs

if BR2_PACKAGE_IMG_MESA3D_DRIVER

comment "OpenGL API Support"

config BR2_PACKAGE_IMG_MESA3D_GBM
	bool "gbm"
	depends on BR2_PACKAGE_IMG_MESA3D_GALLIUM_DRIVER && \
		BR2_PACKAGE_IMG_MESA3D_OPENGL_EGL
	select BR2_PACKAGE_HAS_LIBGBM
	select BR2_PACKAGE_LIBGBM_HAS_FEATURE_FORMAT_MODIFIER_PLANE_COUNT
	select BR2_PACKAGE_LIBGBM_HAS_FEATURE_DMA_BUF
	help
	  Enable Generic Buffer Management (gbm)

comment "gbm support needs a gallium driver w/ EGL support."
	depends on !(BR2_PACKAGE_IMG_MESA3D_GALLIUM_DRIVER && BR2_PACKAGE_IMG_MESA3D_OPENGL_EGL)

config BR2_PACKAGE_IMG_MESA3D_OPENGL_GLX
	bool "OpenGL GLX"
	depends on BR2_PACKAGE_XORG7
	select BR2_PACKAGE_HAS_LIBGL if !BR2_PACKAGE_LIBGLVND
	select BR2_PACKAGE_LIBGLVND_DISPATCH_GL if BR2_PACKAGE_LIBGLVND
	select BR2_PACKAGE_IMG_MESA3D_NEEDS_X11
	help
	  Enable GLX graphic acceleration (OpenGL + X11).

comment "OpenGL GLX support needs X11"
	depends on !BR2_PACKAGE_XORG7

config BR2_PACKAGE_IMG_MESA3D_OPENGL_EGL
	bool "OpenGL EGL"
	depends on BR2_PACKAGE_IMG_MESA3D_GALLIUM_DRIVER
	select BR2_PACKAGE_HAS_LIBEGL if !BR2_PACKAGE_LIBGLVND
	select BR2_PACKAGE_LIBGLVND_DISPATCH_EGL if BR2_PACKAGE_LIBGLVND
	select BR2_PACKAGE_HAS_LIBEGL_WAYLAND
	select BR2_PACKAGE_IMG_MESA3D_GBM
	help
	  Use the Khronos EGL APIs. EGL is a window manager for OpenGL
	  applications similar to GLX, for X, and WGL, for Windows.

config BR2_PACKAGE_IMG_MESA3D_OPENGL_ES
	bool "OpenGL ES"
	select BR2_PACKAGE_HAS_LIBGLES if !BR2_PACKAGE_LIBGLVND
	select BR2_PACKAGE_LIBGLVND_DISPATCH_GLES if BR2_PACKAGE_LIBGLVND
	help
	  Use the Khronos OpenGL ES APIs. This is commonly used on
	  embedded systems and represents a subset of the OpenGL API.

endif # BR2_PACKAGE_IMG_MESA3D_DRIVER

config BR2_PACKAGE_PROVIDES_LIBGBM
	default "img-mesa3d" if BR2_PACKAGE_IMG_MESA3D_GBM

config BR2_PACKAGE_PROVIDES_LIBGL
	default "img-mesa3d" if BR2_PACKAGE_IMG_MESA3D_OPENGL_GLX && !BR2_PACKAGE_LIBGLVND

config BR2_PACKAGE_PROVIDES_LIBEGL
	default "img-mesa3d" if BR2_PACKAGE_IMG_MESA3D_OPENGL_EGL && !BR2_PACKAGE_LIBGLVND

config BR2_PACKAGE_PROVIDES_LIBGLES
	default "img-mesa3d" if BR2_PACKAGE_IMG_MESA3D_OPENGL_ES && !BR2_PACKAGE_LIBGLVND

config BR2_PACKAGE_PROVIDES_LIBOPENCL
	default "img-mesa3d" if BR2_PACKAGE_IMG_MESA3D_OPENCL

endif # BR2_PACKAGE_IMG_MESA3D

comment "mesa3d needs a toolchain w/ C++, NPTL, dynamic library"
	depends on !BR2_INSTALL_LIBSTDCPP || !BR2_TOOLCHAIN_HAS_THREADS_NPTL || \
		BR2_STATIC_LIBS
	depends on BR2_TOOLCHAIN_HAS_SYNC_1

comment "mesa3d needs a toolchain w/ gcc >= 7"
	depends on BR2_m68k
	depends on !BR2_TOOLCHAIN_GCC_AT_LEAST_7
```

## package/batocera/gpu/intel-clc/Config.in
```kconfig
menuconfig BR2_PACKAGE_INTEL_CLC
	bool "intel-clc"
	depends on BR2_INSTALL_LIBSTDCPP
	depends on !BR2_STATIC_LIBS
	depends on BR2_TOOLCHAIN_HAS_SYNC_1
	depends on BR2_TOOLCHAIN_HAS_THREADS_NPTL
	depends on BR2_TOOLCHAIN_GCC_AT_LEAST_8
	select BR2_PACKAGE_EXPAT
	select BR2_PACKAGE_LIBDRM
	select BR2_PACKAGE_ZLIB
	help
	  Mesa 3D, an open-source implementation of the OpenGL
	  specification.

	  http://mesa3d.org

comment "intel-clc needs a toolchain w/ gcc >=8, C++, NPTL, dynamic library"
	depends on !BR2_INSTALL_LIBSTDCPP || !BR2_TOOLCHAIN_HAS_THREADS_NPTL || \
		BR2_STATIC_LIBS || !BR2_TOOLCHAIN_GCC_AT_LEAST_8
	depends on BR2_TOOLCHAIN_HAS_SYNC_1
```

## package/batocera/gpu/libmali/Config.in
```kconfig
config BR2_PACKAGE_HAS_LIBMALI
	bool

config BR2_PACKAGE_PROVIDES_LIBMALI
	string
	depends on BR2_PACKAGE_HAS_LIBMALI
```

## package/batocera/gpu/mali-450/Config.in
```kconfig
config BR2_PACKAGE_MALI_450
	bool "MALI_450"
	depends on BR2_arm || BR2_aarch64 || BR2_PACKAGE_GPU_AML
	select BR2_PACKAGE_MALI_OPENGLES_SDK
	select BR2_PACKAGE_HAS_LIBEGL
	select BR2_PACKAGE_HAS_LIBGLES
	help
	  Install the binary user-space components for the ARM Mali Midgard
	  450 GPU. This package requires a kernel with the ARM Mali Midgard
	  GPU Kernel Drivers enabled.

if BR2_PACKAGE_MALI_450

config BR2_PACKAGE_PROVIDES_LIBEGL
	default "mali-450"

config BR2_PACKAGE_PROVIDES_LIBGLES
	default "mali-450"

endif

comment "mali-450"
```

## package/batocera/gpu/mali-G31/Config.in
```kconfig
config BR2_PACKAGE_MALI_G31
	bool "mali-G31"
	depends on BR2_aarch64
	select BR2_PACKAGE_LIBDRM
	select BR2_PACKAGE_LIBGLVND
	select BR2_PACKAGE_WAYLAND
	select BR2_PACKAGE_HAS_LIBEGL
	select BR2_PACKAGE_HAS_LIBEGL_WAYLAND
	select BR2_PACKAGE_HAS_LIBGLES
	select BR2_PACKAGE_HAS_LIBMALI
	select BR2_PACKAGE_HAS_LIBGBM
	help
	  Install the binary user-space libraries for the ARM Mali GPU
	  suitable for Mali G31. This package requires a kernel with 
	  the ARM Mali GPU kernel driver enabled, as found in the
	  'mali-driver' package.

if BR2_PACKAGE_MALI_G31

config BR2_PACKAGE_PROVIDES_LIBMALI
	default "mali-G31"

config BR2_PACKAGE_PROVIDES_LIBEGL
	default "mali-G31"

config BR2_PACKAGE_PROVIDES_LIBEGL_WAYLAND
	bool
	default "mali-G31"

config BR2_PACKAGE_PROVIDES_LIBGLES
	default "mali-G31"

config BR2_PACKAGE_PROVIDES_LIBGBM
	default "mali-G31"

endif
```

## package/batocera/gpu/mali-G52/Config.in
```kconfig
config BR2_PACKAGE_MALI_G52
	bool "mali-G52"
	depends on BR2_aarch64
	select BR2_PACKAGE_LIBDRM
	select BR2_PACKAGE_LIBGLVND
	select BR2_PACKAGE_WAYLAND
	select BR2_PACKAGE_HAS_LIBEGL
	select BR2_PACKAGE_HAS_LIBEGL_WAYLAND
	select BR2_PACKAGE_HAS_LIBGLES
	select BR2_PACKAGE_HAS_LIBMALI
	select BR2_PACKAGE_HAS_LIBGBM
	select BR2_PACKAGE_LIBGBM_HAS_FEATURE_DMA_BUF
	select BR2_PACKAGE_LIBGBM_HAS_FEATURE_FORMAT_MODIFIER_PLANE_COUNT
	help
	  Install the binary user-space libraries for the ARM Mali GPU
	  suitable for Mali G52. This package requires a kernel with 
	  the ARM Mali GPU kernel driver enabled, as found in the
	  'mali-driver' package.

if BR2_PACKAGE_MALI_G52

config BR2_PACKAGE_PROVIDES_LIBMALI
	default "mali-G52"

config BR2_PACKAGE_PROVIDES_LIBEGL
	default "mali-G52"

config BR2_PACKAGE_PROVIDES_LIBEGL_WAYLAND
	bool
	default "mali-G52"

config BR2_PACKAGE_PROVIDES_LIBGLES
	default "mali-G52"

config BR2_PACKAGE_PROVIDES_LIBGBM
	default "mali-G52"

endif
```

## package/batocera/gpu/mali-T760/Config.in
```kconfig
config BR2_PACKAGE_MALI_T760
	bool "MALI_T760"
	depends on BR2_arm
	select BR2_PACKAGE_HAS_LIBEGL
	select BR2_PACKAGE_HAS_LIBGLES
	select BR2_PACKAGE_HAS_LIBMALI

if BR2_PACKAGE_MALI_T760

config BR2_PACKAGE_PROVIDES_LIBEGL
	default "mali-T760"

config BR2_PACKAGE_PROVIDES_LIBGLES
	default "mali-T760"

config BR2_PACKAGE_PROVIDES_LIBMALI
	default "mali-T760"

endif

comment "mali-T760"
```

## package/batocera/gpu/mali-T860/Config.in
```kconfig
config BR2_PACKAGE_MALI_T860
	bool "MALI_T860"
	depends on BR2_aarch64 || BR2_arm
	select BR2_PACKAGE_HAS_LIBEGL
	select BR2_PACKAGE_HAS_LIBGLES
	select BR2_PACKAGE_HAS_LIBMALI

if BR2_PACKAGE_MALI_T860

config BR2_PACKAGE_PROVIDES_LIBEGL
	default "mali-T860"

config BR2_PACKAGE_PROVIDES_LIBGLES
	default "mali-T860"

config BR2_PACKAGE_PROVIDES_LIBMALI
	default "mali-T860"

endif

comment "mali-T860"
```

## package/batocera/gpu/mali-bifrost-g31-gbm/Config.in
```kconfig
config BR2_PACKAGE_MALI_BIFROST_G31_GBM
	bool "MALI_BIFROST_G31_GBM"
	depends on BR2_arm
	select BR2_PACKAGE_HAS_LIBEGL
	select BR2_PACKAGE_HAS_LIBGLES

if BR2_PACKAGE_MALI_BIFROST_G31_GBM

config BR2_PACKAGE_PROVIDES_LIBEGL
	default "mali-bifrost-g31-gbm"

config BR2_PACKAGE_PROVIDES_LIBGLES
	default "mali-bifrost-g31-gbm"

endif

comment "mali-bifrost-g31-gbm"
```

## package/batocera/gpu/mali-bifrost-module/Config.in
```kconfig
config BR2_PACKAGE_MALI_BIFROST_MODULE
	bool "mali-bifrost-module"
	depends on BR2_LINUX_KERNEL
```
