## package/batocera/kodi/kodi20-resource-language-es_es/Config.in
```kconfig
config BR2_PACKAGE_KODI20_RESOURCE_LANGUAGE_ES_ES
    bool "kodi20-resource-language-es_es"
    help
      Kodi es_es language resource

      https://kodi.tv
```

## package/batocera/kodi/kodi20-resource-language-eu_es/Config.in
```kconfig
config BR2_PACKAGE_KODI20_RESOURCE_LANGUAGE_EU_ES
    bool "kodi20-resource-language-eu_es"
    help
      Kodi eu_es language resource

      https://kodi.tv
```

## package/batocera/kodi/kodi20-resource-language-fr_fr/Config.in
```kconfig
config BR2_PACKAGE_KODI20_RESOURCE_LANGUAGE_FR_FR
    bool "kodi20-resource-language-fr_fr"
    help
      Kodi fr_fr language resource

      https://kodi.tv
```

## package/batocera/kodi/kodi20-resource-language-it_it/Config.in
```kconfig
config BR2_PACKAGE_KODI20_RESOURCE_LANGUAGE_IT_IT
    bool "kodi20-resource-language-it_it"
    help
      Kodi it_it language resource

      https://kodi.tv
```

## package/batocera/kodi/kodi20-resource-language-pt_br/Config.in
```kconfig
config BR2_PACKAGE_KODI20_RESOURCE_LANGUAGE_PT_BR
    bool "kodi20-resource-language-pt_br"
    help
      Kodi pt_br language resource

      https://kodi.tv
```

## package/batocera/kodi/kodi20-resource-language-sv_se/Config.in
```kconfig
config BR2_PACKAGE_KODI20_RESOURCE_LANGUAGE_SV_SE
    bool "kodi20-resource-language-sv_se"
    help
      Kodi sv_se language resource

      https://kodi.tv
```

## package/batocera/kodi/kodi20-resource-language-tr_tr/Config.in
```kconfig
config BR2_PACKAGE_KODI20_RESOURCE_LANGUAGE_TR_TR
    bool "kodi20-resource-language-tr_tr"
    help
      Kodi tr_tr language resource

      https://kodi.tv
```

## package/batocera/kodi/kodi20-screensaver-asteroids/Config.in
```kconfig
config BR2_PACKAGE_KODI20_SCREENSAVER_ASTEROIDS
	bool "kodi20-screensaver-asteroids"
	select BR2_PACKAGE_GLM
	help
	  Asteroids screensaver for Kodi

	  https://github.com/xbmc/screensaver.asteroids
```

## package/batocera/kodi/kodi20-screensaver-asterwave/Config.in
```kconfig
config BR2_PACKAGE_KODI20_SCREENSAVER_ASTERWAVE
	bool "kodi20-screensaver-asterwave"
	select BR2_PACKAGE_GLM
	help
	  AsterWave screensaver for Kodi

	  https://github.com/xbmc/screensaver.asterwave
```

## package/batocera/kodi/kodi20-screensaver-biogenesis/Config.in
```kconfig
config BR2_PACKAGE_KODI20_SCREENSAVER_BIOGENESIS
	bool "kodi20-screensaver-biogenesis"
	help
	  BioGenesis screensaver for Kodi

	  https://github.com/xbmc/screensaver.biogenesis
```

## package/batocera/kodi/kodi20-screensaver-cpblobs/Config.in
```kconfig
config BR2_PACKAGE_KODI20_SCREENSAVER_CPBLOBS
	bool "kodi20-screensaver-cpblobs"
	select BR2_PACKAGE_GLM
	help
	  CpBlobs screensaver for Kodi

	  https://github.com/xbmc/screensaver.cpblobs
```

## package/batocera/kodi/kodi20-screensaver-greynetic/Config.in
```kconfig
config BR2_PACKAGE_KODI20_SCREENSAVER_GREYNETIC
	bool "kodi20-screensaver-greynetic"
	select BR2_PACKAGE_GLM
	help
	  Greynetic screensaver for Kodi

	  https://github.com/xbmc/screensaver.greynetic
```

## package/batocera/kodi/kodi20-screensaver-matrixtrails/Config.in
```kconfig
config BR2_PACKAGE_KODI20_SCREENSAVER_MATRIXTRAILS
	bool "kodi20-screensaver-matrixtrails"
	help
	  Matrix trails screensaver for Kodi

	  https://github.com/xbmc/screensaver.matrixtrails
```

## package/batocera/kodi/kodi20-screensaver-pingpong/Config.in
```kconfig
config BR2_PACKAGE_KODI20_SCREENSAVER_PINGPONG
	bool "kodi20-screensaver-pingpong"
	select BR2_PACKAGE_GLM
	help
	  Ping-pong screensaver for Kodi

	  https://github.com/xbmc/screensaver.pingpong
```

## package/batocera/kodi/kodi20-screensaver-pyro/Config.in
```kconfig
config BR2_PACKAGE_KODI20_SCREENSAVER_PYRO
	bool "kodi20-screensaver-pyro"
	help
	  Pyro screensaver for Kodi

	  https://github.com/xbmc/screensaver.pyro
```

## package/batocera/kodi/kodi20-screensaver-shadertoy/Config.in
```kconfig
config BR2_PACKAGE_KODI20_SCREENSAVER_SHADERTOY
	bool "kodi20-screensaver-shadertoy"
	help
	  Shadertoy screensaver for Kodi

	  https://github.com/xbmc/screensaver.shadertoy
```

## package/batocera/kodi/kodi20-screensaver-stars/Config.in
```kconfig
config BR2_PACKAGE_KODI20_SCREENSAVER_STARS
	bool "kodi20-screensaver-stars"
	help
	  Starfield screensaver for Kodi

	  https://github.com/xbmc/screensaver.stars
```

## package/batocera/kodi/kodi20-screensavers-rsxs/Config.in
```kconfig
config BR2_PACKAGE_KODI20_SCREENSAVERS_RSXS
	bool "kodi20-screensavers-rsxs"
	# depends on BR2_PACKAGE_KODI20_RENDER_SYSTEM_GL
	select BR2_PACKAGE_BZIP2
	select BR2_PACKAGE_GLI
	select BR2_PACKAGE_GLM
	help
	  RSXS screensaver add-ons for Kodi

	  https://github.com/xbmc/screensavers.rsxs

# comment "kodi20-screensaver-rsxs needs OpenGL as Kodi render system"
# 	depends on !BR2_PACKAGE_KODI20_RENDER_SYSTEM_GL
```

## package/batocera/kodi/kodi20-skin-confluence/Config.in
```kconfig
config BR2_PACKAGE_KODI20_SKIN_CONFLUENCE
	bool "kodi20-skin-confluence"
	help
	  Kodi confluence skin

	  https://github.com/xbmc/skin.confluence
```

## package/batocera/kodi/kodi20-vfs-rar/Config.in
```kconfig
config BR2_PACKAGE_KODI20_VFS_RAR
	bool "kodi20-vfs-rar"
	select BR2_PACKAGE_TINYXML
	help
	  RAR VFS addon for Kodi

	  https://github.com/xbmc/vfs.rar
```

## package/batocera/kodi/kodi20-vfs-sftp/Config.in
```kconfig
config BR2_PACKAGE_KODI20_VFS_SFTP
	bool "kodi20-vfs-sftp"
	select BR2_PACKAGE_LIBSSH
	select BR2_PACKAGE_OPENSSL
	select BR2_PACKAGE_ZLIB
	help
	  SFTP VFS addon for Kodi

	  https://github.com/xbmc/vfs.sftp
```

## package/batocera/kodi/kodi20-visualisation-fishbmc/Config.in
```kconfig
config BR2_PACKAGE_KODI20_VISUALISATION_FISHBMC
	bool "kodi20-visualisation-fishbmc"
	select BR2_PACKAGE_GLM
	help
	  Fische visualiser for Kodi

	  https://github.com/xbmc/visualization.fishbmc
```

## package/batocera/kodi/kodi20-visualisation-goom/Config.in
```kconfig
config BR2_PACKAGE_KODI20_VISUALISATION_GOOM
	bool "kodi20-visualisation-goom"
	#depends on BR2_PACKAGE_KODI20_RENDER_SYSTEM_GL
	select BR2_PACKAGE_GLM
	help
	  GOOM visualiser for Kodi

	  https://github.com/notspiff/visualization.goom

# comment "kodi20-visualization-goom needs OpenGL as Kodi render system"
# 	depends on !BR2_PACKAGE_KODI20_RENDER_SYSTEM_GL
```

## package/batocera/kodi/kodi20-visualisation-matrix/Config.in
```kconfig
config BR2_PACKAGE_KODI20_VISUALISATION_MATRIX
	bool "kodi20-visualisation-matrix"
	select BR2_PACKAGE_GLM
	help
	  Matrix themed visualization addon for Kodi

	  https://github.com/xbmc/visualization.matrix
```

## package/batocera/kodi/kodi20-visualisation-pictureit/Config.in
```kconfig
config BR2_PACKAGE_KODI20_VISUALISATION_PICTUREIT
	bool "kodi20-visualisation-pictureit"
	select BR2_PACKAGE_GLM
	help
	  Pictureit visualization addon for Kodi

	  https://github.com/xbmc/visualization.pictureit
```
