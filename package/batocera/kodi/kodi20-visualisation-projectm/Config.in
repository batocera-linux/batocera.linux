## package/batocera/kodi/kodi20-visualisation-projectm/Config.in
```kconfig
config BR2_PACKAGE_KODI20_VISUALISATION_PROJECTM
	bool "kodi20-visualisation-projectm"
	select BR2_PACKAGE_GLM
	select BR2_PACKAGE_PROJECTM
	help
	  ProjectM visualization addon for Kodi

	  https://github.com/xbmc/visualization.projectm
```

## package/batocera/kodi/kodi20-visualisation-spectrum/Config.in
```kconfig
config BR2_PACKAGE_KODI20_VISUALISATION_SPECTRUM
	bool "kodi20-visualisation-spectrum"
	select BR2_PACKAGE_GLM
	help
	  Spectrum visualiser for Kodi

	  https://github.com/notspiff/visualization.spectrum
```

## package/batocera/kodi/kodi20-visualisation-starburst/Config.in
```kconfig
config BR2_PACKAGE_KODI20_VISUALISATION_STARBURST
	bool "kodi20-visualisation-starburst"
	select BR2_PACKAGE_GLM
	help
	  StarBurst visualization for Kodi

	  https://github.com/xbmc/visualization.starburst
```

## package/batocera/kodi/kodi20-visualisation-waveform/Config.in
```kconfig
config BR2_PACKAGE_KODI20_VISUALISATION_WAVEFORM
	bool "kodi20-visualisation-waveform"
	select BR2_PACKAGE_GLM
	help
	  Waveform visualiser for Kodi

	  https://github.com/notspiff/visualization.waveform
```

## package/batocera/kodi/kodi21-kodi-platform/Config.in
```kconfig
config BR2_PACKAGE_KODI21_KODI_PLATFORM
	bool "kodi21-kodi-platform"
	help

	  https://github.com/xbmc/kodi-platform
```

## package/batocera/kodi/kodi21-p8-platform/Config.in
```kconfig
config BR2_PACKAGE_KODI21_P8_PLATFORM
	bool "kodi21-p8-platform"
	help
	  Platform support library used by libCEC and binary add-ons for Kodi

	  https://github.com/xbmc/platform
```

## package/batocera/kodi/kodi21-pvr-freebox/Config.in
```kconfig
config BR2_PACKAGE_KODI21_PVR_FREEBOX
	bool "kodi21-pvr-freebox"
	select BR2_PACKAGE_JSON_FOR_MODERN_CPP
```

## package/batocera/kodi/kodi21-resource-language-de_de/Config.in
```kconfig
config BR2_PACKAGE_KODI21_RESOURCE_LANGUAGE_DE_DE
    bool "kodi21-resource-language-de_de"
    help
      Kodi de_de language resource

      https://kodi.tv
```

## package/batocera/kodi/kodi21-resource-language-el_gr/Config.in
```kconfig
config BR2_PACKAGE_KODI21_RESOURCE_LANGUAGE_EL_GR
    bool "kodi21-resource-language-el_gr"
    help
      Kodi el_gr language resource

      https://kodi.tv
```

## package/batocera/kodi/kodi21-resource-language-es_es/Config.in
```kconfig
config BR2_PACKAGE_KODI21_RESOURCE_LANGUAGE_ES_ES
    bool "kodi21-resource-language-es_es"
    help
      Kodi es_es language resource

      https://kodi.tv
```

## package/batocera/kodi/kodi21-resource-language-eu_es/Config.in
```kconfig
config BR2_PACKAGE_KODI21_RESOURCE_LANGUAGE_EU_ES
    bool "kodi21-resource-language-eu_es"
    help
      Kodi eu_es language resource

      https://kodi.tv
```

## package/batocera/kodi/kodi21-resource-language-fr_fr/Config.in
```kconfig
config BR2_PACKAGE_KODI21_RESOURCE_LANGUAGE_FR_FR
    bool "kodi21-resource-language-fr_fr"
    help
      Kodi fr_fr language resource

      https://kodi.tv
```

## package/batocera/kodi/kodi21-resource-language-it_it/Config.in
```kconfig
config BR2_PACKAGE_KODI21_RESOURCE_LANGUAGE_IT_IT
    bool "kodi21-resource-language-it_it"
    help
      Kodi it_it language resource

      https://kodi.tv
```

## package/batocera/kodi/kodi21-resource-language-pt_br/Config.in
```kconfig
config BR2_PACKAGE_KODI21_RESOURCE_LANGUAGE_PT_BR
    bool "kodi21-resource-language-pt_br"
    help
      Kodi pt_br language resource

      https://kodi.tv
```

## package/batocera/kodi/kodi21-resource-language-sv_se/Config.in
```kconfig
config BR2_PACKAGE_KODI21_RESOURCE_LANGUAGE_SV_SE
    bool "kodi21-resource-language-sv_se"
    help
      Kodi sv_se language resource

      https://kodi.tv
```

## package/batocera/kodi/kodi21-resource-language-tr_tr/Config.in
```kconfig
config BR2_PACKAGE_KODI21_RESOURCE_LANGUAGE_TR_TR
    bool "kodi21-resource-language-tr_tr"
    help
      Kodi tr_tr language resource

      https://kodi.tv
```

## package/batocera/kodi/kodi21-resource-language-zh_cn/Config.in
```kconfig
config BR2_PACKAGE_KODI21_RESOURCE_LANGUAGE_ZH_CN
    bool "kodi21-resource-language-zh_cn"
    help
      Kodi zh_cn language resource

      https://kodi.tv
```

## package/batocera/kodi18/kodi18-audiodecoder-stsound/Config.in
```kconfig
config BR2_PACKAGE_KODI18_AUDIODECODER_STSOUND
	bool "kodi-audiodecoder-stsound"
	help
	  YM decoder addon for Kodi

	  https://github.com/xbmc/audiodecoder.stsound
```

## package/batocera/kodi18/kodi18-audiodecoder-timidity/Config.in
```kconfig
config BR2_PACKAGE_KODI18_AUDIODECODER_TIMIDITY
	bool "kodi-audiodecoder-timidity"
	help
	  Timidity decoder addon for Kodi

	  https://github.com/xbmc/audiodecoder.timidity
```

## package/batocera/kodi18/kodi18-audioencoder-flac/Config.in
```kconfig
config BR2_PACKAGE_KODI18_AUDIOENCODER_FLAC
	bool "kodi-audioencoder-flac"
	select BR2_PACKAGE_FLAC
	select BR2_PACKAGE_KODI18_OPTICALDRIVE
	select BR2_PACKAGE_LIBOGG
	help
	  An audioencoder addon for Kodi

	  https://github.com/xbmc/audioencoder.flac
```

## package/batocera/kodi18/kodi18-audioencoder-vorbis/Config.in
```kconfig
config BR2_PACKAGE_KODI18_AUDIOENCODER_VORBIS
	bool "kodi-audioencoder-vorbis"
	select BR2_PACKAGE_KODI18_OPTICALDRIVE
	select BR2_PACKAGE_LIBOGG
	select BR2_PACKAGE_LIBVORBIS
	help
	  An audioencoder addon for Kodi

	  https://github.com/xbmc/audioencoder.vorbis
```

## package/batocera/kodi18/kodi18-inputstream-rtmp/Config.in
```kconfig
config BR2_PACKAGE_KODI18_INPUTSTREAM_RTMP
	bool "kodi-inputstream-rtmp"
	select BR2_PACKAGE_RTMPDUMP
	help
	  RTMP input stream add-on for Kodi

	  https://github.com/xbmc/inputstream.rtmp
```

## package/batocera/kodi18/kodi18-peripheral-steamcontroller/Config.in
```kconfig
config BR2_PACKAGE_KODI18_PERIPHERAL_STEAMCONTROLLER
	bool "kodi-peripheral-steamcontroller"
	select BR2_PACKAGE_KODI18_PLATFORM
	select BR2_PACKAGE_LIBUSB
	help
	  Steam controller driver for Kodi

	  https://github.com/kodi-game/peripheral.steamcontroller
```

## package/batocera/kodi18/kodi18-peripheral-xarcade/Config.in
```kconfig
config BR2_PACKAGE_KODI18_PERIPHERAL_XARCADE
	bool "kodi-peripheral-xarcade"
	help
	  X-Arcade Tankstick support for Kodi

	  https://github.com/kodi-game/peripheral.xarcade
```

## package/batocera/kodi18/kodi18-pvr-argustv/Config.in
```kconfig
config BR2_PACKAGE_KODI18_PVR_ARGUSTV
	bool "kodi-pvr-argustv"
	select BR2_PACKAGE_JSONCPP
	select BR2_PACKAGE_KODI18_PLATFORM
	help
	  Kodi's ARGUS TV client addon

	  https://github.com/kodi-pvr/pvr.argustv
```
