## package/batocera/kodi/kodi20-p8-platform/Config.in
```kconfig
config BR2_PACKAGE_KODI20_P8_PLATFORM
	bool "kodi20-p8-platform"
	help
	  Platform support library used by libCEC and binary add-ons for Kodi

	  https://github.com/xbmc/platform
```

## package/batocera/kodi/kodi20-peripheral-joystick/Config.in
```kconfig
config BR2_PACKAGE_KODI20_PERIPHERAL_JOYSTICK
	bool "kodi20-peripheral-joystick"
	depends on BR2_PACKAGE_HAS_UDEV
	select BR2_PACKAGE_TINYXML
	help
	  Kodi joystick support (drivers and button maps)

	  https://github.com/xbmc/peripheral.joystick

comment "kodi20-peripheral-joystick needs udev /dev management"
	depends on !BR2_PACKAGE_HAS_UDEV
```

## package/batocera/kodi/kodi20-peripheral-xarcade/Config.in
```kconfig
config BR2_PACKAGE_KODI20_PERIPHERAL_XARCADE
	bool "kodi20-peripheral-xarcade"
	help
	  X-Arcade Tankstick support for Kodi

	  https://github.com/kodi20-game/peripheral.xarcade
```

## package/batocera/kodi/kodi20-pvr-argustv/Config.in
```kconfig
config BR2_PACKAGE_KODI20_PVR_ARGUSTV
	bool "kodi20-pvr-argustv"
	select BR2_PACKAGE_JSONCPP
	help
	  Kodi's ARGUS TV client addon

	  https://github.com/kodi20-pvr/pvr.argustv
```

## package/batocera/kodi/kodi20-pvr-dvblink/Config.in
```kconfig
config BR2_PACKAGE_KODI20_PVR_DVBLINK
	bool "kodi20-pvr-dvblink"
	select BR2_PACKAGE_TINYXML2
	help
	  Kodi's DVBLink client addon

	  https://github.com/kodi20-pvr/pvr.dvblink
```

## package/batocera/kodi/kodi20-pvr-dvbviewer/Config.in
```kconfig
config BR2_PACKAGE_KODI20_PVR_DVBVIEWER
	bool "kodi20-pvr-dvbviewer"
	select BR2_PACKAGE_TINYXML
	help
	  Kodi's DVBViewer client addon

	  https://github.com/kodi20-pvr/pvr.dvbviewer
```

## package/batocera/kodi/kodi20-pvr-filmon/Config.in
```kconfig
config BR2_PACKAGE_KODI20_PVR_FILMON
	bool "kodi20-pvr-filmon"
	select BR2_PACKAGE_JSONCPP
	help
	  Filmon PVR client addon for Kodi

	  https://github.com/kodi20-pvr/pvr.filmon
```

## package/batocera/kodi/kodi20-pvr-hdhomerun/Config.in
```kconfig
config BR2_PACKAGE_KODI20_PVR_HDHOMERUN
	bool "kodi20-pvr-hdhomerun"
	select BR2_PACKAGE_JSONCPP
	select BR2_PACKAGE_LIBHDHOMERUN
	help
	  Kodi's HDHomeRun client addon

	  https://github.com/kodi20-pvr/pvr.hdhomerun
```

## package/batocera/kodi/kodi20-pvr-hts/Config.in
```kconfig
config BR2_PACKAGE_KODI20_PVR_HTS
	bool "kodi20-pvr-hts"
	depends on BR2_TOOLCHAIN_GCC_AT_LEAST_7 # C++17
	help
	  Tvheadend HTSP PVR client addon for Kodi

	  https://github.com/kodi20-pvr/pvr.hts

comment "kodi20-pvr-hts needs a toolchain w/ gcc >= 7"
	depends on !BR2_TOOLCHAIN_GCC_AT_LEAST_7
```

## package/batocera/kodi/kodi20-pvr-iptvsimple/Config.in
```kconfig
config BR2_PACKAGE_KODI20_PVR_IPTVSIMPLE
	bool "kodi20-pvr-iptvsimple"
	# kodi20-inputstream-adaptive
	depends on BR2_aarch64 || BR2_arm || BR2_i386 || BR2_mipsel \
		|| BR2_mips64el || BR2_x86_64 || BR2_riscv
	select BR2_PACKAGE_KODI20_INPUTSTREAM_ADAPTIVE # runtime
	select BR2_PACKAGE_KODI20_INPUTSTREAM_FFMPEGDIRECT # runtime
	select BR2_PACKAGE_KODI20_INPUTSTREAM_RTMP # runtime
	select BR2_PACKAGE_PUGIXML
	select BR2_PACKAGE_XZ
	select BR2_PACKAGE_ZLIB
	help
	  IPTV Live TV and Radio PVR client addon for Kodi

	  https://github.com/kodi20-pvr/pvr.iptvsimple
```

## package/batocera/kodi/kodi20-pvr-mediaportal-tvserver/Config.in
```kconfig
config BR2_PACKAGE_KODI20_PVR_MEDIAPORTAL_TVSERVER
	bool "kodi20-pvr-mediaportal-tvserver"
	select BR2_PACKAGE_TINYXML
	help
	  MediaPortal TVServer PVR client addon for Kodi

	  https://github.com/kodi20-pvr/pvr.mediaportal.tvserver
```

## package/batocera/kodi/kodi20-pvr-mythtv/Config.in
```kconfig
config BR2_PACKAGE_KODI20_PVR_MYTHTV
	bool "kodi20-pvr-mythtv"
	help
	  MythTV PVR for Kodi

	  https://github.com/kodi20-pvr/pvr.mythtv
```

## package/batocera/kodi/kodi20-pvr-nextpvr/Config.in
```kconfig
config BR2_PACKAGE_KODI20_PVR_NEXTPVR
	bool "kodi20-pvr-nextpvr"
	select BR2_PACKAGE_TINYXML2
	help
	  Kodi's NextPVR client addon

	  https://github.com/kodi20-pvr/pvr.nextpvr
```

## package/batocera/kodi/kodi20-pvr-njoy/Config.in
```kconfig
config BR2_PACKAGE_KODI20_PVR_NJOY
	bool "kodi20-pvr-njoy"
	select BR2_PACKAGE_TINYXML
	help
	  Kodi's Njoy N7 client addon

	  https://github.com/kodi20-pvr/pvr.njoy
```

## package/batocera/kodi/kodi20-pvr-octonet/Config.in
```kconfig
config BR2_PACKAGE_KODI20_PVR_OCTONET
	bool "kodi20-pvr-octonet"
	depends on BR2_TOOLCHAIN_GCC_AT_LEAST_4_7 # jsoncpp
	select BR2_PACKAGE_JSONCPP
	help
	  DigitalDevices Octonet PVR client addon for Kodi

	  https://github.com/DigitalDevices/pvr.octonet

comment "kodi20-pvr-octonet needs a toolchain w/ gcc >= 4.7"
	depends on !BR2_TOOLCHAIN_GCC_AT_LEAST_4_7
```

## package/batocera/kodi/kodi20-pvr-pctv/Config.in
```kconfig
config BR2_PACKAGE_KODI20_PVR_PCTV
	bool "kodi20-pvr-pctv"
	select BR2_PACKAGE_JSONCPP
	help
	  PCTV PVR client addon for Kodi

	  https://github.com/kodi20-pvr/pvr.vdr.vnsi
```

## package/batocera/kodi/kodi20-pvr-plutotv/Config.in
```kconfig
config BR2_PACKAGE_KODI20_PVR_PLUTOTV
	bool "kodi20-pvr-plutotv"
	select BR2_PACKAGE_RAPIDJSON
	help
	  Pluto.tv PVR Client for Kodi

	  https://github.com/kodi20-pvr/pvr.plutotv
```

## package/batocera/kodi/kodi20-pvr-stalker/Config.in
```kconfig
config BR2_PACKAGE_KODI20_PVR_STALKER
	bool "kodi20-pvr-stalker"
	select BR2_PACKAGE_JSONCPP
	select BR2_PACKAGE_LIBXML2
	help
	  A PVR Client that connects Kodi to Stalker Middleware

	  https://github.com/kodi20-pvr/pvr.stalker
```

## package/batocera/kodi/kodi20-pvr-vbox/Config.in
```kconfig
config BR2_PACKAGE_KODI20_PVR_VBOX
	bool "kodi20-pvr-vbox"
	help
	  Kodi PVR addon for interfacing with VBox Communications XTi TV
	  Gateway

	  https://github.com/kodi20-pvr/pvr.vbox
```

## package/batocera/kodi/kodi20-pvr-waipu/Config.in
```kconfig
config BR2_PACKAGE_KODI20_PVR_WAIPU
	bool "kodi20-pvr-waipu"
	select BR2_PACKAGE_RAPIDJSON
	help
	  Waipu.tv PVR Plugin for Kodi

	  https://github.com/flubshi/pvr.waipu
```

## package/batocera/kodi/kodi20-pvr-wmc/Config.in
```kconfig
config BR2_PACKAGE_KODI20_PVR_WMC
	bool "kodi20-pvr-wmc"
	help
	  Kodi's Windows Media Center client addon

	  https://github.com/kodi20-pvr/pvr.wmc
```

## package/batocera/kodi/kodi20-pvr-zattoo/Config.in
```kconfig
config BR2_PACKAGE_KODI20_PVR_ZATTOO
	bool "kodi20-pvr-zattoo"
	select BR2_PACKAGE_RAPIDJSON
	select BR2_PACKAGE_TINYXML2
	help
	  Kodi PVR-Addon for Zattoo

	  https://github.com/rbuehlma/pvr.zattoo
```

## package/batocera/kodi/kodi20-resource-language-de_de/Config.in
```kconfig
config BR2_PACKAGE_KODI20_RESOURCE_LANGUAGE_DE_DE
    bool "kodi20-resource-language-de_de"
    help
      Kodi de_de language resource

      https://kodi.tv
```

## package/batocera/kodi/kodi20-resource-language-el_gr/Config.in
```kconfig
config BR2_PACKAGE_KODI20_RESOURCE_LANGUAGE_EL_GR
    bool "kodi20-resource-language-el_gr"
    help
      Kodi el_gr language resource

      https://kodi.tv
```
