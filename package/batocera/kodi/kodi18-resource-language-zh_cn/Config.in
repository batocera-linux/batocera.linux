## package/batocera/kodi/kodi18-resource-language-zh_cn/Config.in
```kconfig
config BR2_PACKAGE_KODI18_RESOURCE_LANGUAGE_ZH_CN
    bool "kodi-resource-language-zh_cn"
    help
      Kodi zh_cn language resource

      https://kodi.tv
```

## package/batocera/kodi/kodi18-skin-confluence/Config.in
```kconfig
config BR2_PACKAGE_KODI18_SKIN_CONFLUENCE
	bool "kodi-skin-confluence"
	select BR2_PACKAGE_KODI18_SKIN_ENABLED
	help
	  Kodi confluence skin

	  https://github.com/xbmc/skin.confluence
```

## package/batocera/kodi/kodi19-resource-language-de_de/Config.in
```kconfig
config BR2_PACKAGE_KODI19_RESOURCE_LANGUAGE_DE_DE
    bool "kodi-resource-language-de_de"
    help
      Kodi de_de language resource

      https://kodi.tv
```

## package/batocera/kodi/kodi19-resource-language-el_gr/Config.in
```kconfig
config BR2_PACKAGE_KODI19_RESOURCE_LANGUAGE_EL_GR
    bool "kodi-resource-language-el_gr"
    help
      Kodi el_gr language resource

      https://kodi.tv
```

## package/batocera/kodi/kodi19-resource-language-es_es/Config.in
```kconfig
config BR2_PACKAGE_KODI19_RESOURCE_LANGUAGE_ES_ES
    bool "kodi-resource-language-es_es"
    help
      Kodi es_es language resource

      https://kodi.tv
```

## package/batocera/kodi/kodi19-resource-language-eu_es/Config.in
```kconfig
config BR2_PACKAGE_KODI19_RESOURCE_LANGUAGE_EU_ES
    bool "kodi-resource-language-eu_es"
    help
      Kodi eu_es language resource

      https://kodi.tv
```

## package/batocera/kodi/kodi19-resource-language-fr_fr/Config.in
```kconfig
config BR2_PACKAGE_KODI19_RESOURCE_LANGUAGE_FR_FR
    bool "kodi-resource-language-fr_fr"
    help
      Kodi fr_fr language resource

      https://kodi.tv
```

## package/batocera/kodi/kodi19-resource-language-it_it/Config.in
```kconfig
config BR2_PACKAGE_KODI19_RESOURCE_LANGUAGE_IT_IT
    bool "kodi-resource-language-it_it"
    help
      Kodi it_it language resource

      https://kodi.tv
```

## package/batocera/kodi/kodi19-resource-language-zh_cn/Config.in
```kconfig
config BR2_PACKAGE_KODI19_RESOURCE_LANGUAGE_ZH_CN
    bool "kodi-resource-language-zh_cn"
    help
      Kodi zh_cn language resource

      https://kodi.tv
```

## package/batocera/kodi/kodi20-audiodecoder-nosefart/Config.in
```kconfig
config BR2_PACKAGE_KODI20_AUDIODECODER_NOSEFART
	bool "kodi20-audiodecoder-nosefart"
	help
	  Nosefart decoder addon for Kodi

	  https://github.com/xbmc/audiodecoder.nosefart
```

## package/batocera/kodi/kodi20-audiodecoder-openmpt/Config.in
```kconfig
config BR2_PACKAGE_KODI20_AUDIODECODER_OPENMPT
	bool "kodi20-audiodecoder-openmpt"
	select BR2_PACKAGE_LIBOPENMPT
	select BR2_PACKAGE_ZLIB
	help
	  This is a Kodi audio decoder addon for tracker module files.

	  https://github.com/xbmc/audiodecoder.openmpt
```

## package/batocera/kodi/kodi20-audiodecoder-sidplay/Config.in
```kconfig
config BR2_PACKAGE_KODI20_AUDIODECODER_SIDPLAY
	bool "kodi20-audiodecoder-sidplay"
	select BR2_PACKAGE_LIBSIDPLAY2
	help
	  Sidplay decoder addon for Kodi

	  https://github.com/xbmc/audiodecoder.sidplay
```

## package/batocera/kodi/kodi20-audiodecoder-snesapu/Config.in
```kconfig
config BR2_PACKAGE_KODI20_AUDIODECODER_SNESAPU
	bool "kodi20-audiodecoder-snesapu"
	help
	  SPC decoder addon for Kodi

	  https://github.com/xbmc/audiodecoder.snesapu
```

## package/batocera/kodi/kodi20-audiodecoder-stsound/Config.in
```kconfig
config BR2_PACKAGE_KODI20_AUDIODECODER_STSOUND
	bool "kodi20-audiodecoder-stsound"
	help
	  YM decoder addon for Kodi

	  https://github.com/xbmc/audiodecoder.stsound
```

## package/batocera/kodi/kodi20-audiodecoder-timidity/Config.in
```kconfig
config BR2_PACKAGE_KODI20_AUDIODECODER_TIMIDITY
	bool "kodi20-audiodecoder-timidity"
	help
	  Timidity decoder addon for Kodi

	  https://github.com/xbmc/audiodecoder.timidity
```

## package/batocera/kodi/kodi20-audiodecoder-vgmstream/Config.in
```kconfig
config BR2_PACKAGE_KODI20_AUDIODECODER_VGMSTREAM
	bool "kodi20-audiodecoder-vgmstream"
	help
	  VGM decoder addon for Kodi

	  https://github.com/xbmc/audiodecoder.vgmstream
```

## package/batocera/kodi/kodi20-audioencoder-flac/Config.in
```kconfig
config BR2_PACKAGE_KODI20_AUDIOENCODER_FLAC
	bool "kodi20-audioencoder-flac"
	select BR2_PACKAGE_FLAC
	select BR2_PACKAGE_KODI20_OPTICALDRIVE
	select BR2_PACKAGE_LIBOGG
	help
	  An audioencoder addon for Kodi

	  https://github.com/xbmc/audioencoder.flac
```

## package/batocera/kodi/kodi20-audioencoder-lame/Config.in
```kconfig
config BR2_PACKAGE_KODI20_AUDIOENCODER_LAME
	bool "kodi20-audioencoder-lame"
	select BR2_PACKAGE_KODI20_OPTICALDRIVE
	select BR2_PACKAGE_LAME
	select BR2_PACKAGE_LIBICONV if !BR2_ENABLE_LOCALE
	help
	  An audioencoder addon for Kodi

	  https://github.com/xbmc/audioencoder.lame
```

## package/batocera/kodi/kodi20-audioencoder-vorbis/Config.in
```kconfig
config BR2_PACKAGE_KODI20_AUDIOENCODER_VORBIS
	bool "kodi20-audioencoder-vorbis"
	select BR2_PACKAGE_KODI20_OPTICALDRIVE
	select BR2_PACKAGE_LIBOGG
	select BR2_PACKAGE_LIBVORBIS
	help
	  An audioencoder addon for Kodi

	  https://github.com/xbmc/audioencoder.vorbis
```

## package/batocera/kodi/kodi20-audioencoder-wav/Config.in
```kconfig
config BR2_PACKAGE_KODI20_AUDIOENCODER_WAV
	bool "kodi20-audioencoder-wav"
	select BR2_PACKAGE_KODI20_OPTICALDRIVE
	help
	  An audioencoder addon for Kodi

	  https://github.com/xbmc/audioencoder.wav
```

## package/batocera/kodi/kodi20-imagedecoder-heif/Config.in
```kconfig
config BR2_PACKAGE_KODI20_IMAGEDECODER_HEIF
	bool "kodi20-imagedecoder-heif"
	select BR2_PACKAGE_LIBDE265
	select BR2_PACKAGE_LIBHEIF
	select BR2_PACKAGE_LIBXML2
	help
	  Kodi .heif imagedecoder

	  https://github.com/xbmc/imagedecoder.heif
```

## package/batocera/kodi/kodi20-imagedecoder-raw/Config.in
```kconfig
config BR2_PACKAGE_KODI20_IMAGEDECODER_RAW
	bool "kodi20-imagedecoder-raw"
	select BR2_PACKAGE_LIBRAW
	select BR2_PACKAGE_JPEG_TURBO
	select BR2_PACKAGE_LCMS2
	help
	  Kodi .raw imagedecoder

	  https://github.com/xbmc/imagedecoder.raw
```

## package/batocera/kodi/kodi20-inputstream-adaptive/Config.in
```kconfig
config BR2_PACKAGE_KODI20_INPUTSTREAM_ADAPTIVE
	bool "kodi20-inputstream-adaptive"
	# wvdecrypter/cdm/build/build_config.h
	depends on BR2_aarch64 || BR2_arm || BR2_i386 || BR2_mipsel \
		|| BR2_mips64el || BR2_x86_64 || BR2_riscv
	select BR2_PACKAGE_EXPAT
	select BR2_PACKAGE_BENTO4
	help
	  Kodi inputstream addon for several manifest types

	  https://github.com/xbmc/inputstream.adaptive
```

## package/batocera/kodi/kodi20-inputstream-rtmp/Config.in
```kconfig
config BR2_PACKAGE_KODI20_INPUTSTREAM_RTMP
	bool "kodi20-inputstream-rtmp"
	select BR2_PACKAGE_OPENSSL
	select BR2_PACKAGE_RTMPDUMP
	select BR2_PACKAGE_ZLIB
	help
	  RTMP input stream add-on for Kodi

	  https://github.com/xbmc/inputstream.rtmp
```

## package/batocera/kodi/kodi20-kodi-platform/Config.in
```kconfig
config BR2_PACKAGE_KODI20_KODI_PLATFORM
	bool "kodi20-kodi-platform"
	help

	  https://github.com/xbmc/kodi-platform
```
