## package/batocera/audio/steamdeck-dsp/Config.in
```kconfig
config BR2_PACKAGE_STEAMDECK_DSP
	bool "steamdeck-dsp"
	depends on BR2_PACKAGE_PIPEWIRE
	depends on BR2_PACKAGE_WIREPLUMBER
	select BR2_PACKAGE_ALSA_UCM_CONF
	select BR2_PACKAGE_LILV # pipewire lv2 filter-graph, oled speakers
	select BR2_PACKAGE_SOUND_OPEN_FIRMWARE
	help
	  Installs Steam Deck specific audio configurations.

	  https://steamdeck-packages.steamos.cloud/archlinux-mirror/jupiter-main
```

## package/batocera/audio/swh-plugins/Config.in
```kconfig
config BR2_PACKAGE_SWH_PLUGINS
	bool "swh-plugins"
	help
	  Steve Harris' LADSPA plugins: the SC4 compressor and the fast
	  lookahead limiter, for PipeWire filter-chains.

	  https://github.com/swh/ladspa
```

## package/batocera/boot/batocera-rkbin/Config.in
```kconfig
config BR2_PACKAGE_BATOCERA_RKBIN
	bool "batocera-rkbin"
	help
	  Versioned, validated Rockchip firmware and host packaging tools.
	  Preserves the firmware versions selected by each board.
```

## package/batocera/boot/openabl/Config.in
```kconfig
config BR2_PACKAGE_OPENABL
	bool "openabl"
	depends on BR2_aarch64
	select BR2_PACKAGE_PV
	help
	  Qualcomm's Android Bootloader (ABL) with a graphical boot menu
	  and standard Linux boot, built for the board's chipset.
	  Installs the signed ABL image and updateabl to flash it.

	  https://github.com/OpenHandheldCollective/OpenABL

if BR2_PACKAGE_OPENABL

config BR2_PACKAGE_OPENABL_STANDARD_BOOT
	bool "standard boot"
	default y
	help
	  UEFI boot manager, Boot Loader Specification entries, unified
	  kernel images, extlinux.conf and the card boot logo. Without
	  it Linux boots only from Android boot images.

config BR2_PACKAGE_OPENABL_ZH_HANS
	bool "Simplified Chinese menu"

config BR2_PACKAGE_OPENABL_DEBUG
	bool "debug build"
	help
	  Adds a Debug section to the boot menu.

endif
```

## package/batocera/boot/uboot-anbernic-h700/Config.in
```kconfig
config BR2_PACKAGE_UBOOT_ANBERNIC_H700
    bool "uboot-anbernic-h700"
    help
      U-Boot for the Anbernic H700 devices.

      https://u-boot.org/
```

## package/batocera/boot/uboot-gameforce-ace/Config.in
```kconfig
config BR2_PACKAGE_UBOOT_GAMEFORCE_ACE
    bool "uboot-gameforce-ace"
    help
      U-Boot files for the Gameforce Ace handheld.
      Currently uses OrangePi 5 until mainline is fixed.

      https://github.com/orangepi-xunlong/orangepi-build
```

## package/batocera/boot/uboot-odroid-m1/Config.in
```kconfig
config BR2_PACKAGE_UBOOT_ODROID_M1
    bool "uboot files for HardKernel ODROID M1"
    help
        uboot files for ODROID M1

        Builds the main-stage U-Boot (u-boot.itb) from upstream source
        using this board's own mainline defconfig, and ships it alongside
        Hardkernel's prebuilt SPL (idbloader.img).
```

## package/batocera/boot/uboot-powkiddy-a13/Config.in
```kconfig
config BR2_PACKAGE_UBOOT_POWKIDDY_A13
    bool "uboot-powkiddy-a13"
    select BR2_PACKAGE_BATOCERA_RKBIN
    help
        uboot files for POWKIDDY_A13
```

## package/batocera/boot/uboot-ps7000/Config.in
```kconfig
config BR2_PACKAGE_UBOOT_PS7000
    bool "uboot-ps7000"
    select BR2_PACKAGE_BATOCERA_RKBIN
    help
        uboot files for PS7000
```

## package/batocera/boot/uboot-rk3326-mainline/Config.in
```kconfig
config BR2_PACKAGE_UBOOT_RK3326_MAINLINE
	bool "uboot-rk3326-mainline"
	help
	  Mainline U-Boot for the RK3326 handhelds the legacy u-boot
	  cannot tell apart (EE clones, RGB10X, RGB20S, XU Mini M,
	  G350, R36 Ultra, GKD Pixel2).

	  https://www.denx.de/wiki/U-Boot

if BR2_PACKAGE_UBOOT_RK3326_MAINLINE

config BR2_PACKAGE_UBOOT_RK3326_MAINLINE_UART5
	bool "Use UART5 for debug console"
	help
	  Select this if your RK3326-based handheld is a clone
	  that uses UART5 for the debug console (e.g., K36 clones).

endif
```

## package/batocera/boot/uboot-rk3326/Config.in
```kconfig
config BR2_PACKAGE_UBOOT_RK3326
	bool "uboot-rk3326"
	help
	  Legacy hardkernel U-Boot (ROCKNIX fork) for RK3326 handhelds
	  that are detected by the board ID ADC.

	  https://github.com/ROCKNIX/hardkernel-uboot
```

## package/batocera/boot/uboot-rk3562/Config.in
```kconfig
config BR2_PACKAGE_UBOOT_RK3562
	bool "uboot-rk3562"
	select BR2_PACKAGE_RKBIN
	help
	  Mainline U-Boot for RK3562 boards
```

## package/batocera/boot/uboot-rk356x/Config.in
```kconfig
config BR2_PACKAGE_UBOOT_RK356X
    bool "uboot-rk356x"
    select BR2_PACKAGE_BATOCERA_RKBIN
    help
      U-Boot for multiple RK356x boards.

      https://u-boot.org/
```

## package/batocera/boot/uboot-rk3588/Config.in
```kconfig
config BR2_PACKAGE_UBOOT_RK3588
    bool "uboot-rk3588"
    select BR2_PACKAGE_BATOCERA_RKBIN
    help
      u-boot for multiple RK3588 boards
```

## package/batocera/controllers/coin-mechanism/chronic-concepts-insert-coin/Config.in
```kconfig
config BR2_PACKAGE_CHRONIC_CONCEPTS_INSERT_COIN
    bool "chronic-concepts-insert-coin"
    help
      https://chronicconcepts.com/pages/tinybrights-insert-coin-cube-gen-2-product-user-manual
```

## package/batocera/controllers/pads/fun-r1-gamepad/Config.in
```kconfig
config BR2_PACKAGE_FUN_R1_GAMEPAD
    bool "fun-r1-gamepad"
    help
      Driver for Unico FUN R1 Dual Controllers

      Cesar Talon <ctalon@gmail.com> [@acmeplus]
```

## package/batocera/controllers/wheels/hid-tmff2/Config.in
```kconfig
config BR2_PACKAGE_HID_TMFF2
	bool "hid-tmff2"
	help
	  Force feedback driver for the Thrustmaster T300RS, T248
	  and (experimental) TX, T128, T-GT II and TS-XW wheels.

	  https://github.com/Kimplul/hid-tmff2
```

## package/batocera/controllers/wheels/logi-wheel/Config.in
```kconfig
config BR2_PACKAGE_LOGI_WHEEL
	bool "logi-wheel"
	depends on BR2_PACKAGE_HOST_RUSTC_TARGET_ARCH_SUPPORTS
	help
	    Terminal settings app for the wheels driven by the
	    logitech-trueforce module (RS50, G PRO, G923): rotation range,
	    force feedback gains, pedal curves, LIGHTSYNC and the onboard
	    profile slots, through the driver's wheel_* sysfs knobs.

	    Also installs the two wine helpers the app drives: logi-ffb,
	    a force feedback proxy for the DirectInput games that need
	    PROTON_ENABLE_HIDRAW=1, and logi-tf-sim, which synthesizes
	    TrueForce and the rev lights from the UDP telemetry of a few
	    PC titles.

	    https://github.com/mescon/logitech-trueforce-linux-driver

if BR2_PACKAGE_LOGI_WHEEL

config BR2_PACKAGE_LOGI_WHEEL_GUI
	bool "logi-wheel-gui"
	default y if BR2_PACKAGE_XORG7 && BR2_PACKAGE_HAS_LIBEGL && BR2_PACKAGE_HAS_LIBGLES
	select BR2_PACKAGE_FONTCONFIG
	select BR2_PACKAGE_LIBXKBCOMMON
	select BR2_PACKAGE_XLIB_LIBX11
	help
	    Same settings as the terminal app, as a Slint desktop
	    application. It draws with OpenGL ES through a winit window, so
	    it needs the X11 session batocera starts for its desktop mode,
	    where it shows up as logi-wheel-config.

	    Only enable this on a target that has xorg and an EGL / OpenGL
	    ES stack, it will not build without them.

endif
```

## package/batocera/controllers/wheels/logitech-trueforce/Config.in
```kconfig
config BR2_PACKAGE_LOGITECH_TRUEFORCE
	bool "logitech-trueforce"
	help
	    Force feedback and TrueForce driver for the Logitech direct
	    drive wheels (RS50, G PRO Racing Wheel for Xbox/PC and PS/PC).

	    Builds as hid-logitech-dd, which binds only those wheels and
	    runs alongside the in-tree hid-logitech-hidpp.

	    It also supports the belt driven G923 (PS and Xbox), but that
	    wheel is left to new-lg4ff (hid-logitech-new) here, so the
	    driver declines it unless it is loaded with g923=1.

	    https://github.com/mescon/logitech-trueforce-linux-driver
```

## package/batocera/emulationstation/batocera-es-system/Config.in
```kconfig
config BR2_PACKAGE_BATOCERA_ES_SYSTEM
	bool "batocera-es-system"
	select BR2_PACKAGE_BATOCERA_LAUNCH
	help
	  Generates the es_system.cfg file and the roms folder
```

## package/batocera/emulators/armsx2/Config.in
```kconfig
config BR2_PACKAGE_ARMSX2
    bool "armsx2"
    depends on BR2_aarch64
    depends on BR2_TOOLCHAIN_HAS_THREADS
    depends on BR2_TOOLCHAIN_HAS_THREADS_NPTL
    depends on BR2_TOOLCHAIN_GCC_AT_LEAST_10
    select BR2_PACKAGE_ALSA_LIB
    select BR2_PACKAGE_BATOCERA_QT6
    select BR2_PACKAGE_BR2_PACKAGE_FMT
    select BR2_PACKAGE_DEJAVU
    select BR2_PACKAGE_ECM
    select BR2_PACKAGE_FREETYPE
    select BR2_PACKAGE_KDDOCKWIDGETS
    select BR2_PACKAGE_LIBAIO
    select BR2_PACKAGE_LIBBACKTRACE
    select BR2_PACKAGE_LIBCURL
    select BR2_PACKAGE_LIBGTK3
    select BR2_PACKAGE_LIBPCAP
    select BR2_PACKAGE_LIBPNG
    select BR2_PACKAGE_LIBSAMPLERATE
    select BR2_PACKAGE_LIBSOUNDTOUCH
    select BR2_PACKAGE_PLUTOSVG
    select BR2_PACKAGE_PORTAUDIO
    select BR2_PACKAGE_RAPIDYAML
    select BR2_PACKAGE_SDL3
    select BR2_PACKAGE_SHADERC
    select BR2_PACKAGE_VULKAN_HEADERS    if BR2_PACKAGE_BATOCERA_VULKAN
    select BR2_PACKAGE_VULKAN_LOADER     if BR2_PACKAGE_BATOCERA_VULKAN
    select BR2_PACKAGE_WEBP
    select BR2_PACKAGE_WXWIDGETS
    select BR2_PACKAGE_YAML_CPP
    select BR2_PACKAGE_ZLIB
    help
      ARMSX2 - PlayStation 2 Emulator for ARM64 platforms.
      This is an ARM64-focused fork of PCSX2 with native ARM64 JIT.
```

## package/batocera/emulators/eka2l1/Config.in
```kconfig
config BR2_PACKAGE_EKA2L1
    bool "eka2l1"
    select BR2_PACKAGE_BATOCERA_QT6
    # in-game pad remapping screen (batocera_launch/emulators/eka2l1_remap.py)
    select BR2_PACKAGE_PYTHON_GOBJECT
    select BR2_PACKAGE_LIBGTK3
    select BR2_PACKAGE_GTK_LAYER_SHELL if BR2_PACKAGE_WAYLAND
    help
      Symbian OS / N-Gage emulator

	    https://github.com/EKA2L1/EKA2L1
```
