## package/batocera/utils/ledspicer/Config.in
```kconfig
config BR2_PACKAGE_LEDSPICER
    bool "ledspicer"
    depends on BR2_PACKAGE_HAS_UDEV
    select BR2_PACKAGE_TINYXML2
    select BR2_PACKAGE_LIBUSB
    select BR2_PACKAGE_PULSEAUDIO
    select BR2_PACKAGE_ALSA_LIB
    select BR2_PACKAGE_LIBTOOL
    select BR2_PACKAGE_LIBPTHREAD_STUBS
    select BR2_PACKAGE_PIGPIO if BR2_arm || BR2_aarch64
    help
        LED Manager for Linux

        https://sourceforge.net/projects/ledspicer/
        https://github.com/meduzapat/LEDSpicer
```

## package/batocera/utils/mangohud/Config.in
```kconfig
config BR2_PACKAGE_MANGOHUD
	bool "mangohud"
	depends on BR2_PACKAGE_WAYLAND || BR2_PACKAGE_XORG7 || BR2_PACKAGE_LIBDRM
	depends on BR2_PACKAGE_DBUS
	select BR2_PACKAGE_JSON_FOR_MODERN_CPP
	select BR2_PACKAGE_LIBXKBCOMMON
	help
	  Command line tool for injecting HUD / overlay in GL/Vulkan apps

          https://github.com/flightlessmango/MangoHud
```

## package/batocera/utils/mergerfs/Config.in
```kconfig
config BR2_PACKAGE_MERGERFS
    bool "mergerfs"
    help
      mergerfs is a union filesystem for FUSE which allows multiple
      directories to be merged and presented as a single directory tree.

      Homepage: https://github.com/trapexit/mergerfs
```

## package/batocera/utils/mokutil/Config.in
```kconfig
config BR2_PACKAGE_MOKUTIL
        bool "mokutil"
        help
          The utility to manipulate machines owner keys which managed in shim

          https://github.com/lcp/mokutil
```

## package/batocera/utils/moonlight-embedded/Config.in
```kconfig
config BR2_PACKAGE_MOONLIGHT_EMBEDDED
	bool "moonlight-embedded"
	select BR2_PACKAGE_OPUS
	select BR2_PACKAGE_EXPAT
	select BR2_PACKAGE_LIBEVDEV
	select BR2_PACKAGE_AVAHI
	select BR2_PACKAGE_ALSA_LIB
	select BR2_PACKAGE_HAS_UDEV
	select BR2_PACKAGE_LIBCURL
	select BR2_PACKAGE_LIBCEC
	select BR2_PACKAGE_FFMPEG
	select BR2_PACKAGE_FFMPEG_SWSCALE
	select BR2_PACKAGE_SDL2
	select BR2_PACKAGE_LIBENET
    select BR2_PACKAGE_ROCKCHIP_MPP                if BR2_PACKAGE_ROCKCHIP_RGA && !BR2_PACKAGE_HOST_LINUX_HEADERS_CUSTOM_4_4
	select BR2_PACKAGE_FFMPEG_ROCKCHIP             if BR2_PACKAGE_ROCKCHIP_RGA && !BR2_PACKAGE_HOST_LINUX_HEADERS_CUSTOM_4_4
	select BR2_PACKAGE_FFMPEG_ROCKCHIP_GPL         if BR2_PACKAGE_ROCKCHIP_RGA && !BR2_PACKAGE_HOST_LINUX_HEADERS_CUSTOM_4_4
	select BR2_PACKAGE_FFMPEG_ROCKCHIP_NONFREE     if BR2_PACKAGE_ROCKCHIP_RGA && !BR2_PACKAGE_HOST_LINUX_HEADERS_CUSTOM_4_4
	select BR2_PACKAGE_FFMPEG_ROCKCHIP_FFMPEG      if BR2_PACKAGE_ROCKCHIP_RGA && !BR2_PACKAGE_HOST_LINUX_HEADERS_CUSTOM_4_4
	select BR2_PACKAGE_FFMPEG_ROCKCHIP_SWSCALE     if BR2_PACKAGE_ROCKCHIP_RGA && !BR2_PACKAGE_HOST_LINUX_HEADERS_CUSTOM_4_4
	select BR2_PACKAGE_LIBVA_INTEL_DRIVER          if BR2_PACKAGE_BATOCERA_TARGET_X86_ANY
	select BR2_PACKAGE_INTEL_MEDIADRIVER           if BR2_PACKAGE_BATOCERA_TARGET_X86_ANY
	help
	  Gamestream client for embedded systems.

	  https://github.com/moonlight-stream/moonlight-embedded/wiki
```

## package/batocera/utils/moonlight-qt/Config.in
```kconfig
config BR2_PACKAGE_MOONLIGHT_QT
	bool "moonlight-qt"
	select BR2_PACKAGE_MOONLIGHT_COMMON
	select BR2_PACKAGE_QT6
	select BR2_PACKAGE_QT6BASE
	select BR2_PACKAGE_QT6BASE_NETWORK
	# host qmlprofiler is needed, which is part of QtNetwork
	select BR2_PACKAGE_HOST_QT6BASE_NETWORK
	select BR2_PACKAGE_QT6SVG
	select BR2_PACKAGE_QT6DECLARATIVE
	select BR2_PACKAGE_QT6DECLARATIVE_QUICK
	select BR2_PACKAGE_QT6DECLARATIVE_QUICK_CONTROLS2
	select BR2_PACKAGE_QT6WAYLAND    if BR2_PACKAGE_WAYLAND
	select BR2_PACKAGE_OPUS
	select BR2_PACKAGE_SDL2
	select BR2_PACKAGE_SDL2_TTF
	select BR2_PACKAGE_OPENSSL
	select BR2_PACKAGE_FFMPEG
	select BR2_PACKAGE_FFMPEG_SWSCALE
	help
	  GameStream client for PCs

	  https://github.com/moonlight-stream/moonlight-qt
```

## package/batocera/utils/od-commander/Config.in
```kconfig
config BR2_PACKAGE_OD_COMMANDER
	bool "commander"
	select BR2_PACKAGE_SDL2
	select BR2_PACKAGE_SDL2_GFX
	select BR2_PACKAGE_SDL2_IMAGE
	select BR2_PACKAGE_SDL2_TTF
	select BR2_PACKAGE_DEJAVU
	select BR2_PACKAGE_NANUM_FONT
	help
	  Two-pane file manager in the style of Norton Commander.

	  https://github.com/od-contrib/commander

if BR2_PACKAGE_OD_COMMANDER

config BR2_PACKAGE_OD_COMMANDER_FONTS
	string "Font stack"
	default "{\"/usr/share/fonts/dejavu/DejaVuSansCondensed.ttf\",10},{\"/usr/share/fonts/truetype/nanum/NanumMyeongjo.ttf\",10},{\"/usr/share/fonts/truetype/droid/DroidSansFallback.ttf\",9}"

config BR2_PACKAGE_OD_COMMANDER_FONTS_LOW_DPI
	string "Font stack for low DPI displays"
	default "{RES_DIR\"Fiery_Turk.ttf\",8},{\"/usr/share/fonts/dejavu/DejaVuSansCondensed.ttf\",10},{\"/usr/share/fonts/truetype/nanum/NanumMyeongjo.ttf\",10},{\"/usr/share/fonts/truetype/droid/DroidSansFallback.ttf\",9}"

config BR2_PACKAGE_OD_COMMANDER_AUTOSCALE
	bool "Enable automatic screen size and PPU detection"
	default y

config BR2_PACKAGE_OD_COMMANDER_WIDTH
	string "Screen width"
	help
	  Commander will pick the best resolution by default as reported by SDL.
	  If this is unreliable on a given kernel, use this and the HEIGHT option to force a different one.

config BR2_PACKAGE_OD_COMMANDER_HEIGHT
	string "Screen height"

config BR2_PACKAGE_OD_COMMANDER_PPU_X
	string "Horizontal pixels per unit"

config BR2_PACKAGE_OD_COMMANDER_PPU_Y
	string "Vertical pixels per unit"

endif
```

## package/batocera/utils/pacman/Config.in
```kconfig
config BR2_PACKAGE_PACMAN
	bool "pacman"
	select BR2_PACKAGE_LIBARCHIVE
	select BR2_PACKAGE_LIBARCHIVE_BSDTAR
	select BR2_PACKAGE_LIBARCHIVE_BSDCPIO
	select BR2_PACKAGE_LIBARCHIVE_BSDCAT
	select BR2_PACKAGE_OPENSSL
	select BR2_PACKAGE_LIBGPGME
	select BR2_PACKAGE_GNUPG
	select BR2_PACKAGE_GNUPG_AES
	select BR2_PACKAGE_GNUPG_RSA
	select BR2_PACKAGE_GNUPG_GPGV
	select BR2_PACKAGE_GNUPG_GPGSPLIT
	select BR2_PACKAGE_PYTHON_HTTPLIB2 # needed for batocera-pacman-batoexec

	help
	  Arch Linux PACkage MANager. Because of its name, it's the best choice for a retrogaming-oriented distribution :)
 
```

## package/batocera/utils/piboy/Config.in
```kconfig
config BR2_PACKAGE_PIBOY
	bool "piboy"
	depends on BR2_LINUX_KERNEL
	help
	  Kernel module to support hardware from piboy (experimental pi)

comment "piboy needs a kernel and headers"
	depends on !BR2_LINUX_KERNEL
```

## package/batocera/utils/picade/Config.in
```kconfig
config BR2_PACKAGE_PICADE
    bool "picade"
      help
        Adds support for the Pimoroni Picade RPi arcade case

        https://github.com/pimoroni/picade-hat
```

## package/batocera/utils/picom/Config.in
```kconfig
config BR2_PACKAGE_PICOM
    bool "picom"
    select BR2_PACKAGE_LIBCONFIG
    select BR2_PACKAGE_LIBEV
    select BR2_PACKAGE_LIBXCB
    select BR2_PACKAGE_PIXMAN
    select BR2_PACKAGE_UTHASH
    select BR2_PACKAGE_XCB_UTIL
    select BR2_PACKAGE_XCB_UTIL_IMAGE
    select BR2_PACKAGE_XCB_UTIL_RENDERUTIL
    select BR2_PACKAGE_XLIB_LIBX11
    select BR2_PACKAGE_XLIB_LIBXCOMPOSITE
    select BR2_PACKAGE_XLIB_LIBXDAMAGE
    select BR2_PACKAGE_XLIB_LIBXEXT
    select BR2_PACKAGE_XLIB_LIBXFIXES
    select BR2_PACKAGE_XLIB_LIBXPRESENT
    select BR2_PACKAGE_XLIB_LIBXRANDR
    select BR2_PACKAGE_XLIB_LIBXRENDER
    select BR2_PACKAGE_XORGPROTO
    help
      A lightweight compositor for X11 with animation support.

      https://picom.app/
```

## package/batocera/utils/pigo/Config.in
```kconfig
config BR2_PACKAGE_PIGO
        bool "pigo"
        depends on BR2_PACKAGE_HOST_GO_TARGET_ARCH_SUPPORTS
        depends on BR2_PACKAGE_HOST_GO_TARGET_CGO_LINKING_SUPPORTS
	select BR2_PACKAGE_BATOCERA_SCISOR_GUNS
        help
          Fast face/eye tracking module to detect eyes getting open/closed quickly.
          To be used jointly with Batocera scisor-guns (same webcam framework).

          https://github.com/esimov/pigo
```

## package/batocera/utils/pulseaudio-utils/Config.in
```kconfig
config BR2_PACKAGE_PULSEAUDIO_UTILS
	bool "pulseaudio-utils"
	depends on BR2_PACKAGE_PULSEAUDIO_HAS_ATOMIC
	depends on BR2_USE_WCHAR
	depends on BR2_TOOLCHAIN_HAS_THREADS
	depends on !BR2_STATIC_LIBS
	depends on BR2_USE_MMU # fork()
	select BR2_PACKAGE_LIBTOOL
	select BR2_PACKAGE_LIBSNDFILE
	select BR2_PACKAGE_PULSEAUDIO_ENABLE_ATOMIC
	select BR2_PACKAGE_SPEEX
	help
	  PulseAudio is a sound system for POSIX OSes, meaning that it
	  is a proxy for your sound applications. It allows you to do
	  advanced operations on your sound data as it passes between
	  your application and your hardware. Things like transferring
	  the audio to a different machine, changing the sample format
	  or channel count and mixing several sounds into one are
	  easily achieved using a sound server.

	  http://pulseaudio.org

comment "pulseaudio needs a toolchain w/ wchar, threads, dynamic library"
	depends on BR2_USE_MMU
	depends on BR2_PACKAGE_PULSEAUDIO_HAS_ATOMIC
	depends on !BR2_USE_WCHAR || !BR2_TOOLCHAIN_HAS_THREADS || BR2_STATIC_LIBS
```

## package/batocera/utils/pulsemixer/Config.in
```kconfig
config BR2_PACKAGE_PULSEMIXER
	bool "pulsemixer"
	depends on BR2_PACKAGE_PYTHON3
	select BR2_PACKAGE_PYTHON3_CURSES
	depends on BR2_PACKAGE_PULSEAUDIO_UTILS
	help
	  CLI and curses mixer for PulseAudio
```

## package/batocera/utils/python-ndeflib/Config.in
```kconfig
config BR2_PACKAGE_PYTHON_NDEFLIB
       bool "ndeflib"
       depends on BR2_PACKAGE_PYTHON3
       depends on BR2_TOOLCHAIN_HAS_THREADS # libusb
       depends on BR2_TOOLCHAIN_GCC_AT_LEAST_4_9 # libusb

comment "ndeflib needs a toolchain w/ threads, gcc >= 4.9"
       depends on BR2_PACKAGE_PYTHON3
       depends on !BR2_TOOLCHAIN_HAS_THREADS || \
               !BR2_TOOLCHAIN_GCC_AT_LEAST_4_9
```

## package/batocera/utils/python-nfcpy/Config.in
```kconfig
config BR2_PACKAGE_PYTHON_NFCPY
       bool "python-nfcpy"
       depends on BR2_PACKAGE_PYTHON3
       depends on BR2_TOOLCHAIN_HAS_THREADS # libusb
       depends on BR2_TOOLCHAIN_GCC_AT_LEAST_4_9 # libusb
       select BR2_PACKAGE_LIBUSB
       select BR2_PACKAGE_LIBUSB_COMPAT
       select BR2_PACKAGE_PYTHON_LIBUSB1
       select BR2_PACKAGE_PYTHON_PYDES
       help
         Python module for near field communication.

         https://launchpad.net/nfcpy

comment "python-nfcpy needs a toolchain w/ threads, gcc >= 4.9"
       depends on BR2_PACKAGE_PYTHON3
       depends on !BR2_TOOLCHAIN_HAS_THREADS || \
               !BR2_TOOLCHAIN_GCC_AT_LEAST_4_9
```

## package/batocera/utils/rclone/Config.in
```kconfig
config BR2_PACKAGE_RCLONE
    bool "rclone"
    depends on BR2_PACKAGE_HOST_GO_TARGET_ARCH_SUPPORTS
    depends on BR2_PACKAGE_HOST_GO_TARGET_CGO_LINKING_SUPPORTS
    depends on BR2_TOOLCHAIN_HAS_THREADS
    select BR2_PACKAGE_HOST_GO
    help
      rsync for cloud storage.

      https://github.com/rclone/rclone

comment "syncthing needs a toolchain w/ threads"
	depends on BR2_PACKAGE_HOST_GO_TARGET_ARCH_SUPPORTS
	depends on BR2_PACKAGE_HOST_GO_TARGET_CGO_LINKING_SUPPORTS
	depends on !BR2_TOOLCHAIN_HAS_THREADS
```

## package/batocera/utils/re2c/Config.in
```kconfig
config BR2_PACKAGE_RE2C
	bool "re2c"
	help
	  re2c is a free and open-source lexer generator for C, C++ and Go.
```

## package/batocera/utils/retroflag/Config.in
```kconfig
config BR2_PACKAGE_RETROFLAG
        bool "retroflag"
	depends on BR2_PACKAGE_RPI_USERLAND

comment "retroflag"
	depends on BR2_PACKAGE_RPI_USERLAND
```

## package/batocera/utils/rkmpp/Config.in
```kconfig
config BR2_PACKAGE_RKMPP
	bool "rkmpp"
	depends on BR2_PACKAGE_LIBDRM
	help
	  rkmpp: Rockchip Media Process Platform (MPP) module
	  https://github.com/rockchip-linux/mpp

comment "rkmpp"
```

## package/batocera/utils/roshambo-case/Config.in
```kconfig
config BR2_PACKAGE_ROSHAMBO_CASE
	bool "roshambo-case"
	depends on BR2_PACKAGE_PYTHON3
	help
	  Scripts to enable the LED, Fan, and Buttons on the Kintaro SNES and Roshambo Super Famicom Cases.
```

## package/batocera/utils/rpi-eeprom/Config.in
```kconfig
config BR2_PACKAGE_RPI_EEPROM
	bool "rpi-eeprom"
	depends on BR2_PACKAGE_PYTHON3
	select BR2_PACKAGE_BINUTILS
	select BR2_PACKAGE_BINUTILS_TARGET
	select BR2_PACKAGE_RPI_UTILS
	help
	  Installation scripts and binaries for the Raspberry Pi 4
	  and Raspberry Pi 5 bootloader EEPROMs.

	  https://github.com/raspberrypi/rpi-eeprom
```

## package/batocera/utils/rpi-utils/Config.in
```kconfig
config BR2_PACKAGE_RPI_UTILS
	bool "rpi-utils"
	select BR2_PACKAGE_DTC
	select BR2_PACKAGE_NCURSES
	help
	  A collection of RPi scripts and simple applications.

	  https://github.com/raspberrypi/utils
```
