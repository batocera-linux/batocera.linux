## package/batocera/utils/zramswap/Config.in
```kconfig
config BR2_PACKAGE_ZRAMSWAP
        bool "zramswap"
        help
          Service to enable swap on zram
```

## package/batocera/wine/dxvk/Config.in
```kconfig
config BR2_PACKAGE_DXVK
	bool "dxvk"
    depends on BR2_i386 || BR2_x86_64
	# Wine unconditionally builds shared libraries
	depends on !BR2_STATIC_LIBS
	depends on BR2_PACKAGE_SPIRV_HEADERS
	help
      DXVK is a Vulkan-based translation layer for Direct3D 9/10/11
	  which allows running 3D applications on Linux using Wine.

	  https://github.com/doitsujin/dxvk

comment "dxvk needs a toolchain w/ dynamic library"
	depends on BR2_STATIC_LIBS
```

## package/batocera/wine/rtkit/Config.in
```kconfig
config BR2_PACKAGE_RTKIT
	bool "rtkit"
	select BR2_PACKAGE_LIBCAP
	select BR2_PACKAGE_POLKIT
	# Wine unconditionally builds shared libraries
	depends on !BR2_STATIC_LIBS
	help
      RealtimeKit: Realtime Policy and Watchdog Daemon.

	  https://gitlab.freedesktop.org/pipewire/rtkit

comment "rtkit needs a toolchain w/ dynamic library"
	depends on BR2_STATIC_LIBS
```

## package/batocera/wine/vkd3d-proton/Config.in
```kconfig
config BR2_PACKAGE_VKD3D_PROTON
	bool "vkd3d_proton"
    depends on BR2_i386 || BR2_x86_64
	# Wine unconditionally builds shared libraries
	depends on !BR2_STATIC_LIBS
	depends on BR2_PACKAGE_SPIRV_HEADERS
	depends on BR2_PACKAGE_DXVK
	help
      vkd3d-proton is a fork of VKD3D, which aims to implement the full Direct3D 12 API on top of Vulkan.
	  The project serves as the development effort for Direct3D 12 support in Proton.

	  https://github.com/HansKristian-Work/vkd3d-proton

comment "vkd3d_proton needs a toolchain w/ dynamic library"
	depends on BR2_STATIC_LIBS
```

## package/batocera/wine/wine-common/Config.in
```kconfig
config BR2_PACKAGE_WINE_COMMON
	bool "wine-common"
	help
	  A set of WINE based emulator configuration options.
```

## package/batocera/wine/wine-mono/Config.in
```kconfig
config BR2_PACKAGE_WINE_MONO
	bool "wine-mono"
  depends on BR2_i386 || BR2_x86_64
  help
    Wine Mono is a package containing Framework Mono and other projects,
    intended as a replacement for the .NET Framework (4.8.1 and earlier) in Wine.
    It works in conjunction with Wine's builtin mscoree.dll,
    and it is not intended to be useful for any other purpose.

    https://github.com/wine-mono/wine-mono
```

## package/batocera/wine/wine-proton/Config.in
```kconfig
config BR2_PACKAGE_WINE_PROTON
	bool "wine-proton"
    depends on BR2_i386 || BR2_x86_64
	help
      Proton is a Wine build modified by Valve and other contributors.
      It contains many useful patches (primarily for a better gaming experience),
      some of them are unique and not present in other builds.
      The differences from the official Steam's Proton are the lack of the Proton's python script
      and the lack of some builtin dlls (like DXVK and vkd3d-proton).

	  https://github.com/Kron4ek/Wine-Builds
```

## package/batocera/wine/wine-x86/Config.in
```kconfig
config BR2_PACKAGE_WINE_X86
    bool "wine-x86"
    help
      Associated 32-bit binaries & libraries precompiled for
      WINE, Lindbergh Loader & PortMaster.

      https://github.com/batocera-linux/wine-x86
```

## package/batocera/wine/winetricks/Config.in
```kconfig
config BR2_PACKAGE_WINETRICKS
	bool "WINETRICKS"
	depends on BR2_PACKAGE_WINE_TKG
	help
	  Winetricks is an easy way to work around problems in Wine.

	  https://github.com/Winetricks/winetricks
```

## package/batocera/xarcade2jstick/Config.in
```kconfig
config BR2_PACKAGE_XARCADE2JSTICK
	bool "Petrockblock's XArcade2Jstock"
	help
	  Creates joystick devs from XArcade
	  http://blog.petrockblock.com/2014/06/01/xarcade2jstick/

comment "XARCADE2JSTICK needs a toolchain w/ C++"
```

## package/dolphin-emu/Config.in
```kconfig
config BR2_PACKAGE_DOLPHIN_EMU
        bool "dolphin-emu"
	depends on BR2_x86_64
	depends on BR2_PACKAGE_XORG7
	select BR2_PACKAGE_LIBEVDEV
	select BR2_PACKAGE_FFMPEG
	select BR2_PACKAGE_ZLIB
	select BR2_PACKAGE_LIBPNG
	select BR2_PACKAGE_LZO
	select BR2_PACKAGE_LIBUSB
	select BR2_PACKAGE_LIBCURL
	select BR2_PACKAGE_SFML
	select BR2_PACKAGE_BLUEZ5_UTILS
	select BR2_PACKAGE_WXWIDGETS
	select BR2_PACKAGE_HIDAPI
        help
          A  gamecube/wii emulator
```

## package/dosbox/Config.in
```kconfig
config BR2_PACKAGE_DOSBOX
	bool "dosbox"
        depends on BR2_INSTALL_LIBSTDCPP
        depends on BR2_PACKAGE_SDL2
        select BR2_PACKAGE_ZLIB
        select BR2_PACKAGE_LIBPNG
        select BR2_PACKAGE_LIBOGG
        select BR2_PACKAGE_LIBVORBIS
        select BR2_PACKAGE_SDL_SOUND
        select BR2_PACKAGE_SDL_NET

	help
	  DOSBox is a DOS-emulator that uses the SDL-library 
          which makes DOSBox very easy to port to different platforms

	  http://www.dosbox.com/
```

## package/fluidsynth/Config.in
```kconfig
config BR2_PACKAGE_FLUIDSYNTH
        bool "Fluidsynth"
	depends on BR2_INSTALL_LIBSTDCPP

        help
          Fludsynth

	  http://sourceforge.net/projects/fluidsynth/
```

## package/freeimage/Config.in
```kconfig
config BR2_PACKAGE_FREEIMAGE
	bool "freeimage"
	help
	  an image manipulation library.

	  http://freeimage.sourceforge.net
```

## package/gamecon_gpio_rpi/Config.in
```kconfig
config BR2_PACKAGE_GAMECON_GPIO_RPI
	bool "gamecon gpio driver"
	depends on BR2_LINUX_KERNEL
	help
	  Kernel module to support snes,nes,psx joysticks on gpios

comment "gamecon needs a kernel and headers"
	depends on !BR2_LINUX_KERNEL
```

## package/jstest2/Config.in
```kconfig
config BR2_PACKAGE_JSTEST2
	bool "JSTEST2"
	depends on BR2_PACKAGE_SDL BR2_PACKAGE_SDL2
	help
	  Command line tool to test the joysticks with sdl2

	  https://github.com/Grumbel/sdl-jstest
```

## package/kodi-plugin-video-filmon/Config.in
```kconfig
config BR2_PACKAGE_KODI_PLUGIN_VIDEO_FILMON
    depends on BR2_PACKAGE_KODI
    bool "kodi-plugin-video-filmon"
    default y
    select BR2_PACKAGE_KODI_SCRIPT_MODULE_T0MM0_COMMON
    help
      Kodi FilmOn Plugin

      https://kodi.tv
```

## package/kodi-plugin-video-youtube/Config.in
```kconfig
config BR2_PACKAGE_KODI_PLUGIN_VIDEO_YOUTUBE
    depends on BR2_PACKAGE_KODI
    bool "kodi-plugin-video-youtube"
    default y
    help
      Kodi Youtube Plugin

      https://kodi.tv
```

## package/kodi-resource-language-de_de/Config.in
```kconfig
config BR2_PACKAGE_KODI_RESOURCE_LANGUAGE_de_de
    depends on BR2_PACKAGE_KODI
    bool "kodi-resource-language-de_de"
    default y
    help
      Kodi de_de language resource

      https://kodi.tv
```

## package/kodi-resource-language-es_es/Config.in
```kconfig
config BR2_PACKAGE_KODI_RESOURCE_LANGUAGE_es_es
    depends on BR2_PACKAGE_KODI
    bool "kodi-resource-language-es_es"
    default y
    help
      Kodi es_es language resource

      https://kodi.tv
```

## package/kodi-resource-language-eu_es/Config.in
```kconfig
config BR2_PACKAGE_KODI_RESOURCE_LANGUAGE_eu_es
    depends on BR2_PACKAGE_KODI
    bool "kodi-resource-language-eu_es"
    default y
    help
      Kodi eu_es language resource

      https://kodi.tv
```

## package/kodi-resource-language-fr_fr/Config.in
```kconfig
config BR2_PACKAGE_KODI_RESOURCE_LANGUAGE_fr_fr
    depends on BR2_PACKAGE_KODI
    bool "kodi-resource-language-fr_fr"
    default y
    help
      Kodi fr_fr language resource

      https://kodi.tv
```

## package/kodi-resource-language-it_it/Config.in
```kconfig
config BR2_PACKAGE_KODI_RESOURCE_LANGUAGE_it_it
    depends on BR2_PACKAGE_KODI
    bool "kodi-resource-language-it_it"
    default y
    help
      Kodi it_it language resource

      https://kodi.tv
```

## package/kodi-resource-language-pt_br/Config.in
```kconfig
config BR2_PACKAGE_KODI_RESOURCE_LANGUAGE_pt_br
    depends on BR2_PACKAGE_KODI
    bool "kodi-resource-language-pt_br"
    default y
    help
      Kodi pt_br language resource

      https://kodi.tv
```

## package/kodi-resource-language-sv_se/Config.in
```kconfig
config BR2_PACKAGE_KODI_RESOURCE_LANGUAGE_sv_se
    depends on BR2_PACKAGE_KODI
    bool "kodi-resource-language-sv_se"
    default y
    help
      Kodi sv_se language resource

      https://kodi.tv
```
