## package/batocera/utils/ryzen-smu/Config.in
```kconfig
comment "ryzen-smu needs a Linux kernel to be built"
	depends on !BR2_LINUX_KERNEL

config BR2_PACKAGE_RYZEN_SMU
	bool "ryzen-smu"
	depends on BR2_LINUX_KERNEL
	help
	  Ryzen SMU is a Linux kernel driver that exposes access to the
	  SMU (System Management Unit) for certain AMD Ryzen Processors.

	  https://github.com/amkillam/ryzen_smu
```

## package/batocera/utils/ryzenadj/Config.in
```kconfig
config BR2_PACKAGE_RYZENADJ
    bool "ryzenadj"
    depends on BR2_x86_64
    select BR2_PACKAGE_PCIUTILS
    select BR2_PACKAGE_LIBPCIACCESS
    help
      Adjust power management settings for Mobile Raven Ridge Ryzen Processors

      https://github.com/FlyGoat/RyzenAdj
```

## package/batocera/utils/sdl2-touch-test/Config.in
```kconfig
config BR2_PACKAGE_SDL2_TOUCH_TEST
    bool "sdl2-touch-test"
    select BR2_PACKAGE_SDL2
    select BR2_PACKAGE_SDL2_TTF
    select BR2_PACKAGE_UDEV
    help
      Small little SDL2 graphics utility to test touch accuracy.
      Great to help troubleshoot multiple touchscreen devices.
      
      https://github.com/batocera-linux/batocera.linux
```

## package/batocera/utils/smpq/Config.in
```kconfig
config BR2_PACKAGE_SMPQ
	bool "smpq"
	select BR2_PACKAGE_SMPQ
	help
	  StormLib MPQ archiving utility

	  This utility manipulates Blizzard MPQ archives.
	  It supports extracting, appending, renaming and deleting files
	  in MPQ archives, and creating new MPQ archives.

	  https://launchpad.net/smpq
```

## package/batocera/utils/switchres/Config.in
```kconfig
config BR2_PACKAGE_SWITCHRES
	bool "switchres"
	depends on BR2_PACKAGE_LIBDRM
	depends on BR2_PACKAGE_SDL2
	depends on BR2_PACKAGE_SDL2_TTF
	help
	  Command line tool for modeline generation
	  
	  https://github.com/antonioginer/switchres
```

## package/batocera/utils/syncthing/Config.in
```kconfig
config BR2_PACKAGE_SYNCTHING
        bool "syncthing"
        depends on BR2_PACKAGE_HOST_GO_TARGET_ARCH_SUPPORTS
        depends on BR2_PACKAGE_HOST_GO_TARGET_CGO_LINKING_SUPPORTS
        depends on BR2_TOOLCHAIN_HAS_THREADS
        help
          Open Source Continuous File Synchronization.

          https://github.com/syncthing/syncthing

comment "syncthing needs a toolchain w/ threads"
	depends on BR2_PACKAGE_HOST_GO_TARGET_ARCH_SUPPORTS
	depends on BR2_PACKAGE_HOST_GO_TARGET_CGO_LINKING_SUPPORTS
	depends on !BR2_TOOLCHAIN_HAS_THREADS
```

## package/batocera/utils/touchegg/Config.in
```kconfig
config BR2_PACKAGE_TOUCHEGG
	bool "touchegg"
	select BR2_PACKAGE_XINPUT
	select BR2_PACKAGE_LIBINPUT
	select BR2_PACKAGE_CAIRO
	select BR2_PACKAGE_PUGIXML
	select BR2_PACKAGE_XLIB_LIBXTST
	help
	  Extended support for touchscreens

	  https://github.com/JoseExposito/touchegg
```

## package/batocera/utils/unclutter/Config.in
```kconfig
config BR2_PACKAGE_UNCLUTTER
	bool "unclutter"
	depends on BR2_PACKAGE_XORG7
	select BR2_PACKAGE_LIBEV
	help
	  This is a rewrite of the popular tool unclutter, but using the x11-xfixes extension.
```

## package/batocera/utils/vdpauinfo/Config.in
```kconfig
config BR2_PACKAGE_VDPAUINFO
	bool "vdpauinfo"
	select BR2_PACKAGE_LIBVDPAU
	select BR2_PACKAGE_XLIB_LIBX11
	help
	  Command line utility for querying the capabilities of a VDPAU device.
```

## package/batocera/utils/vkbasalt/Config.in
```kconfig
config BR2_PACKAGE_VKBASALT
        bool "vkbasalt"
        depends on !BR2_STATIC_LIBS
        depends on BR2_PACKAGE_XORG7
        depends on BR2_TOOLCHAIN_HAS_THREADS
        help
          A vulkan post processing layer for linux.

          https://github.com/DadSchoorse/vkBasalt
```

## package/batocera/utils/wf-recorder/Config.in
```kconfig
config BR2_PACKAGE_WF_RECORDER
    bool "wf-recorder"
    depends on BR2_PACKAGE_WAYLAND
    select BR2_PACKAGE_FFMPEG
    select BR2_PACKAGE_FFMPEG_GPL
    select BR2_PACKAGE_FFMPEG_FFPROBE
    select BR2_PACKAGE_FFMPEG_SWSCALE
    select BR2_PACKAGE_FFMPEG_POSTPROC
    select BR2_PACKAGE_X264
    select BR2_PACKAGE_X265
    select BR2_PACKAGE_PULSEAUDIO
    help
        wf-recorder is a utility program for screenrecording
        of wlroots-based compositors (more specifically, those
        that support wlr-screencopy-v1 and xdg-output).

	    https://github.com/ammen99/wf-recorder
```

## package/batocera/utils/wii-u-gc-adapter/Config.in
```kconfig
config BR2_PACKAGE_WII_U_GC_ADAPTER
	bool "wii-u-gc-adapter"
	select BR2_PACKAGE_DBUS
	select BR2_PACKAGE_LIBUSB
	select BR2_PACKAGE_NCURSES
	help
	  wii-u-gc receiver daemon
```

## package/batocera/utils/winbtrfs/Config.in
```kconfig
config BR2_PACKAGE_WINBTRFS
        bool "winbtrfs"
        help
          driver to mount btrfs on windows
```

## package/batocera/utils/winetricks/Config.in
```kconfig
config BR2_PACKAGE_WINETRICKS
	bool "WINETRICKS"
	depends on BR2_PACKAGE_WINE_LUTRIS
	help
	  wine tricks

	  https://github.com/Winetricks/winetricks
```

## package/batocera/utils/wireguard-service/Config.in
```kconfig
config BR2_PACKAGE_WIREGUARD_SERVICE
    bool "wireguard-service"
    select BR2_PACKAGE_WIREGUARD_TOOLS
    help
      Service that runs wg-quick on /userdata/system/wireguard/*.conf
```

## package/batocera/utils/wlr-randr/Config.in
```kconfig
config BR2_PACKAGE_WLR_RANDR
    bool "wlr-randr"
    depends on BR2_PACKAGE_WAYLAND
    help
        Utility to manage outputs of a Wayland compositor.

	    https://git.sr.ht/~emersion/wlr-randr
```

## package/batocera/utils/wlrctl/Config.in
```kconfig
config BR2_PACKAGE_WLRCTL
    bool "wlrctl"
    select BR2_PACKAGE_WAYLAND
    help
      wlrctl is a command line utility for miscellaneous wlroots Wayland
      extensions (foreign-toplevel-management, virtual-keyboard, virtual-pointer).
```

## package/batocera/utils/wsdd-native/Config.in
```kconfig
config BR2_PACKAGE_WSDD_NATIVE
        bool "wsdd-native"
	select BR2_HOST_CMAKE_AT_LEAST_3_26

        help
          wsdd implements a Web Service Discovery host daemon. This
          enables (Samba) hosts, like your local NAS device, to be
          found by Web Service Discovery Clients like Windows.

          https://github.com/gershnik/wsdd-native
```

## package/batocera/utils/wsdd/Config.in
```kconfig
config BR2_PACKAGE_WSDD
        bool "wsdd"
        help
          wsdd implements a Web Service Discovery host daemon. This
          enables (Samba) hosts, like your local NAS device, to be
          found by Web Service Discovery Clients like Windows.

          https://github.com/christgau/wsdd
```

## package/batocera/utils/wtype/Config.in
```kconfig
config BR2_PACKAGE_WTYPE
	bool "wtype"
	select BR2_PACKAGE_LIBXKBCOMMON
	select BR2_PACKAGE_WAYLAND
	help
	  xdotool type for wayland.

	  https://github.com/atx/wtype
```

## package/batocera/utils/x86-64-level/Config.in
```kconfig
config BR2_PACKAGE_X86_64_LEVEL
	bool "x86-64-level"
	help
	  A script to check compatibility to migrate from X86_64 to X86-64-v3 images.
```

## package/batocera/utils/xosd/Config.in
```kconfig
config BR2_PACKAGE_XOSD
        bool "xosd"
	depends on BR2_PACKAGE_XORG7
        help
          overlay text on a X display
```

## package/batocera/utils/xow/Config.in
```kconfig
config BR2_PACKAGE_XOW
	bool "xow"
	select BR2_PACKAGE_LIBUSB

	help
	  xbox receiver daemon
```

## package/batocera/utils/xwiimote/Config.in
```kconfig
config BR2_PACKAGE_XWIIMOTE
	bool "xwiimote"
	depends on BR2_PACKAGE_HAS_UDEV
	select BR2_PACKAGE_NCURSES
	help
	  a tool to analyze the wiimote events
```

## package/batocera/utils/xxd/Config.in
```kconfig
config BR2_PACKAGE_XXD
	bool "xxd"
	help
	  xxd - a hexdump utility by Juergen Weigert, v1.11 by Vadim Vygonets
```
