## package/batocera/utils/batocera-rpcs3/Config.in
```kconfig
config BR2_PACKAGE_BATOCERA_RPCS3
	bool "batocera-rpcs3"
	depends on BR2_PACKAGE_RPCS3
	help
	  batocera-rpcs3 is a helper for run ps3 games
```

## package/batocera/utils/batocera-steam/Config.in
```kconfig
config BR2_PACKAGE_BATOCERA_STEAM
	bool "batocera-steam"

	select BR2_PACKAGE_FLATPAK
```

## package/batocera/utils/batocera-test/Config.in
```kconfig
config BR2_PACKAGE_BATOCERA_TEST
	bool "batocera-test"

    select BR2_PACKAGE_PYTHON_REQUESTS
```

## package/batocera/utils/batocera-torrent/Config.in
```kconfig
config BR2_PACKAGE_BATOCERA_TORRENT
    bool "batocera-torrent"

    select BR2_PACKAGE_TRANSMISSION
    select BR2_PACKAGE_TRANSMISSION_DAEMON
```

## package/batocera/utils/batocera-wine/Config.in
```kconfig
config BR2_PACKAGE_BATOCERA_WINE
	bool "batocera-wine"
	select BR2_PACKAGE_BATOCERA_WINE_REQUIREMENTS
	select BR2_PACKAGE_WINETRICKS
	select BR2_PACKAGE_CABEXTRACT
	select BR2_PACKAGE_DXVK
	select BR2_PACKAGE_DXVK_NVAPI
	#select BR2_PACKAGE_MF
	select BR2_PACKAGE_VKD3D_PROTON
	select BR2_PACKAGE_RTKIT
	select BR2_PACKAGE_PYTHON_PYGAME2
	select BR2_PACKAGE_SQUASHFS
    select BR2_PACKAGE_YAD
	select BR2_PACKAGE_WINE_TKG
	select BR2_PACKAGE_WINE_MONO

config BR2_PACKAGE_BATOCERA_WINE_REQUIREMENTS
        bool "batocera-wine-requirements"

	select BR2_PACKAGE_NCURSES

	# direct from wine.mk
    select BR2_PACKAGE_LIBMSPACK
    select BR2_PACKAGE_GSTREAMER1
    select BR2_PACKAGE_GST1_LIBAV
	select BR2_PACKAGE_GST1_PLUGINS_BAD
	select BR2_PACKAGE_GST1_PLUGINS_BAD_PLUGIN_ADPCMDEC
	select BR2_PACKAGE_GST1_PLUGINS_BAD_PLUGIN_CODECALPHA
	select BR2_PACKAGE_GST1_PLUGINS_BAD_PLUGIN_FAAD
	select BR2_PACKAGE_GST1_PLUGINS_BAD_PLUGIN_FDK_AAC
	select BR2_PACKAGE_GST1_PLUGINS_BAD_PLUGIN_MPEGDEMUX
	select BR2_PACKAGE_GST1_PLUGINS_BAD_PLUGIN_MPEGTSDEMUX
	select BR2_PACKAGE_GST1_PLUGINS_BAD_PLUGIN_OPENH264
	select BR2_PACKAGE_GST1_PLUGINS_BAD_PLUGIN_VIDEOFILTERS
	select BR2_PACKAGE_GST1_PLUGINS_BAD_PLUGIN_VA
	select BR2_PACKAGE_GST1_PLUGINS_BAD_PLUGIN_VIDEOPARSERS
	select BR2_PACKAGE_GST1_PLUGINS_BAD_PLUGIN_Y4M
	select BR2_PACKAGE_GST1_PLUGINS_BASE
	select BR2_PACKAGE_GST1_PLUGINS_BASE_LIB_OPENGL
	select BR2_PACKAGE_GST1_PLUGINS_BASE_LIB_OPENGL_EGL
	select BR2_PACKAGE_GST1_PLUGINS_BASE_LIB_OPENGL_GLX
	select BR2_PACKAGE_GST1_PLUGINS_BASE_LIB_OPENGL_X11
	select BR2_PACKAGE_GST1_PLUGINS_BASE_PLUGIN_ADDER
	select BR2_PACKAGE_GST1_PLUGINS_BASE_PLUGIN_ALSA
	select BR2_PACKAGE_GST1_PLUGINS_BASE_PLUGIN_APP
	select BR2_PACKAGE_GST1_PLUGINS_BASE_PLUGIN_AUDIOCONVERT
	select BR2_PACKAGE_GST1_PLUGINS_BASE_PLUGIN_AUDIOMIXER
	select BR2_PACKAGE_GST1_PLUGINS_BASE_PLUGIN_AUDIORATE
	select BR2_PACKAGE_GST1_PLUGINS_BASE_PLUGIN_OGG
	select BR2_PACKAGE_GST1_PLUGINS_BASE_PLUGIN_OPUS
	select BR2_PACKAGE_GST1_PLUGINS_BASE_PLUGIN_PLAYBACK
	select BR2_PACKAGE_GST1_PLUGINS_BASE_PLUGIN_THEORA
	select BR2_PACKAGE_GST1_PLUGINS_BASE_PLUGIN_VOLUME
	select BR2_PACKAGE_GST1_PLUGINS_BASE_PLUGIN_VORBIS
	select BR2_PACKAGE_GST1_PLUGINS_GOOD
	select BR2_PACKAGE_GST1_PLUGINS_GOOD_PLUGIN_AVI
	select BR2_PACKAGE_GST1_PLUGINS_GOOD_PLUGIN_DEBUGUTILS
	select BR2_PACKAGE_GST1_PLUGINS_GOOD_PLUGIN_DEINTERLACE
	select BR2_PACKAGE_GST1_PLUGINS_GOOD_PLUGIN_FLAC
	select BR2_PACKAGE_GST1_PLUGINS_GOOD_PLUGIN_MATROSKA
	select BR2_PACKAGE_GST1_PLUGINS_GOOD_PLUGIN_MPG123
	select BR2_PACKAGE_GST1_PLUGINS_GOOD_PLUGIN_OSS
	select BR2_PACKAGE_GST1_PLUGINS_GOOD_PLUGIN_OSS4
	select BR2_PACKAGE_GST1_PLUGINS_GOOD_PLUGIN_VIDEOFILTER
	select BR2_PACKAGE_GST1_PLUGINS_UGLY
	select BR2_PACKAGE_GST1_PLUGINS_UGLY_PLUGIN_ASFDEMUX
	select BR2_PACKAGE_GST1_PLUGINS_UGLY_PLUGIN_DVDLPCMDEC
	select BR2_PACKAGE_GST1_PLUGINS_UGLY_PLUGIN_MPEG2DEC
	select BR2_PACKAGE_GST1_VAAPI
	select BR2_PACKAGE_MPG123
    select BR2_PACKAGE_FAUDIO
	select BR2_PACKAGE_VULKAN_HEADERS
	select BR2_PACKAGE_VULKAN_LOADER
	select BR2_PACKAGE_XLIB_LIBXI
	select BR2_PACKAGE_XLIB_LIBXINERAMA
	select BR2_PACKAGE_XLIB_LIBXRANDR
	select BR2_PACKAGE_XLIB_LIBX11
	select BR2_PACKAGE_XLIB_LIBXCOMPOSITE
	select BR2_PACKAGE_XLIB_LIBXCURSOR
	select BR2_PACKAGE_XLIB_LIBXEXT
	select BR2_PACKAGE_XLIB_LIBXRENDER
	select BR2_PACKAGE_XLIB_LIBXXF86VM
	select BR2_PACKAGE_ALSA_LIB
	select BR2_PACKAGE_ALSA_LIB_SEQ
	select BR2_PACKAGE_ALSA_LIB_RAWMIDI
	select BR2_PACKAGE_DBUS
	select BR2_PACKAGE_FONTCONFIG
	select BR2_PACKAGE_FREETYPE
	select BR2_PACKAGE_GNUTLS
	select BR2_PACKAGE_JPEG
	select BR2_PACKAGE_LIBPNG
	select BR2_PACKAGE_LIBXML2
	select BR2_PACKAGE_OPENAL
	select BR2_PACKAGE_SDL2
	select BR2_PACKAGE_ZLIB
	select BR2_PACKAGE_OPENLDAP
	select BR2_PACKAGE_AVAHI # for BR2_PACKAGE_NSS_MDNS
	select BR2_PACKAGE_AVAHI_DAEMON # for BR2_PACKAGE_NSS_MDNS
	select BR2_PACKAGE_NSS_MDNS
	select BR2_PACKAGE_LIBKRB5

	# packages used by sub libs (gstreamer, ffmpeg, ...)
    select BR2_PACKAGE_X264
    select BR2_PACKAGE_X265
	select BR2_PACKAGE_LIBOGG
	select BR2_PACKAGE_LIBASS
	select BR2_PACKAGE_LIBVORBIS
	select BR2_PACKAGE_LIBUSB
	select BR2_PACKAGE_LIBTHEORA
	select BR2_PACKAGE_LIBVA
	select BR2_PACKAGE_LIBOPENH264
	select BR2_PACKAGE_NETTLE
	select BR2_PACKAGE_RTMPDUMP
	select BR2_PACKAGE_OPUS
	select BR2_PACKAGE_LIBVPX
	select BR2_PACKAGE_LAME
	select BR2_PACKAGE_LIBVDPAU
	select BR2_PACKAGE_HARFBUZZ
	select BR2_PACKAGE_LIBMODPLUG
	select BR2_PACKAGE_LIBBLURAY
	select BR2_PACKAGE_FFMPEG_GPL
	select BR2_PACKAGE_LIBGCRYPT
	select BR2_PACKAGE_WAYLAND
	select BR2_PACKAGE_WAYLAND_PROTOCOLS
```

## package/batocera/utils/bauh/Config.in
```kconfig
config BR2_PACKAGE_BAUH
    bool "bauh"
	select BR2_PACKAGE_QT5
	select BR2_PACKAGE_PYTHON_PYQT5_SIP
	select BR2_PACKAGE_PYTHON_SETUPTOOLS
	select BR2_PACKAGE_PYTHON_DATEUTIL
	select BR2_PACKAGE_PYTHON_PYQT5
	select BR2_PACKAGE_PYTHON_PACKAGING
	select BR2_PACKAGE_PYTHON_REQUESTS
	select BR2_PACKAGE_PYTHON_COLORAMA
	select BR2_PACKAGE_FLATPAK
	select BR2_PACKAGE_PYTHON_CERTIFI
	select BR2_PACKAGE_PYTHON_URLLIB3
	select BR2_PACKAGE_PYTHON_CHARDET
	select BR2_PACKAGE_QT5BASE
	select BR2_PACKAGE_QT5BASE_XCB
	select BR2_PACKAGE_QT5BASE_WIDGETS
	select BR2_PACKAGE_QT5BASE_GUI
	select BR2_PACKAGE_QT5BASE_NETWORK
	select BR2_PACKAGE_QT5BASE_EGLFS
	select BR2_PACKAGE_QT5BASE_FONTCONFIG
	select BR2_PACKAGE_QT5BASE_GIF
	select BR2_PACKAGE_QT5BASE_JPEG
	select BR2_PACKAGE_QT5BASE_PNG
	select BR2_PACKAGE_QT5SVG
```

## package/batocera/utils/box64/Config.in
```kconfig
config BR2_PACKAGE_BOX64
	bool "box64"
	depends on BR2_aarch64 || BR2_RISCV_64
	select BR2_PACKAGE_HOST_PYTHON3
	help
	  Box64 - Linux Userspace x86_64 Emulator with a twist,
	  targeted at ARM64, RV64 and LoongArch Linux devices

	  https://github.com/ptitSeb/box64
```

## package/batocera/utils/btop/Config.in
```kconfig
config BR2_PACKAGE_BTOP
        bool "btop"
        help
          A monitor of resources

          https://github.com/aristocratos/btop
```

## package/batocera/utils/cabextract/Config.in
```kconfig
config BR2_PACKAGE_CABEXTRACT
	bool "CABEXTRACT"
	select BR2_PACKAGE_LIBMSPACK
	help
	  cab extractor
```

## package/batocera/utils/chromebook-ucm-conf/Config.in
```kconfig
config BR2_PACKAGE_CHROMEBOOK_UCM_CONF
	bool "chromebook-ucm-conf"
	select BR2_PACKAGE_ALLLINUXFIRMWARES
	select BR2_PACKAGE_SOUND_OPEN_FIRMWARE
	help
	  Alsa UCM configuration for chrome devices.

	  https://github.com/WeirdTreeThing/chromebook-ucm-conf
```

## package/batocera/utils/clevis/Config.in
```kconfig
config BR2_PACKAGE_CLEVIS
        bool "clevis"
        select BR2_PACKAGE_CRYPTSETUP
        select BR2_PACKAGE_JOSE
        select BR2_PACKAGE_LUKSMETA
        select BR2_PACKAGE_TPM2_TOOLS

        help
          Clevis is a pluggable framework for automated decryption. It
          can be used to provide automated decryption of data or even
          automated unlocking of LUKS volumes.

          https://github.com/latchset/clevis
```

## package/batocera/utils/evmapy/Config.in
```kconfig
config BR2_PACKAGE_EVMAPY
        bool "python-evmapy"
	select BR2_PACKAGE_PYTHON_EVDEV
	select BR2_PACKAGE_PYTHON_SETUPTOOLS
	select BR2_PACKAGE_INOTIFY_TOOLS # required to wait that evmapy is ready
        help
	  https://github.com/kempniu/evmapy
```

## package/batocera/utils/evsieve/Config.in
```kconfig
config BR2_PACKAGE_EVSIEVE
	bool "evsieve"
	depends on BR2_PACKAGE_HOST_RUSTC_TARGET_ARCH_SUPPORTS
	select BR2_PACKAGE_HOST_RUSTC
	select BR2_PACKAGE_LIBEVDEV
	help
	  Evsieve (from "event sieve") is a low-level utility that 
	  can read events from Linux event devices (evdev) and write 
	  them to virtual event devices (uinput), performing simple 
	  manipulations on the events along the way. 

	  https://github.com/KarsMulder/evsieve
```

## package/batocera/utils/fake-hwclock/Config.in
```kconfig
config BR2_PACKAGE_FAKE_HWCLOCK
	bool "fake-hwclock"
	help
	  Save/restore system clock on machines without working RTC hardware
```

## package/batocera/utils/fdupes/Config.in
```kconfig
config BR2_PACKAGE_FDUPES
	bool "FDUPES"
	depends on  BR2_PACKAGE_NCURSES
	depends on  BR2_PACKAGE_SQLITE

	help
	  Command line tool to find duplicate files

	  https://github.com/adrianlopezroche/fdupes
```

## package/batocera/utils/flatpak/Config.in
```kconfig
config BR2_PACKAGE_FLATPAK
	bool "flatpak"
	select BR2_PACKAGE_APPSTREAM_GLIB
	select BR2_PACKAGE_BOOST
	select BR2_PACKAGE_BOOST_ATOMIC
	select BR2_PACKAGE_BZIP2
	select BR2_PACKAGE_GLIB_NETWORKING
	select BR2_PACKAGE_HOST_PYTHON3
	select BR2_PACKAGE_HOST_PYTHON3_PYPARSING
	select BR2_PACKAGE_HOST_PYTHON3_SSL
	select BR2_PACKAGE_JSON_GLIB
	select BR2_PACKAGE_LIBARCHIVE
	select BR2_PACKAGE_LIBCAP
	select BR2_PACKAGE_LIBFUSE
	select BR2_PACKAGE_LIBGLIB2
	select BR2_PACKAGE_LIBGPGME
	select BR2_PACKAGE_LIBOPENSSL
	select BR2_PACKAGE_LIBOSTREE
	select BR2_PACKAGE_LIBSECCOMP
	select BR2_PACKAGE_LIBSOUP
	select BR2_PACKAGE_LIBSOUP3
	select BR2_PACKAGE_LIBSOUP3_SSL
	select BR2_PACKAGE_LIBSVG_CAIRO
	select BR2_PACKAGE_PKGCONF
	select BR2_PACKAGE_POLKIT
	select BR2_PACKAGE_PYTHON3
	select BR2_PACKAGE_PYTHON3_HASHLIB
	select BR2_PACKAGE_PYTHON3_PYPARSING
	select BR2_PACKAGE_PYTHON3_PY_PYC
	select BR2_PACKAGE_PYTHON3_SSL
	select BR2_PACKAGE_PYTHON_PSUTIL
	select BR2_PACKAGE_READLINE
	select BR2_PACKAGE_TSLIB
	select BR2_PACKAGE_YAML_CPP
	select BR2_PACKAGE_HICOLOR_ICON_THEME
	select BR2_PACKAGE_ADWAITA_ICON_THEME
	select BR2_PACKAGE_ADWAITA_ICON_THEME_LIGHT
	help
	  Flatpak runtime
```

## package/batocera/utils/gpicase/Config.in
```kconfig
config BR2_PACKAGE_GPICASE
        bool "gpicase"
	depends on BR2_PACKAGE_RPI_USERLAND || BR2_PACKAGE_MESA3D

comment "gpicase"
	depends on BR2_PACKAGE_RPI_USERLAND || BR2_PACKAGE_MESA3D
```

## package/batocera/utils/gpimateplus/Config.in
```kconfig
config BR2_PACKAGE_GPIMATEPLUS
        bool "gpimateplus"
	select BR2_PACKAGE_GPICASE
```

## package/batocera/utils/grim/Config.in
```kconfig
config BR2_PACKAGE_GRIM
    bool "grim"
    depends on BR2_PACKAGE_WAYLAND
    select BR2_PACKAGE_JPEG_TURBO
    help
      Grab images from a Wayland compositor.

      https://git.sr.ht/~emersion/grim
```

## package/batocera/utils/imgui/Config.in
```kconfig
config BR2_PACKAGE_IMGUI
	bool "imgui"
	help
	  Bloat-free Graphical User interface for C++ with minimal dependencies

	  https://github.com/ocornut/imgui
```

## package/batocera/utils/innoextract/Config.in
```kconfig
config BR2_PACKAGE_INNOEXTRACT
    bool "innoextract"
    select BR2_PACKAGE_XZ
    select BR2_PACKAGE_BOOST
    select BR2_PACKAGE_BOOST_IOSTREAMS
    select BR2_PACKAGE_BOOST_DATE_TIME
    select BR2_PACKAGE_BOOST_PROGRAM_OPTIONS
    select BR2_PACKAGE_BOOST_FILESYSTEM
    select BR2_PACKAGE_BOOST_SYSTEM

    help
      innoextract - A tool to unpack installers created by Inno Setup

	    https://constexpr.org/innoextract/
```

## package/batocera/utils/jstest2/Config.in
```kconfig
config BR2_PACKAGE_JSTEST2
	bool "JSTEST2"
	select BR2_PACKAGE_SDL2
	select BR2_PACKAGE_NCURSES
	help
	  Command line tool to test the joysticks with sdl2

	  https://github.com/Grumbel/sdl-jstest
```

## package/batocera/utils/l3afpad/Config.in
```kconfig
config BR2_PACKAGE_L3AFPAD
	bool "l3afpad"
	depends on BR2_PACKAGE_LIBGTK3
	help
	  GTK+ based simple text editor

	  https://github.com/stevenhoneyman/l3afpad
```

## package/batocera/utils/labwc/Config.in
```kconfig
config BR2_PACKAGE_LABWC
	bool "labwc"
	depends on !BR2_STATIC_LIBS # wlroots
	depends on BR2_TOOLCHAIN_HAS_THREADS # pango, wlroots
	depends on BR2_PACKAGE_HAS_LIBEGL # wlroots
	depends on BR2_PACKAGE_HAS_LIBGLES # wlroots
	depends on BR2_PACKAGE_HAS_UDEV # wlroots
	depends on BR2_TOOLCHAIN_HAS_SYNC_4 # json-c, pango
	depends on BR2_USE_WCHAR # pango
	depends on BR2_USE_MMU # pango
	depends on BR2_INSTALL_LIBSTDCPP # pango
	depends on BR2_TOOLCHAIN_GCC_AT_LEAST_4_9 # pango
	select BR2_PACKAGE_CAIRO
	select BR2_PACKAGE_CAIRO_PNG
	select BR2_PACKAGE_LIBDECOR
	select BR2_PACKAGE_LIBGLIB2
	select BR2_PACKAGE_LIBINPUT
	select BR2_PACKAGE_LIBPNG
	select BR2_PACKAGE_LIBSFDO
	select BR2_PACKAGE_LIBXCB
	select BR2_PACKAGE_LIBXKBCOMMON
	select BR2_PACKAGE_LIBXML2
	select BR2_PACKAGE_PANGO
	select BR2_PACKAGE_WAYLAND
	select BR2_PACKAGE_WAYLAND_PROTOCOLS
	select BR2_PACKAGE_WLROOTS
	select BR2_PACKAGE_XKEYBOARD_CONFIG
	help
	  Labwc is a wlroots-based window-stacking compositor for wayland, inspired by openbox.

	  https://labwc.github.io/

comment "labwc needs a toolchain w/ wchar, threads, C++, dynamic library, gcc >= 4.9"
	depends on BR2_USE_MMU
	depends on BR2_TOOLCHAIN_HAS_SYNC_4
	depends on !BR2_USE_WCHAR || \
		!BR2_TOOLCHAIN_HAS_THREADS || \
		!BR2_TOOLCHAIN_GCC_AT_LEAST_4_9 || \
		!BR2_INSTALL_LIBSTDCPP || \
		BR2_STATIC_LIBS
```
