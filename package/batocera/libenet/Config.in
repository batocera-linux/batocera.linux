## package/batocera/libenet/Config.in
```kconfig
config BR2_PACKAGE_LIBENET
	bool "libenet"
	help
	  network communication layer on top of UDP

	  http://enet.bespin.org
```

## package/batocera/libhybris/Config.in
```kconfig
config BR2_PACKAGE_LIBHYBRIS
	bool "libhybris"
	select BR2_PACKAGE_ANDROID_HEADERS
	select BR2_PACKAGE_HAS_LIBEGL
        select BR2_PACKAGE_HAS_LIBGLES

if BR2_PACKAGE_LIBHYBRIS

config BR2_PACKAGE_LIBHYBRIS_DEBUG
	bool "libhybris-debug"

config BR2_PACKAGE_PROVIDES_LIBEGL
        default "libhybris"

config BR2_PACKAGE_PROVIDES_LIBGLES
	default "libhybris"
endif
```

## package/batocera/libraries/Config.in
```kconfig
source "package/batocera/libraries/guichan/Config.in"
source "package/batocera/libraries/libcapsimage/Config.in"
source "package/batocera/libraries/libenet/Config.in"
source "package/batocera/libraries/openal-soft/Config.in"
source "package/batocera/libraries/python-autobreadcrumbs/Config.in"
source "package/batocera/libraries/python-rpigpio/Config.in"
source "package/batocera/libraries/sfml/Config.in"
source "package/batocera/libraries/wxwidgets/Config.in"
```

## package/batocera/libraries/alsa-plugins/Config.in
```kconfig
config BR2_PACKAGE_ALSA_PLUGINS
	bool "alsa-plugins"
	depends on BR2_PACKAGE_ALSA_LIB
	help
	  Advanced Linux Sound Architecture Plugins

	  http://www.alsa-project.org/
```

## package/batocera/libraries/appstream-glib/Config.in
```kconfig
config BR2_PACKAGE_APPSTREAM_GLIB
	bool "appstream-glib"
	select BR2_PACKAGE_LIBGTK3
	select BR2_PACKAGE_LIBYAML
	select BR2_PACKAGE_JSON_GLIB
	select BR2_PACKAGE_LIBARCHIVE
	select BR2_PACKAGE_LIBCURL

	help 
	    This library provides objects and helper methods to help reading and writing AppStream metadata.

		https://github.com/hughsie/appstream-glib
```

## package/batocera/libraries/bgfx/Config.in
```kconfig
config BR2_PACKAGE_BGFX
    bool "bgfx"
    select BR2_PACKAGE_XLIB_LIBX11
    select BR2_PACKAGE_LIBGL
    help
      Cross-platform, graphics API agnostic, “Bring Your Own Engine/Framework”
      style rendering library.
      
      https://github.com/bkaradzic/bgfx.cmake
```

## package/batocera/libraries/capsimg/Config.in
```kconfig
config BR2_PACKAGE_CAPSIMG
        bool "capsimg"
        help
          A fsuae emulator plugin
```

## package/batocera/libraries/cargs/Config.in
```kconfig
config BR2_PACKAGE_CARGS
    bool "cargs"
    help
      cargs - A lightweight cross-platform getopt alternative that is tested on Linux, Windows, FreeBSD and macOS. Command line argument parser library for C/C++. Can be used to parse argv and argc parameters.
      
      https://github.com/likle/cargs
```

## package/batocera/libraries/catch2/Config.in
```kconfig
config BR2_PACKAGE_CATCH2
    bool "Catch2"
    help
      A multi-paradigm test framework for C++

	    https://github.com/catchorg/Catch2/
```

## package/batocera/libraries/cpp-ipc/Config.in
```kconfig
config BR2_PACKAGE_CPP_IPC
    bool "cpp-ipc"
    help
      C++ IPC Library: A high-performance inter-process communication
      using shared memory on Linux/Windows.
      
      https://github.com/mutouyun/cpp-ipc
```

## package/batocera/libraries/cpuinfo/Config.in
```kconfig
config BR2_PACKAGE_CPUINFO
	bool "cpuinfo"
	help
	  CPUInfo is a library to detect essential for performance optimization information about host CPU.

	  https://github.com/pytorch/cpuinfo
```

## package/batocera/libraries/cxxopts/Config.in
```kconfig
config BR2_PACKAGE_CXXOPTS
    bool "cxxopts"
    help
      Lightweight C++ command line option parser.
      
      https://github.com/jarro2783/cxxopts
```

## package/batocera/libraries/date/Config.in
```kconfig
config BR2_PACKAGE_DATE
    bool "date"
    help
      A date and time library based on the C++11/14/17 <chrono> header.
      
      https://github.com/HowardHinnant/date
```

## package/batocera/libraries/ecm/Config.in
```kconfig
config BR2_PACKAGE_ECM
	bool "ecm"
	help
	  Extra modules and scripts for CMake.
```

## package/batocera/libraries/faudio/Config.in
```kconfig
config BR2_PACKAGE_FAUDIO
	bool "faudio"
    depends on BR2_i386 || BR2_x86_64
	select BR2_PACKAGE_SDL2
	select BR2_PACKAGE_GSTREAMER1
	select BR2_PACKAGE_GST1_PLUGINS_BASE
	# Wine unconditionally builds shared libraries
	depends on !BR2_STATIC_LIBS
	help  
	  This is FAudio, an XAudio reimplementation that focuses solely on developing
	  fully accurate DirectX Audio runtime libraries for the FNA project, including
	  XAudio2, X3DAudio, XAPO, and XACT3.

	  Project Website: http://fna-xna.github.io/

comment "dxvk needs a toolchain w/ dynamic library"
	depends on BR2_STATIC_LIBS
```

## package/batocera/libraries/ffmpeg-python/Config.in
```kconfig
config BR2_PACKAGE_FFMPEG_PYTHON
    bool "ffmpeg-python"
    select BR2_PACKAGE_PYTHON_FUTURE
    help
      Python bindings for FFmpeg - with complex filtering support.
      
      https://github.com/kkroening/ffmpeg-python
```

## package/batocera/libraries/gamenetworkingsockets/Config.in
```kconfig
config BR2_PACKAGE_GAMENETWORKINGSOCKETS
	bool "gamenetworkingsockets"
	select BR2_PACKAGE_PROTOBUF
	select BR2_PACKAGE_OPENSSL
	help
	  Reliable & unreliable messages over UDP.
	  Robust message fragmentation & reassembly.
	  P2P networking / NAT traversal. Encryption. 

	  https://github.com/ValveSoftware/GameNetworkingSockets
```

## package/batocera/libraries/guichan/Config.in
```kconfig
config BR2_PACKAGE_GUICHAN
	bool "guichan"
        select BR2_PACKAGE_SDL
	select BR2_PACKAGE_SDL_IMAGE
	help
	  GUICHAN c++ library

	  http://sourceforge.net/projects/guichan/

comment "guichan"
```

## package/batocera/libraries/iir/Config.in
```kconfig
config BR2_PACKAGE_IIR
	bool "iir"
	help
        An infinite impulse response (IIR) filter library for Linux,
        Mac OSX and Windows which implements Butterworth, RBJ, Chebychev
        filters and can easily import coefficients generated by Python (scipy).
```

## package/batocera/libraries/kddockwidgets/Config.in
```kconfig
config BR2_PACKAGE_KDDOCKWIDGETS
    bool "kddockwidgets"
    select BR2_PACKAGE_QT6BASE
    select BR2_PACKAGE_QT6BASE_WIDGETS
    help
      KDAB's Dock Widget Framework for Qt.
      
      https://github.com/KDAB/KDDockWidgets
```

## package/batocera/libraries/libaltsound/Config.in
```kconfig
config BR2_PACKAGE_LIBALTSOUND
    bool "libaltsound"
    select BR2_PACKAGE_ZLIB
    select BR2_HOST_CMAKE_AT_LEAST_3_26
    help
      libaltsound - A cross platform compilation of altsound that is baked directly into VPinMAME.
      
      https://github.com/vpinball/libaltsound
      www.vpforums.org
```

## package/batocera/libraries/libde265/Config.in
```kconfig
config BR2_PACKAGE_LIBDE265
	bool "libde265"
	help
	  libde265 - H265 video decoder

	  https://github.com/strukturag/libde265
```

## package/batocera/libraries/libdecor/Config.in
```kconfig
config BR2_PACKAGE_LIBDECOR
	bool "libdecor"
	select BR2_PACKAGE_WAYLAND
	select BR2_PACKAGE_WAYLAND_PROTOCOLS
	help
	  libdecor is a library that can help Wayland clients draw window decorations for them.
	  It aims to provide multiple backends that implements the decoration drawing.

	  https://gitlab.freedesktop.org/libdecor/libdecor
```

## package/batocera/libraries/libdmdutil/Config.in
```kconfig
config BR2_PACKAGE_LIBDMDUTIL
    bool "libdmdutil"
    select BR2_PACKAGE_LIBSERIALPORT
    select BR2_PACKAGE_SOCKPP
    select BR2_PACKAGE_CARGS
    select BR2_PACKAGE_LIBZEDMD
    select BR2_PACKAGE_LIBSERUM
    help
      libdmdutil - A cross platform library for performing DMD tasks.
      
      https://github.com/vpinball/libdmdutil
      www.vpforums.org
```

## package/batocera/libraries/libdof/Config.in
```kconfig
config BR2_PACKAGE_LIBDOF
    bool "libdof"
    select BR2_PACKAGE_LIBSERIALPORT
    select BR2_PACKAGE_HIDAPI
    select BR2_PACKAGE_SOCKPP
    select BR2_PACKAGE_CARGS
    select BR2_PACKAGE_LIBFTDI1
    help
      libdof - A cross platform library for performing Direct Output Framework tasks.
      
      https://github.com/jsm174/libdof
```
