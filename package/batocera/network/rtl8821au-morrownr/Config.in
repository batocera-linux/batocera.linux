## package/batocera/network/rtl8821au-morrownr/Config.in
```kconfig
comment "rtl8821au needs a Linux kernel to be built"
	depends on !BR2_LINUX_KERNEL

config BR2_PACKAGE_RTL8821AU_MORROWNR
	bool "rtl8821au-morrownr"
	depends on BR2_LINUX_KERNEL
	help
	  Linux Driver for USB WiFi Adapters that are based on the
	  RTL8811AU and RTL8821AU Chipsets - v5.12.5.2

	  https://github.com/morrownr/8821au-20210708
```

## package/batocera/network/rtl8821ce/Config.in
```kconfig
comment "rtl8821ce needs a Linux kernel to be built"
	depends on !BR2_LINUX_KERNEL

config BR2_PACKAGE_RTL8821CE
	bool "rtl8821ce"
	depends on BR2_LINUX_KERNEL
	help
	  rtl8821ce wifi driver

	  https://github.com/tomaspinho/rtl8821ce
```

## package/batocera/network/rtl8821cu/Config.in
```kconfig
comment "rtl8821cu needs a Linux kernel to be built"
	depends on !BR2_LINUX_KERNEL

config BR2_PACKAGE_RTL8821CU
	bool "rtl8821cu"
	depends on BR2_LINUX_KERNEL
	help
	  Linux Driver for USB WiFi Adapters that are based on the RTL8811CU, RTL8821CU and RTL8731AU Chipsets

	  https://github.com/morrownr/8821cu
```

## package/batocera/network/rtl8822cs/Config.in
```kconfig
comment "RTL8822CS needs a Linux kernel to be built"
	depends on !BR2_LINUX_KERNEL

config BR2_PACKAGE_RTL8822CS
	bool "rtl8822cs"
	depends on BR2_LINUX_KERNEL
	help
	  Realtek RTL8822CS Wi-Fi driver

	  https://github.com/jethome-ru/rtl88x2cs/
```

## package/batocera/network/rtl8852au/Config.in
```kconfig
comment "rtl8852au needs a Linux kernel to be built"
	depends on !BR2_LINUX_KERNEL

config BR2_PACKAGE_RTL8852AU
	bool "rtl8852au"
	depends on BR2_LINUX_KERNEL
	help
	  RTL8852AU wifi driver

	  https://github.com/natimerry/rtl8852au
```

## package/batocera/network/rtl8852cu/Config.in
```kconfig
comment "rtl8852cu needs a Linux kernel to be built"
	depends on !BR2_LINUX_KERNEL

config BR2_PACKAGE_RTL8852CU
	bool "rtl8852cu"
	depends on BR2_LINUX_KERNEL
	help
	  Linux Driver for USB WiFi Adapters that are based on
	  the RTL8832CU and RTL8852CU Chipsets.

	  https://github.com/morrownr/rtl8852cu-20240510
```

## package/batocera/network/rtl88x2bu/Config.in
```kconfig
comment "rtl88x2bu needs a Linux kernel to be built"
	depends on !BR2_LINUX_KERNEL

config BR2_PACKAGE_RTL88X2BU
	bool "rtl88x2bu"
	depends on BR2_LINUX_KERNEL
	help
	  Linux Driver for USB WiFi Adapters that are based on the RTL8812BU and RTL8822BU Chipsets.

	  https://github.com/morrownr/88x2bu-20210702
```

## package/batocera/network/rtw88/Config.in
```kconfig
comment "rtw88 needs a Linux kernel to be built"
	depends on !BR2_LINUX_KERNEL

config BR2_PACKAGE_RTW88
	bool "rtw88"
	depends on BR2_LINUX_KERNEL
	help
	  A backport of the Realtek Wifi 5 drivers from the wireless-next repo.
	  Use for Kernel versions between 5.4 & 6.12 only.

	  https://github.com/lwfinger/rtw88
```

## package/batocera/network/rtw89-temp/Config.in
```kconfig
comment "rtw89-temp needs a Linux kernel to be built"
	depends on !BR2_LINUX_KERNEL

config BR2_PACKAGE_RTW89_TEMP
	bool "rtw89-temp"
	depends on BR2_LINUX_KERNEL
	help
	  Prefered driver for Realtek 8852xx devices

	  https://github.com/morrownr/rtw89
```

## package/batocera/network/uwe5622/Config.in
```kconfig
comment "uwe5622 needs a Linux kernel to be built"
	depends on !BR2_LINUX_KERNEL

config BR2_PACKAGE_UWE5622
	bool "uwe5622"
	depends on BR2_LINUX_KERNEL
	help
	  UWE5622 driver kept up to date with modern mainline kernels.

	  https://github.com/EvilOlaf/uwe5622
```

## package/batocera/openal-soft/Config.in
```kconfig
config BR2_PACKAGE_OPENAL_SOFT
        bool "openal-soft"
        help
          OpenAL-soft
```

## package/batocera/opengl-meson-t82x/Config.in
```kconfig
config BR2_PACKAGE_OPENGL_MESON_T82X
	bool "opengl-meson-t82x"
	depends on BR2_arm || BR2_aarch64
	select BR2_PACKAGE_LIBHYBRIS
	help
	  Install the binary user-space components for the ARM Mali Midgard

comment "opengl-meson-tx82"
```

## package/batocera/pcsx2/Config.in
```kconfig
config BR2_PACKAGE_PCSX2
        bool "pcsx2"
	depends on BR2_x86_i586
	depends on BR2_PACKAGE_XORG7
	select BR2_PACKAGE_ALSA_LIB
	select BR2_PACKAGE_FREETYPE
	select BR2_PACKAGE_ZLIB
	select BR2_PACKAGE_LIBPNG
	select BR2_PACKAGE_WXWIDGETS
	select BR2_PACKAGE_LIBAIO
	select BR2_PACKAGE_PORTAUDIO
	select BR2_PACKAGE_LIBSOUNDTOUCH
	select BR2_PACKAGE_SDL2
        help
          A  pcsx2 emulator
```

## package/batocera/pegasus/Config.in
```kconfig
config BR2_PACKAGE_PEGASUS
        bool "Pegasus frontend"
	depends on BR2_INSTALL_LIBSTDCPP
	select BR2_PACKAGE_QT5
	select BR2_PACKAGE_QT5_VERSION_LATEST
	select BR2_PACKAGE_QT5BASE
	select BR2_PACKAGE_QT5BASE_OPENGL
	select BR2_PACKAGE_QT5MULTIMEDIA
	select BR2_PACKAGE_QT5BASE_FONTCONFIG
	select BR2_PACKAGE_QT5TOOLS
	select BR2_PACKAGE_QT5TOOLS_LINGUIST_TOOLS
	select BR2_PACKAGE_QT5SVG
	select BR2_PACKAGE_SDL2
        help
          A cross platform, customizable graphical frontend for launching emulators and managing your game collection.

	  https://pegasus-frontend.org/

comment "Pegasus Frontend needs a toolchain w/ C++"
```

## package/batocera/ports/abuse-data/Config.in
```kconfig
config BR2_PACKAGE_ABUSE_DATA
	bool "abuse-data"
	help
	  Data files to use with Abuse game.

	  http://abuse.zoy.org/
```

## package/batocera/ports/abuse/Config.in
```kconfig
config BR2_PACKAGE_ABUSE
	bool "abuse"
	select BR2_PACKAGE_SDL2
	select BR2_PACKAGE_SDL2_MIXER
	help
	  This is a fork of the original Abuse SDL port

	  http://github.com/Xenoveritas/abuse

comment "BR2_PACKAGE_ABUSE needs a toolchain w/ C++"
	depends on !BR2_INSTALL_LIBSTDCPP
```

## package/batocera/ports/bennugd-bgdi/Config.in
```kconfig
config BR2_PACKAGE_BENNUGD_BGDI
	bool "bennugd-bgdi"
	depends on BR2_INSTALL_LIBSTDCPP
    select BR2_PACKAGE_LIBTRE
	select BR2_PACKAGE_SDL2
	select BR2_PACKAGE_SDL2_MIXER
	help
        BennuGD is an open source video game development language,
        with a modular design designed to facilitate the portability
        of the projects carried out in it, making this language 
        one of the best.
```

## package/batocera/ports/bstone/Config.in
```kconfig
config BR2_PACKAGE_BSTONE
	bool "bstone"
	select BR2_PACKAGE_OPENAL
	select BR2_PACKAGE_SDL2
	help
	  Unofficial source port for Blake Stone series.

	  https://github.com/bibendovsky/bstone
```

## package/batocera/ports/catacombgl/Config.in
```kconfig
config BR2_PACKAGE_CATACOMBGL
    bool "catacombgl"
    select BR2_PACKAGE_SDL2
    help
      CatacombGL is a source port of Catacomb 3D and the Catacomb Adventure series. 

      https://github.com/ArnoAnsems/CatacombGL
```

## package/batocera/ports/cdogs/Config.in
```kconfig
config BR2_PACKAGE_CDOGS
	bool "cdogs"
	select BR2_PACKAGE_SDL2
	select BR2_PACKAGE_SDL2_IMAGE
	select BR2_PACKAGE_SDL2_MIXER
	select BR2_PACKAGE_PYTHON_PROTOBUF
	select BR2_PACKAGE_HOST_PYTHON_PROTOBUF
	select BR2_PACKAGE_ENET
	depends on BR2_INSTALL_LIBSTDCPP
	help
	  Classic overhead run-and-gun game

	  https://cxong.github.io/cdogs-sdl/

comment "BR2_PACKAGE_CDOGS needs a toolchain w/ C++"
	depends on !BR2_INSTALL_LIBSTDCPP
```

## package/batocera/ports/cgenius/Config.in
```kconfig
config BR2_PACKAGE_CGENIUS
	bool "cgenius"
	select BR2_PACKAGE_SDL2
	select BR2_PACKAGE_SDL2_IMAGE
	select BR2_PACKAGE_SDL2_TTF
	select BR2_PACKAGE_SDL2_MIXER
	select BR2_PACKAGE_BOOST
	select BR2_PACKAGE_XXD
	select BR2_PACKAGE_PYTHON3_CONFIGOBJ
	help
	  Commander Genius - Commander Keen Engine
	  
	  https://github.com/gerstrong/Commander-Genius
```

## package/batocera/ports/corsixth/Config.in
```kconfig
config BR2_PACKAGE_CORSIXTH
	bool "corsixth"
	select BR2_PACKAGE_SDL2
	select BR2_PACKAGE_SDL2_IMAGE
	select BR2_PACKAGE_LUA
	select BR2_PACKAGE_LUAFILESYSTEM
	select BR2_PACKAGE_LPEG
	select BR2_PACKAGE_LUASOCKET
	select BR2_PACKAGE_LUASEC
	select BR2_PACKAGE_SDL2_MIXER
	select BR2_PACKAGE_FFMPEG
	help
	  Open source clone of Theme Hospital
	  
	  https://github.com/CorsixTH/CorsixTH
```

## package/batocera/ports/devilutionx/Config.in
```kconfig
config BR2_PACKAGE_DEVILUTIONX
	bool "devilutionx"
	select BR2_PACKAGE_SDL2
	select BR2_PACKAGE_SDL2_IMAGE
	select BR2_PACKAGE_FMT
	select BR2_PACKAGE_LIBSODIUM
	select BR2_PACKAGE_BZIP2
	help
	  A Diablo 1 port for modern operating systems.

	  https://github.com/diasurgical/devilutionX/
```

## package/batocera/ports/dhewm3/Config.in
```kconfig
config BR2_PACKAGE_DHEWM3
    bool "dhewm3"
    select BR2_PACKAGE_LIBCURL
    select BR2_PACKAGE_LIBJPEG
    select BR2_PACKAGE_LIBOGG
    select BR2_PACKAGE_LIBVORBIS
    select BR2_PACKAGE_OPENAL
    select BR2_PACKAGE_SDL2
    select BR2_PACKAGE_ZLIB
    help
      dhewm 3 is a Doom 3 GPL source port.
      The goal of dhewm 3 is bring DOOM 3 with the help of SDL to all suitable platforms.

      https://github.com/dhewm/dhewm3
```

## package/batocera/ports/dhewm3/d3le/Config.in
```kconfig
config BR2_PACKAGE_D3LE
    bool "d3le"
    select BR2_PACKAGE_LIBCURL
    select BR2_PACKAGE_LIBJPEG
    select BR2_PACKAGE_LIBOGG
    select BR2_PACKAGE_LIBVORBIS
    select BR2_PACKAGE_OPENAL
    select BR2_PACKAGE_SDL2
    select BR2_PACKAGE_ZLIB
    help
      dhewm3 port of the Doom3: The Lost Mission mod..

      https://github.com/dhewm/dhewm3-sdk/tree/d3le
```
