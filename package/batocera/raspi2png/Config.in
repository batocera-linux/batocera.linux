## package/batocera/raspi2png/Config.in
```kconfig
config BR2_PACKAGE_RASPI2PNG
        bool "raspi2png"
	depends on BR2_PACKAGE_LIBPNG
        help
          A tool for taking screenshots
	  https://github.com/AndrewFromMelbourne/raspi2png

comment "RASPI2PNG needs libpng"
	depends on !BR2_PACKAGE_LIBPNG
```

## package/batocera/recalbox-api/Config.in
```kconfig
config BR2_PACKAGE_RECALBOX_API
        bool "recalbox-api"
	depends on BR2_PACKAGE_NODEJS
        help
          Neolao's api project

	  https://github.com/neolao/recalbox-api
```

## package/batocera/recalbox-configgen/Config.in
```kconfig
config BR2_PACKAGE_RECALBOX_CONFIGGEN
        bool "recalbox configgen"
	select BR2_PACKAGE_PYTHON
        help
          The configuration utility for recalbox

	  https://github.com/batocera-linux/recalbox-configgen
```

## package/batocera/recalbox-manager/Config.in
```kconfig
config BR2_PACKAGE_RECALBOX_MANAGER
	bool "recalbox-manager"
	select BR2_PACKAGE_PYTHON_DJANGO
	select BR2_PACKAGE_PYTHON_PSUTIL
	select BR2_PACKAGE_PYTHON_AUTOBREADCRUMBS
	help
	 https://github.com/sveetch/recalbox-manager
```

## package/batocera/recalbox-themes/Config.in
```kconfig
config BR2_PACKAGE_RECALBOX_THEMES
        bool "recalbox ES themes"
        help
          Emulationstation themes for recalbox.

	  https://github.com/recalbox/recalbox-themes
```

## package/batocera/recalbox-x86_64_efi/Config.in
```kconfig
config BR2_PACKAGE_RECALBOX_X86_64_EFI
    bool "recalbox-x86_64_efi"
    help
      EFI 64 bit precompiled

      https://github.com/batocera-linux/recalbox-x86_64_efi
```

## package/batocera/retrolx/kernel-rk3288/Config.in
```kconfig
config BR2_PACKAGE_KERNEL_RK3288
        bool "kernel-rk3288"
        help
          Rockchip RK3288 kernel for RetroLX
```

## package/batocera/retrolx/kernel-rk3326/Config.in
```kconfig
config BR2_PACKAGE_KERNEL_RK3326
        bool "kernel-rk3326"
        help
          Rockchip RK3326 kernel for RetroLX
```

## package/batocera/screens/dmd-play-rust/Config.in
```kconfig
config BR2_PACKAGE_DMD_PLAY_RUST
    bool "dmd-play-rust"
    depends on BR2_PACKAGE_HOST_RUSTC_TARGET_ARCH_SUPPORTS
    help
      dmd-simulator player command that can send image to the simulator or to the libdmd server

config BR2_PACKAGE_DMD_PLAY_RUST_DMD_PLAY_BIN
    bool "dmd-play-rust-dmd-play-bin"
```

## package/batocera/screens/dmd-simulator/Config.in
```kconfig
config BR2_PACKAGE_DMD_SIMULATOR_PLAYER
    bool "dmd-simulator-player"
    select BR2_PACKAGE_PYTHON_NUMPY
    select BR2_PACKAGE_PYTHON_PILLOW
    select BR2_PACKAGE_JQ          # for scripts
    select BR2_PACKAGE_IMAGEMAGICK # for scripts
    select BR2_PACKAGE_PYTHON_NUMPY_ARCH_SUPPORTS
    help
      dmd-simulator player command that can send image to the simulator or to the libdmd server

config BR2_PACKAGE_DMD_SIMULATOR
    bool "dmd-simulator"
    select BR2_PACKAGE_PYTHON_NUMPY
    select BR2_PACKAGE_PYTHON_WEBSOCKETS
    select BR2_PACKAGE_PYTHON_URLLIB3
    select BR2_PACKAGE_PYTHON_AIOHTTP
    select BR2_PACKAGE_PYTHON_NUMPY_ARCH_SUPPORTS
    help
      dmd-simulator is a daemon that simulate a real dmd on a web server
```

## package/batocera/screens/pixelcade/Config.in
```kconfig
config BR2_PACKAGE_PIXELCADE
	bool "pixelcade"
	select BR2_PACKAGE_JQ
	select BR2_PACKAGE_IMAGEMAGICK

	help
	  pixelcade support
```

## package/batocera/scummvm-vanfanel/Config.in
```kconfig
config BR2_PACKAGE_SCUMMVM_VANFANEL
        bool "Scummvm gls port vanfanel"
	depends on BR2_INSTALL_LIBSTDCPP
	depends on BR2_PACKAGE_SDL
	select BR2_PACKAGE_LIBMPEG2
	select BR2_PACKAGE_JPEG_TURBO
	select BR2_PACKAGE_LIBOGG

        select BR2_PACKAGE_LIBVORBIS
        select BR2_PACKAGE_FLAC
        select BR2_PACKAGE_LIBMAD
        select BR2_PACKAGE_LIBPNG
        select BR2_PACKAGE_LIBTHEORA
        select BR2_PACKAGE_FAAD2
        select BR2_PACKAGE_FLUIDSYNTH
        select BR2_PACKAGE_FREETYPE

	select BR2_PACKAGE_ZLIB  

        help
		ScummVM point and click 
		http://wiki.scummvm.org/

comment "Scummvm  needs a toolchain w/ C++,  SDL"
	depends on !BR2_INSTALL_LIBSTDCPP || !BR2_PACKAGE_SDL
```

## package/batocera/toolchain/toolchain-optional-linaro-aarch64/Config.in
```kconfig
config BR2_TOOLCHAIN_OPTIONAL_LINARO_AARCH64
	bool "toolchain-optional-linaro-aarch64"
	depends on BR2_HOSTARCH = "x86_64" || BR2_HOSTARCH = "x86"
	help
	  Toolchain for the AArch64 architecture that can be optionally used by packages at compile time, from
	  http://www.linaro.org/engineering/armv8/
```

## package/batocera/utils-host/aml-dtbtools/Config.in.host
```kconfig
config BR2_PACKAGE_HOST_AML_DTBTOOLS
	bool "aml-dtbTools"
	depends on BR2_arm || BR2_aarch64
	help
	    Comprises of a splitter and builder of AmLogic's multi-dtb formats.
	    The format is deduced from the AmLogic u-boot code
	    The dtbTool is based on dtbTool source from the CyanogenMod project.
```

## package/batocera/utils-host/cargo-c/Config.in.host
```kconfig
config BR2_PACKAGE_HOST_CARGO_C
	bool "host-cargo-c"
	depends on BR2_PACKAGE_HOST_RUSTC_ARCH_SUPPORTS
	select BR2_PACKAGE_HOST_RUSTC
	help
	  build and install C-compatible libraries.

	  https://github.com/lu-zero/
```

## package/batocera/utils-host/cbindgen/Config.in.host
```kconfig
config BR2_PACKAGE_HOST_CBINDGEN
	bool "host cbindgen"
	depends on BR2_PACKAGE_HOST_RUSTC_ARCH_SUPPORTS
	select BR2_PACKAGE_HOST_RUSTC
	help
	  A project for generating C bindings from Rust code.

	  https://github.com/mozilla/cbindgen
```

## package/batocera/utils-host/xa/Config.in.host
```kconfig
config BR2_PACKAGE_HOST_XA
	bool "xa"
	help
	  xa is a high-speed, two-pass portable cross-assembler.
```

## package/batocera/utils/Config.in
```kconfig
source "package/batocera/utils/raspi2png/Config.in"
source "package/batocera/utils/megatools/Config.in"
source "package/batocera/utils/jstest2/Config.in"
source "package/batocera/utils/unclutter/Config.in"
source "package/batocera/utils/fluidsynth/Config.in"
```

## package/batocera/utils/alsa-ucm-conf/Config.in
```kconfig
config BR2_PACKAGE_ALSA_UCM_CONF
	bool "alsa-ucm-conf"
	help
	  ALSA Use Case Manager configuration.

	  https://github.com/alsa-project/alsa-ucm-conf
```

## package/batocera/utils/batocera-battery-checker/Config.in
```kconfig
config BR2_PACKAGE_BATOCERA_BATTERY_CHECKER
	bool "batocera-battery-checker"
	depends on BR2_PACKAGE_BATOCERA_RESOLUTION
```

## package/batocera/utils/batocera-ethtool/Config.in
```kconfig
config BR2_PACKAGE_BATOCERA_ETHTOOL
	bool "batocera-ethtool"

		select BR2_PACKAGE_ETHTOOL
```

## package/batocera/utils/batocera-led-handheld/Config.in
```kconfig
config BR2_PACKAGE_BATOCERA_LED_HANDHELD
	bool "batocera-led-handheld"
	select BR2_PACKAGE_PYTHON3
	select BR2_PACKAGE_PYTHON_BATOCERA_COMMON
	help
	  Batocera tools to manage LED on handheld devices
```

## package/batocera/utils/batocera-nfc/Config.in
```kconfig
config BR2_PACKAGE_BATOCERA_NFC
	bool "batocera-nfc"

 	select BR2_PACKAGE_PYTHON_NFCPY
	select BR2_PACKAGE_PYTHON_NDEFLIB
```

## package/batocera/utils/batocera-onscreen-keyboard/Config.in
```kconfig
config BR2_PACKAGE_BATOCERA_ONSCREEN_KEYBOARD
	bool "batocera-onscreen-keyboard"
	select BR2_PACKAGE_WAYLAND
	select BR2_PACKAGE_PANGO
	select BR2_PACKAGE_LIBXKBCOMMON
	select BR2_PACKAGE_CAIRO

	help
	  wvkbd - On-screen virtual keyboard for Wayland/wlroots.

	  Provides a touchscreen virtual keyboard for Batocera systems
	  running Wayland/Sway. Integrates with Control Center for
	  easy toggling via SIGUSR1.

	  https://github.com/jjsullivan5196/wvkbd
```

## package/batocera/utils/batocera-pygame/Config.in
```kconfig
config BR2_PACKAGE_BATOCERA_PYGAME
	bool "batocera-pygame"

	select BR2_PACKAGE_PYTHON_PYGAME2
	select BR2_PACKAGE_EVMAPY
```
