## package/batocera/controllers/guns/openfire-guns/Config.in
```kconfig
config BR2_PACKAGE_OPENFIRE_GUNS
	bool "openfire-guns"
	select BR2_PACKAGE_EVSIEVE
	help
	  Support for Open Four Infa-Red Emitter Light Gun System.
	  OpenFIRE Lightgun is a feature rich open source firmware to allow lightgun enthusiasts
	  to build their own lightgun that will work on modern flat screen displays.

	  https://openfirelightgun.org/
```

## package/batocera/controllers/guns/samco-guns/Config.in
```kconfig
config BR2_PACKAGE_SAMCO_GUNS
	bool "samco-guns"

	help
	  samco guns support (https://github.com/samuelballantyne/IR-Light-Gun)
```

## package/batocera/controllers/guns/xgunner-lightguns/Config.in
```kconfig
config BR2_PACKAGE_XGUNNER_LIGHTGUNS
	bool "xgunner-lightguns"
	select BR2_PACKAGE_EVSIEVE
	help
	  Support for X-Gunner lightguns.
```

## package/batocera/controllers/hid-nx/Config.in
```kconfig
config BR2_PACKAGE_HID_NX
	bool "hid-nx"
	select BR2_PACKAGE_LIBUSB
	  help
	    Alternative Linux kernel HID driver for Nintendo Switch controllers
	    
	    https://github.com/emilyst/hid-nx-dkms
```

## package/batocera/controllers/joycond/Config.in
```kconfig
config BR2_PACKAGE_JOYCOND
    bool "joycond"
    select BR2_PACKAGE_ACL
    select BR2_PACKAGE_LIBEVDEV
    select BR2_PACKAGE_HAS_UDEV
    depends on BR2_PACKAGE_HID_NX
    help
      Joycond is a linux daemon which uses the evdev devices provided by
      hid-nintendo (now in the kernel) to implement joycon pairing.

      https://github.com/DanielOgorchock/joycond
```

## package/batocera/controllers/lightguns-games-precalibrations/Config.in
```kconfig
config BR2_PACKAGE_LIGHTGUNS_GAMES_PRECALIBRATIONS
        bool "lightguns-games-precalibrations"
	
        help
          lightguns precalibration files
```

## package/batocera/controllers/mk_arcade_joystick_rpi/Config.in
```kconfig
config BR2_PACKAGE_MK_ARCADE_JOYSTICK_RPI
	bool "mk_arcade_joystick_rpi GPIO Kernel Module"
	depends on BR2_LINUX_KERNEL
	help
	  Kernel module to support joystick on rpi gpios

comment "mk_arcade_joystick_rpi needs a kernel and headers"
	depends on !BR2_LINUX_KERNEL
```

## package/batocera/controllers/new-lg4ff/Config.in
```kconfig
config BR2_PACKAGE_NEW_LG4FF
	bool "new-lg4ff"
	help
	    Linux kernel driver for lg4ff
	    
	    https://github.com/berarma/new-lg4ff
```

## package/batocera/controllers/nso-n64/Config.in
```kconfig
config BR2_PACKAGE_NSO_N64
    bool "nso-n64"

    help
	  fixes nso n64 calibration
```

## package/batocera/controllers/pads/anbernic-gpio-pad/Config.in
```kconfig
config BR2_PACKAGE_ANBERNIC_GPIO_PAD
	bool "anbernic-gpio-pad"
	select BR2_PACKAGE_EVSIEVE
	help
	  Method to consolidate Anbernic & Powkiddy input devices to a single controller.
```

## package/batocera/controllers/pads/db9_gpio_rpi/Config.in
```kconfig
config BR2_PACKAGE_DB9_GPIO_RPI
	bool "db9_gpio_driver"
	help
	  Kernel module to support db9 joysticks on gpios
```

## package/batocera/controllers/pads/gamecon_gpio_rpi/Config.in
```kconfig
config BR2_PACKAGE_GAMECON_GPIO_RPI
	bool "gamecon_gpio_driver"
	help
	  Kernel module to support snes,nes,psx joysticks on gpios
```

## package/batocera/controllers/pads/input-wrapper/Config.in
```kconfig
config BR2_PACKAGE_INPUT_WRAPPER
    bool "input-wrapper"

    help
        Virtual Controller is a simple C program to emulate to userspace
        a controller composed of a specific set of input devices.

        https://github.com/macromorgan/input-wrapper
```

## package/batocera/controllers/pads/joycond/Config.in
```kconfig
config BR2_PACKAGE_JOYCOND
    bool "joycond"
    select BR2_PACKAGE_ACL
    select BR2_PACKAGE_LIBEVDEV
    select BR2_PACKAGE_HAS_UDEV
    help
      Joycond is a linux daemon which uses the evdev devices provided by
      hid-nintendo (now in the kernel) to implement joycon pairing.

      https://github.com/DanielOgorchock/joycond
```

## package/batocera/controllers/pads/keyboardtopads/Config.in
```kconfig
config BR2_PACKAGE_KEYBOARDTOPADS
	bool "keyboardtopads"
	select BR2_PACKAGE_EVSIEVE
```

## package/batocera/controllers/pads/nso-n64/Config.in
```kconfig
config BR2_PACKAGE_NSO_N64
    bool "nso-n64"
    help
	  Script to help fixes NSO N64 controller calibration.
```

## package/batocera/controllers/pads/rocknix-joypad/Config.in
```kconfig
config BR2_PACKAGE_ROCKNIX_JOYPAD
    bool "rocknix-joypad"
    depends on BR2_LINUX_KERNEL
    help
      Linux kernel driver for various handheld devices.
      Provides input support for analog sticks connected via
      ADC and Multiplexers, and buttons via GPIO.
      Thanks Rocknix team!
      
      https://github.com/ROCKNIX/rocknix-joypad

comment "rocknix-joypad needs a Linux kernel to be built"
	depends on !BR2_LINUX_KERNEL
```

## package/batocera/controllers/pads/umtool/Config.in
```kconfig
config BR2_PACKAGE_UMTOOL
    bool "umtool"
    depends on BR2_PACKAGE_HAS_UDEV
    select BR2_PACKAGE_JSON_C
    select BR2_PACKAGE_LIBTOOL
    select BR2_PACKAGE_LIBUSB
    help
        Command line tool for configuring Ultimarc arcade hardware

        https://www.ultimarc.com
        https://github.com/katie-snow/Ultimarc-linux
```

## package/batocera/controllers/pads/wiimote-3rdparty/Config.in
```kconfig
config BR2_PACKAGE_WIIMOTE_3RDPARTY
	bool "wiimote-3rdparty"

	help
	  support for wiimote3rd party
```

## package/batocera/controllers/qt5gamepad/Config.in
```kconfig
config BR2_PACKAGE_QT5GAMEPAD
	bool "qt5gamepad"
	select BR2_PACKAGE_QT5BASE
	
	help
		A Qt5 module that adds support for reading
		from Gamepad devices on Linux
```

## package/batocera/controllers/qtsixa-shanwan/Config.in
```kconfig
config BR2_PACKAGE_QTSIXA_SHANWAN
	depends on BR2_PACKAGE_BLUEZ5_UTILS
	select BR2_PACKAGE_QTSIXA
	select BR2_PACKAGE_LIBUSB
	select BR2_PACKAGE_LIBUSB_COMPAT
        bool "qtsixashanwan"
        help
          Support for ps3 controllers.


comment "qtsixashanwan depends on bluez5-utils checkinstall libusb-dev libbluetooth-dev joystick"
	depends on !BR2_PACKAGE_BLUEZ5_UTILS || !BR2_PACKAGE_LIBUSB
```
