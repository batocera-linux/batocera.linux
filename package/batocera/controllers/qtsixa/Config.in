## package/batocera/controllers/qtsixa/Config.in
```kconfig
config BR2_PACKAGE_QTSIXA
	depends on BR2_PACKAGE_BLUEZ5_UTILS
	select BR2_PACKAGE_LIBUSB
	select BR2_PACKAGE_LIBUSB_COMPAT
        bool "qtsixa"
        help
          Support for ps3 controllers.


comment "qtsixa depends on bluez5 checkinstall libusb-dev libbluetooth-dev joystick"
	depends on !BR2_PACKAGE_BLUEZ5_UTILS || !BR2_PACKAGE_LIBUSB
```

## package/batocera/controllers/retrogame/Config.in
```kconfig
config BR2_PACKAGE_RETROGAME
    bool "retrogame"
    help
      retrogame is optimized for Pi2 and manage a 2 player panel with an ESC key
```

## package/batocera/controllers/retroshooter-guns/Config.in
```kconfig
config BR2_PACKAGE_RETROSHOOTER_GUNS
	bool "retroshooter-guns"
	select BR2_PACKAGE_EVSIEVE

	help
	  retroshooter guns support
```

## package/batocera/controllers/sinden-guns-libs/Config.in
```kconfig
config BR2_PACKAGE_SINDEN_GUNS_LIBS
	bool "sinden-guns"
	select BR2_PACKAGE_LIBV4L
	select BR2_PACKAGE_LIBV4L_UTILS

	help
	  sinden guns support libs
```

## package/batocera/controllers/sinden-guns/Config.in
```kconfig
config BR2_PACKAGE_SINDEN_GUNS
	bool "sinden-guns"
	select BR2_PACKAGE_MONO
	select BR2_PACKAGE_LIBV4L
	select BR2_PACKAGE_LIBV4L_UTILS
	select BR2_PACKAGE_LIBGDIPLUS
	select BR2_PACKAGE_SINDEN_GUNS_LIBS

	help
	  sinden guns support
```

## package/batocera/controllers/ultimarc/Config.in
```kconfig
config BR2_PACKAGE_ULTIMARC
    bool "ultimarc"
    depends on BR2_PACKAGE_HAS_UDEV
    select BR2_PACKAGE_JSON_C
    select BR2_PACKAGE_LIBTOOL
    select BR2_PACKAGE_LIBUSB
```

## package/batocera/controllers/wheels/batocera-wheel-calibrator/Config.in
```kconfig
config BR2_PACKAGE_BATOCERA_WHEEL_CALIBRATOR
	bool "batocera-wheel-calibrator"
	select BR2_PACKAGE_PYTHON_PYUDEV

	help
	  wheel calibration support
```

## package/batocera/controllers/wiimotes-rules/Config.in
```kconfig
config BR2_PACKAGE_WIIMOTES_RULES
	bool "wiimotes-rules"
	select BR2_PACKAGE_EVSIEVE
	select BR2_PACKAGE_BATOCERA_GUN_CALIBRATOR

	help
	  wiimote support
```

## package/batocera/controllers/xboxdrv/Config.in
```kconfig
config BR2_PACKAGE_XBOXDRV
        bool "xbox and ps3 xboxdrv"
	depends on BR2_PACKAGE_RETROARCH
	depends on BR2_INSTALL_LIBSTDCPP
	select BR2_PACKAGE_BOOST
	select BR2_PACKAGE_DBUS_CPP
	select BR2_PACKAGE_DBUS_PYTHON
	select BR2_PACKAGE_DBUS_TRIGGERD
        help
	  Xbox and ps3 controller support
	  http://www.libretro.com

comment "XBOXDRV needs a toolchain w/ C++"
	depends on !BR2_INSTALL_LIBSTDCPP
```

## package/batocera/controllers/xone/Config.in
```kconfig
config BR2_PACKAGE_XONE
	bool "xone"
	select BR2_PACKAGE_LIBUSB
	  help
	    Linux kernel driver for Xbox One and Xbox Series X|S accessories
	    
	    https://github.com/medusalix/xone
```

## package/batocera/controllers/xpad-noone/Config.in
```kconfig
config BR2_PACKAGE_XPAD_NOONE
	bool "xpad-noone"
	select BR2_PACKAGE_LIBUSB
	  help
	    This is the original xpad kernel driver with support for Xbox One controllers removed.
	    We use the xone module driver for the Xbox One controllers.
	    
	    https://github.com/medusalix/xpad-noone
```

## package/batocera/controllers/xpadneo/Config.in
```kconfig
config BR2_PACKAGE_XPADNEO
	bool "xpadneo"
	select BR2_PACKAGE_BLUEZ5_UTILS
	  help
	    Linux kernel driver for Xbox One and Xbox Series X|S accessories using Bluetooth
	    
	    https://atar-axis.github.io/xpadneo/
```

## package/batocera/core/batocera-audio-alsa/Config.in
```kconfig
config BR2_PACKAGE_BATOCERA_AUDIO_ALSA
	bool "batocera-audio"
	select BR2_PACKAGE_BLUEZ_ALSA
	select BR2_PACKAGE_ALSA_UTILS
	select BR2_PACKAGE_ALSA_UTILS_AMIXER
	select BR2_PACKAGE_ALSA_UTILS_APLAY
	select BR2_PACKAGE_ALSA_PLUGINS
	help
	  Audio support and scripts for batocera.linux (ALSA)
```

## package/batocera/core/batocera-audio/Config.in
```kconfig
config BR2_PACKAGE_BATOCERA_AUDIO
	bool "batocera-audio"
	select BR2_PACKAGE_ALSA_UTILS
	select BR2_PACKAGE_ALSA_UTILS_AMIXER
	select BR2_PACKAGE_ALSA_UTILS_APLAY
	select BR2_PACKAGE_ALSA_UTILS_ALSAUCM
	select BR2_PACKAGE_ALSA_UCM_CONF
	select BR2_PACKAGE_ALSA_TOPOLOGY_CONF       if BR2_PACKAGE_BATOCERA_TARGET_X86_ANY
	select BR2_PACKAGE_CHROMEBOOK_UCM_CONF      if BR2_PACKAGE_BATOCERA_TARGET_X86_ANY
	select BR2_PACKAGE_CHROMEBOOK_LINUX_AUDIO   if BR2_PACKAGE_BATOCERA_TARGET_X86_ANY
	select BR2_PACKAGE_ALSA_UTILS_ALSAINFO
	select BR2_PACKAGE_ALSA_PLUGINS
	select BR2_PACKAGE_SBC
	select BR2_PACKAGE_PIPEWIRE
	select BR2_PACKAGE_PULSEAUDIO
	select BR2_PACKAGE_WIREPLUMBER
	select BR2_PACKAGE_PIPEWIRE_GSTREAMER
	select BR2_PACKAGE_PIPEWIRE_V4L2
	select BR2_PACKAGE_GST1_PLUGINS_BAD
	select BR2_PACKAGE_GST1_PLUGINS_BAD_PLUGIN_ADPCMDEC
	select BR2_PACKAGE_GST1_PLUGINS_BAD_PLUGIN_ADPCMENC
	select BR2_PACKAGE_GST1_PLUGINS_BAD_PLUGIN_SBC
	select BR2_PACKAGE_GST1_PLUGINS_BAD_PLUGIN_FAAD
	select BR2_PACKAGE_GST1_PLUGINS_BAD_PLUGIN_FDK_AAC
	select BR2_PACKAGE_GST1_PLUGINS_BAD_PLUGIN_BLUEZ
	select BR2_PACKAGE_GST1_PLUGINS_BAD_PLUGIN_MIDI
	select BR2_PACKAGE_GST1_PLUGINS_BAD_PLUGIN_OPENAL
	select BR2_PACKAGE_GST1_PLUGINS_BAD_PLUGIN_OPUS
	select BR2_PACKAGE_GST1_PLUGINS_BAD_PLUGIN_VOAACENC
	select BR2_PACKAGE_LIBFREEAPTX
	select BR2_PACKAGE_LIBLDAC
	select BR2_PACKAGE_LIBLC3
	help
	  Audio support and scripts for batocera.linux
```

## package/batocera/core/batocera-bluetooth/Config.in
```kconfig
config BR2_PACKAGE_BATOCERA_BLUETOOTH
	bool "batocera-bluetooth"
   	select BR2_PACKAGE_BLUEZ5_UTILS
   	select BR2_PACKAGE_BLUEZ5_UTILS_CLIENT
   	select BR2_PACKAGE_BLUEZ5_UTILS_TEST
   	select BR2_PACKAGE_BLUEZ5_UTILS_PLUGINS_SIXAXIS
   	select BR2_PACKAGE_BLUEZ5_UTILS_DEPRECATED
    select BR2_PACKAGE_BLUEZ5_UTILS_TOOLS # needed for sixaxis
    select BR2_PACKAGE_UTIL_LINUX_RFKILL
  	help
	  Bluetooth support and scripts for batocera.linux
```

## package/batocera/core/batocera-configgen/Config.in
```kconfig
config BR2_PACKAGE_BATOCERA_CONFIGGEN
    bool "batocera configgen"
	select BR2_PACKAGE_PYTHON3
	select BR2_PACKAGE_PYTHON_PYYAML
	select BR2_PACKAGE_PYTHON_RUAMEL_YAML
	select BR2_PACKAGE_PYTHON_TOML
	select BR2_PACKAGE_PYTHON_PILLOW
	select BR2_PACKAGE_PYTHON_QRCODE # for retroachievement urls
	select BR2_PACKAGE_PYTHON_PSUTIL
	select BR2_PACKAGE_PYTHON3_CONFIGOBJ
	select BR2_PACKAGE_PYTHON_REQUESTS
	select BR2_PACKAGE_PYTHON_PYUDEV # for guns
	select BR2_PACKAGE_MANGOHUD      if (BR2_PACKAGE_WAYLAND || BR2_PACKAGE_XORG7 || BR2_PACKAGE_LIBDRM) && !BR2_PACKAGE_BATOCERA_TARGET_S905
	select BR2_PACKAGE_PYSDL2
    help
      The configuration utility for batocera.
	  
	  The purpose of the lib is to automatically configure emulators,
	  using the environment variables available in Batocera.
      The main program is emulatorlauncher.py, taking 13 parameters,
	  that are the system and 4 controllers configurations.
```

## package/batocera/core/batocera-controlcenter/Config.in
```kconfig
config BR2_PACKAGE_BATOCERA_CONTROLCENTER
	bool "batocera-controlcenter"
	select BR2_PACKAGE_PYTHON3
	select BR2_PACKAGE_PYTHON_EVDEV

	help
	  A flexible, XML-driven control panel for Batocera that provides
	  an on-screen interface for system configuration and control.
	  Works on both X11 and Wayland (Sway) with gamepad / touchscreen / keyboard.
```

## package/batocera/core/batocera-controller-overlays/Config.in
```kconfig
config BR2_PACKAGE_BATOCERA_CONTROLLER_OVERLAYS
    bool "batocera-controller-overlays"
    help
      Controller overlays that can be "tattooed" onto a libretro bezel
```

## package/batocera/core/batocera-desktopapps/Config.in
```kconfig
config BR2_PACKAGE_BATOCERA_DESKTOPAPPS
    bool "batocera-desktopapps"
    depends on BR2_PACKAGE_XORG7
    depends on BR2_PACKAGE_PCMANFM # file manager
    select BR2_PACKAGE_YAD    if BR2_PACKAGE_LIBGTK2 || BR2_PACKAGE_LIBGTK3_X11
    help
      Batocera desktop applications
```

## package/batocera/core/batocera-drminfo/Config.in
```kconfig
config BR2_PACKAGE_BATOCERA_DRMINFO
       depends on BR2_PACKAGE_LIBDRM
       bool "batocera-drminfo"
```

## package/batocera/core/batocera-image/Config.in
```kconfig
config BR2_PACKAGE_BATOCERA_IMAGE
	bool "batocera-image"
	select BR2_PACKAGE_HOST_GENIMAGE
	select BR2_PACKAGE_HOST_GENEXT2FS
	help
	  Utilities needed to build Batocera.linux images
```

## package/batocera/core/batocera-launch/Config.in
```kconfig
config BR2_PACKAGE_BATOCERA_LAUNCH
	bool "batocera launch"
	select BR2_PACKAGE_PYTHON3
	select BR2_PACKAGE_PYTHON_PYYAML
	select BR2_PACKAGE_PYTHON_RUAMEL_YAML
	select BR2_PACKAGE_PYTHON_TYPING_EXTENSIONS
	select BR2_PACKAGE_PYTHON_BATOCERA_COMMON
	select BR2_PACKAGE_PYTHON_EVDEV
	select BR2_PACKAGE_PYTHON_PYUDEV # for guns
	select BR2_PACKAGE_PYSDL2
	select BR2_PACKAGE_PYTHON_TOML
	select BR2_PACKAGE_PYTHON_PILLOW
	select BR2_PACKAGE_PYTHON_QRCODE # for retroachievement urls
	select BR2_PACKAGE_MANGOHUD      if (BR2_PACKAGE_WAYLAND || BR2_PACKAGE_XORG7 || BR2_PACKAGE_LIBDRM) && !BR2_PACKAGE_BATOCERA_TARGET_S905
	help
	  The emulator launcher for batocera.
```

## package/batocera/core/batocera-notice/Config.in
```kconfig
config BR2_PACKAGE_BATOCERA_NOTICE
    bool "batocera-notice"
    help
      Batocera pdf notice
```
