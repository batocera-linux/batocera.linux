## package/batocera/boot/uboot-common/uboot-rk3399/uboot-rock-pi-4/Config.in
```kconfig
config BR2_PACKAGE_UBOOT_ROCK_PI_4
  bool "rk3399/rock pi 4 u-boot"
  help
    U-Boot for rk3399/rock pi 4 board

config BR2_PACKAGE_UBOOT_ROCK_PI_4_VERSION
  string "rk3399/rock pi 4 u-boot version"
  default BR2_PACKAGE_UBOOT_RK3399_VERSION
  help
    U-Boot version to use for rk3399/rock pi 4 board
```

## package/batocera/boot/uboot-common/uboot-rk3399/uboot-rock960/Config.in
```kconfig
config BR2_PACKAGE_UBOOT_ROCK960
  bool "rk3399/rock960 u-boot"
  help
    U-Boot for rk3399/rock960 board

config BR2_PACKAGE_UBOOT_ROCK960_VERSION
  string "rk3399/rock960 u-boot version"
  default BR2_PACKAGE_UBOOT_RK3399_VERSION
  help
    U-Boot version to use for rk3399/rock960 board
```

## package/batocera/boot/uboot-common/uboot-rk3399/uboot-rockpro64/Config.in
```kconfig
config BR2_PACKAGE_UBOOT_ROCKPRO64
  bool "rk3399/rockpro64 u-boot"
  help
    U-Boot for rk3399/rockpro64 board

config BR2_PACKAGE_UBOOT_ROCKPRO64_VERSION
  string "rk3399/rockpro64 u-boot version"
  default BR2_PACKAGE_UBOOT_RK3399_VERSION
  help
    U-Boot version to use for rk3399/rockpro64 board
```

## package/batocera/boot/uboot-evb-rk3399/Config.in
```kconfig
config BR2_PACKAGE_UBOOT_EVB_RK3399
    bool "uboot files for generic rk3399"
    help
        uboot files for generic rk3399
```

## package/batocera/boot/uboot-firefly-station-m2/Config.in
```kconfig
config BR2_PACKAGE_UBOOT_FIREFLY_STATION_M2
    bool "uboot-firefly-station-m2"
    help
      uboot files for Firefly Station M2
```

## package/batocera/boot/uboot-firefly-station-p2/Config.in
```kconfig
config BR2_PACKAGE_UBOOT_FIREFLY_STATION_P2
    bool "uboot-firefly-station-p2"
    help
      uboot files for Firefly Station P2
```

## package/batocera/boot/uboot-gameforce-chi/Config.in
```kconfig
config BR2_PACKAGE_UBOOT_GAMEFORCE_CHI
        bool "uboot-gameforce-chi"
        select BR2_TOOLCHAIN_OPTIONAL_LINARO_AARCH64
        help
          uboot files for gameforce chi rk3326
```

## package/batocera/boot/uboot-gameforce/Config.in
```kconfig
config BR2_PACKAGE_UBOOT_GAMEFORCE
    bool "uboot files for gameforce"
    select BR2_TOOLCHAIN_OPTIONAL_LINARO_AARCH64
    help
        uboot files for gameforce chi
```

## package/batocera/boot/uboot-hugsun-x99/Config.in
```kconfig
config BR2_PACKAGE_UBOOT_HUGSUN_X99
    bool "uboot files for Hugsun X99 TV Box"
    help
        uboot files for Hugsun X99 TV Box
```

## package/batocera/boot/uboot-khadas-edge-2/Config.in
```kconfig
config BR2_PACKAGE_UBOOT_KHADAS_EDGE_2
    bool "uboot files for Khadas Edge 2"
    help
        uboot files for Khadas Edge 2
```

## package/batocera/boot/uboot-miqi/Config.in
```kconfig
config BR2_PACKAGE_UBOOT_MIQI
        bool "uboot files for miqi"
        help
          uboot files for miqi
```

## package/batocera/boot/uboot-multi-h616/Config.in
```kconfig
config BR2_PACKAGE_UBOOT_MULTI_H616
  bool "U-Boot for multiple boards"
  select BR2_TARGET_ARM_TRUSTED_FIRMWARE 
  select BR2_TARGET_ARM_TRUSTED_FIRMWARE_LATEST_VERSION 
  select BR2_TARGET_ARM_TRUSTED_FIRMWARE_BL31 
  select BR2_TARGET_UBOOT_NO_SCP 
  help
    U-Boot for multiple boards. NOTE: some related configs, like
    BR2_TARGET_ARM_TRUSTED_FIRMWARE_PLATFORM have to be set in
    xxx.board files.

if BR2_PACKAGE_UBOOT_MULTI_H616

config BR2_PACKAGE_UBOOT_MULTI_H616_CONFIGS
  string "U-Boot configs"
  default "orangepi_zero2 orangepi_zero3 x96_mate"			     
  help
    Names of U-Boot defconfigs to build without the _defconfig part.
    These also define the directory to search for board specific
    patches and config fragment files, and they also define the
    install directory name.

config BR2_PACKAGE_UBOOT_MULTI_H616_BINARIES
  string "U-Boot binaries"
  default "u-boot-sunxi-with-spl.bin" 
  help
    List of U-Boot binaries to be collected.

endif # BR2_PACKAGE_UBOOT_MULTI_H616
```

## package/batocera/boot/uboot-multiboard/Config.in
```kconfig
config BR2_PACKAGE_UBOOT_MULTIBOARD
  bool "U-Boot for multiple boards"
  select BR2_TARGET_ARM_TRUSTED_FIRMWARE if !BR2_PACKAGE_BATOCERA_TARGET_H3
  select BR2_TARGET_ARM_TRUSTED_FIRMWARE_LATEST_VERSION 
  select BR2_TARGET_ARM_TRUSTED_FIRMWARE_BL32 \
    if BR2_PACKAGE_BATOCERA_TARGET_RK3288
  select BR2_TARGET_ARM_TRUSTED_FIRMWARE_BL31 if \
    !BR2_PACKAGE_BATOCERA_TARGET_RK3288 && !BR2_PACKAGE_BATOCERA_TARGET_H3
  select BR2_TARGET_ARM_TRUSTED_FIRMWARE_NEEDS_ARM32_TOOLCHAIN \
    if BR2_PACKAGE_BATOCERA_TARGET_RK3399
  select BR2_TARGET_UBOOT_NO_SCP if BR2_PACKAGE_BATOCERA_TARGET_H5 || BR2_PACKAGE_BATOCERA_TARGET_H6 || BR2_PACKAGE_BATOCERA_TARGET_H616
  help
    U-Boot for multiple boards. NOTE: some related configs, like
    BR2_TARGET_ARM_TRUSTED_FIRMWARE_PLATFORM have to be set in
    xxx.board files.

if BR2_PACKAGE_UBOOT_MULTIBOARD

config BR2_PACKAGE_UBOOT_MULTIBOARD_CONFIGS
  string "U-Boot configs"
  default "miqi-rk3288 tinker-s-rk3288" if BR2_PACKAGE_BATOCERA_TARGET_RK3288
  default "orangepi-rk3399 rock960-rk3399 rock-pi-4-rk3399 rockpro64-rk3399" if BR2_PACKAGE_BATOCERA_TARGET_RK3399
  default "libretech_all_h3_cc_h3 orangepi_one orangepi_pc orangepi_pc_plus orangepi_plus2e bananapi_m2_zero" if BR2_PACKAGE_BATOCERA_TARGET_H3
  default "libretech_all_h3_cc_h5 orangepi_pc2"                              if BR2_PACKAGE_BATOCERA_TARGET_H5
  default "orangepi_3 orangepi_3_lts orangepi_one_plus"                      if BR2_PACKAGE_BATOCERA_TARGET_H6
  default "orangepi_zero2"						if BR2_PACKAGE_BATOCERA_TARGET_H616
  default ""
  help
    Names of U-Boot defconfigs to build without the _defconfig part.
    These also define the directory to search for board specific
    patches and config fragment files, and they also define the
    install directory name.

config BR2_PACKAGE_UBOOT_MULTIBOARD_BINARIES
  string "U-Boot binaries"
  default "u-boot-sunxi-with-spl.bin" if BR2_PACKAGE_BATOCERA_TARGET_H3 || BR2_PACKAGE_BATOCERA_TARGET_H5 || BR2_PACKAGE_BATOCERA_TARGET_H6 || BR2_PACKAGE_BATOCERA_TARGET_H616
  default "idbloader.img u-boot.img"  if BR2_PACKAGE_BATOCERA_TARGET_RK3288
  default "idbloader.img u-boot.itb"  if BR2_PACKAGE_BATOCERA_TARGET_RK3399
  default ""
  help
    List of U-Boot binaries to be collected.

endif # BR2_PACKAGE_UBOOT_MULTIBOARD
```

## package/batocera/boot/uboot-nanopi-m6/Config.in
```kconfig
config BR2_PACKAGE_UBOOT_NANOPI_M6
    bool "uboot-nanopi-m6"
    help
        U-Boot files for NanoPi M6

        https://github.com/friendlyarm/uboot-rockchip
        https://wiki.friendlyelec.com/wiki/index.php/NanoPi_M6#Get_Started
```

## package/batocera/boot/uboot-odroid-c2/Config.in
```kconfig
config BR2_PACKAGE_UBOOT_ODROID_C2
        bool "uboot files for odroid c2"
        help
          uboot files for odroid c2
```

## package/batocera/boot/uboot-odroid-goa/Config.in
```kconfig
config BR2_PACKAGE_UBOOT_ODROID_GOA
        bool "uboot files for odroidgoa"
	select BR2_TOOLCHAIN_OPTIONAL_LINARO_AARCH64
        help
          uboot files for odroidgoa
```

## package/batocera/boot/uboot-odroid-m1s/Config.in
```kconfig
config BR2_PACKAGE_UBOOT_ODROID_M1S
    bool "uboot-odroid-m1s"
    help
      U-Boot for the Odroid M1s.

      https://u-boot.org/
```

## package/batocera/boot/uboot-odroid-m2/Config.in
```kconfig
config BR2_PACKAGE_UBOOT_ODROID_M2
    bool "uboot-odroid-m2"
    help
      U-Boot for the Hardkernel Odroid M2.

      https://u-boot.org/
```

## package/batocera/boot/uboot-odroid-n2/Config.in
```kconfig
config BR2_PACKAGE_UBOOT_ODROID_N2
        bool "uboot files for odroid n2"
        help
          uboot files for odroid n2
```

## package/batocera/boot/uboot-odroid-xu4/Config.in
```kconfig
config BR2_PACKAGE_UBOOT_ODROID_XU4
        bool "uboot files for odroid xu4"
        help
          uboot files for odroid xu4
```

## package/batocera/boot/uboot-orangepi-3b/Config.in
```kconfig
config BR2_PACKAGE_UBOOT_ORANGEPI_3B
    bool "uboot-orangepi-3b"
    help
      U-Boot files for OrangePi 3B

      https://github.com/orangepi-xunlong/u-boot-orangepi/tree/v2017.09-rk3588
```

## package/batocera/boot/uboot-orangepi-4-lts/Config.in
```kconfig
config BR2_PACKAGE_UBOOT_ORANGEPI_4_LTS
    bool "uboot files for OrangePi 4 LTS"
    help
        uboot files for OrangePi 4 LTS
```

## package/batocera/boot/uboot-orangepi-4a/Config.in
```kconfig
config BR2_PACKAGE_UBOOT_ORANGEPI_4A
    bool "uboot-orangepi-4a"
    help
      U-Boot files for OrangePi 4a
      
      https://github.com/orangepi-xunlong/u-boot-orangepi/tree/v2018.05-t527
```

## package/batocera/boot/uboot-orangepi-5-max/Config.in
```kconfig
config BR2_PACKAGE_UBOOT_ORANGEPI_5_MAX
    bool "uboot-orangepi-5-max"
    help
      U-Boot files for OrangePi 5 Max

      https://github.com/orangepi-xunlong/orangepi-build
```

## package/batocera/boot/uboot-orangepi-5-plus/Config.in
```kconfig
config BR2_PACKAGE_UBOOT_ORANGEPI_5_PLUS
    bool "uboot-orangepi-5-plus"
    help
      U-Boot files for OrangePi 5 Plus

      https://github.com/orangepi-xunlong/u-boot-orangepi/tree/v2017.09-rk3588
```
