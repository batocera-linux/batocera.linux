## package/batocera/boot/uboot-powkiddy-a13/Config.in
```kconfig
config BR2_PACKAGE_UBOOT_POWKIDDY_A13
    bool "uboot-powkiddy-a13"
    help
        uboot files for POWKIDDY_A13
```

## package/batocera/boot/uboot-ps5000/Config.in
```kconfig
config BR2_PACKAGE_UBOOT_PS5000
    bool "uboot-ps5000"
    #select BR2_TOOLCHAIN_OPTIONAL_LINARO_ARM
    help
        uboot files for PS5000
```

## package/batocera/boot/uboot-rk3562/Config.in
```kconfig
config BR2_PACKAGE_UBOOT_RK3562
	bool "uboot-rk3562"
	help
	  Mainline U-Boot for RK3562 boards
```

## package/batocera/core/batocera-controlcenter/Config.in
```kconfig
config BR2_PACKAGE_BATOCERA_CONTROLCENTER
	bool "batocera-controlcenter"

	help
	  The XML-driven control panel for Batocera, drawn by
	  EmulationStation with the current theme over whatever is running.
	  Works on X11 and Wayland (labwc) with gamepad, touchscreen and keyboard.
```

## package/batocera/emulators/opencdi/Config.in
```kconfig
config BR2_PACKAGE_OPENCDI
	bool "opencdi"
	depends on BR2_PACKAGE_HOST_RUSTC_TARGET_ARCH_SUPPORTS
	depends on BR2_PACKAGE_HAS_UDEV
	select BR2_PACKAGE_HOST_RUSTC
	select BR2_PACKAGE_ALSA_LIB
	select BR2_PACKAGE_LIBXKBCOMMON
	help
	  A Philips CD-i emulator written in Rust, with Digital Video
	  Cartridge (FMV) support.

	  https://github.com/sigsantilio/opencdi
```

## package/batocera/emulators/retroarch/libretro/libretro-anybor/Config.in
```kconfig
config BR2_PACKAGE_LIBRETRO_ANYBOR
	bool "libretro-anybor"
	depends on BR2_INSTALL_LIBSTDCPP
	depends on BR2_USE_WCHAR # libarchive
	depends on BR2_SHARED_STATIC_LIBS # shared container and static codec libraries
	select BR2_PACKAGE_LIBARCHIVE
	select BR2_PACKAGE_ZLIB
	select BR2_PACKAGE_LIBPNG
	select BR2_PACKAGE_LIBOGG
	select BR2_PACKAGE_LIBVORBIS
	select BR2_PACKAGE_LIBVPX
	help
	  A libretro openbor emulator

	  http://www.libretro.com

comment "libretro-anybor needs a toolchain w/ C++, wchar and shared and static libraries"
	depends on !BR2_INSTALL_LIBSTDCPP || !BR2_USE_WCHAR || !BR2_SHARED_STATIC_LIBS
```

## package/batocera/libraries/cubeb/Config.in
```kconfig
config BR2_PACKAGE_CUBEB
	bool "cubeb"
	depends on BR2_TOOLCHAIN_HAS_THREADS
	help
	  Cross-platform audio library from Mozilla.

	  https://github.com/mozilla/cubeb
```

## package/batocera/libraries/dsp56300/Config.in
```kconfig
config BR2_PACKAGE_DSP56300
	bool "dsp56300"
	depends on BR2_PACKAGE_HOST_RUSTC_TARGET_ARCH_SUPPORTS
	select BR2_PACKAGE_HOST_RUSTC
	help
	  Motorola DSP56300 JIT emulator library, used by xemu.

	  https://github.com/mborgerson/dsp56300
```

## package/batocera/network/bcmdhd/Config.in
```kconfig
comment "bcmdhd needs a Linux kernel to be built"
	depends on !BR2_LINUX_KERNEL

config BR2_PACKAGE_BCMDHD
	bool "bcmdhd"
	depends on BR2_LINUX_KERNEL
	help
	  Broadcom / Synaptics bcmdhd SDIO WiFi driver, for chips
	  brcmfmac does not support (AP6611S / SYN43711).

	  https://github.com/armbian/bcmdhd-dkms
```

## package/batocera/network/swt6621s/Config.in
```kconfig
comment "swt6621s needs a Linux kernel to be built"
	depends on !BR2_LINUX_KERNEL

config BR2_PACKAGE_SWT6621S
	bool "swt6621s"
	depends on BR2_LINUX_KERNEL
	help
	  SeekWave SWT6621S SDIO Wi-Fi and Bluetooth drivers.
	  The kernel needs CFG80211, MMC and Bluetooth support.

	  https://github.com/Novice-PG/swt6621s
```

## package/batocera/ports/xash3d/cs16-client/Config.in
```kconfig
config BR2_PACKAGE_CS16_CLIENT
	bool "cs16-client"
	depends on BR2_INSTALL_LIBSTDCPP
	select BR2_PACKAGE_FREETYPE
	help
	  Reverse-engineered Counter-Strike 1.6 client, menu and
	  ReGameDLL server libraries for Xash3D.

	  https://github.com/FWGS/cs16-client
```

## package/batocera/utils/gamescope/Config.in
```kconfig
config BR2_PACKAGE_GAMESCOPE
	bool "gamescope"
	depends on BR2_PACKAGE_BATOCERA_VULKAN
	depends on BR2_PACKAGE_BATOCERA_LUAJIT_ARCH_SUPPORTS # batocera-luajit
	select BR2_PACKAGE_GLM
	select BR2_PACKAGE_STB
	select BR2_PACKAGE_VULKAN_HEADERS
	select BR2_PACKAGE_VULKAN_LOADER
	select BR2_PACKAGE_WAYLAND
	select BR2_PACKAGE_WAYLAND_PROTOCOLS
	select BR2_PACKAGE_XLIB_LIBX11
	help
	  SteamOS session compositing window manager, built for
	  nesting inside labwc only (no DRM backend).

	  https://github.com/ValveSoftware/gamescope

if BR2_PACKAGE_GAMESCOPE

choice
	prompt "gamescope build"
	default BR2_PACKAGE_GAMESCOPE_COMPOSITOR

config BR2_PACKAGE_GAMESCOPE_COMPOSITOR
	bool "compositor"
	select BR2_PACKAGE_HWDATA
	select BR2_PACKAGE_LIBCAP
	select BR2_PACKAGE_LIBDECOR
	select BR2_PACKAGE_LIBDISPLAY_INFO
	select BR2_PACKAGE_LIBINPUT
	select BR2_PACKAGE_LIBXKBCOMMON
	select BR2_PACKAGE_BATOCERA_LUAJIT
	select BR2_PACKAGE_PIXMAN
	select BR2_PACKAGE_WLROOTS
	select BR2_PACKAGE_WLROOTS_XWAYLAND
	select BR2_PACKAGE_XLIB_LIBXCOMPOSITE
	select BR2_PACKAGE_XLIB_LIBXCURSOR
	select BR2_PACKAGE_XLIB_LIBXDAMAGE
	select BR2_PACKAGE_XLIB_LIBXEXT
	select BR2_PACKAGE_XLIB_LIBXFIXES
	select BR2_PACKAGE_XLIB_LIBXI
	select BR2_PACKAGE_XLIB_LIBXMU
	select BR2_PACKAGE_XLIB_LIBXRENDER
	select BR2_PACKAGE_XLIB_LIBXRES
	select BR2_PACKAGE_XLIB_LIBXTST
	select BR2_PACKAGE_XLIB_LIBXXF86VM
	select BR2_PACKAGE_XWAYLAND

config BR2_PACKAGE_GAMESCOPE_WSI_LAYER_ONLY
	bool "WSI layer only"
	help
	  Only the Vulkan WSI layer, for the 32-bit Wine libraries of
	  the 64-bit images: without it gamescope can't pace or limit
	  32-bit Vulkan games.

endchoice

endif
```

## python-src/batocera-launch-kodi/Config.in
```kconfig
config BR2_PACKAGE_BATOCERA_LAUNCH_KODI
	bool
	depends on BR2_PACKAGE_PYTHON_BATOCERA_COMMON
	depends on BR2_PACKAGE_BATOCERA_LAUNCH

# Boards whose ffmpeg decoders can output DRM PRIME frames
config BR2_PACKAGE_BATOCERA_LAUNCH_KODI_DRMPRIME
	bool
	default y if BR2_PACKAGE_BATOCERA_V4L2_REQUEST || \
	             BR2_PACKAGE_BATOCERA_TARGET_BCM2711 || \
	             BR2_PACKAGE_BATOCERA_TARGET_BCM2712 || \
	             BR2_PACKAGE_BATOCERA_TARGET_S905 || \
	             BR2_PACKAGE_BATOCERA_TARGET_S905GEN2 || \
	             BR2_PACKAGE_BATOCERA_TARGET_S905GEN3 || \
	             BR2_PACKAGE_BATOCERA_TARGET_S922X || \
	             BR2_PACKAGE_BATOCERA_TARGET_SDM845 || \
	             BR2_PACKAGE_BATOCERA_TARGET_SM6115 || \
	             BR2_PACKAGE_BATOCERA_TARGET_QCS6490 || \
	             BR2_PACKAGE_BATOCERA_TARGET_SM8250 || \
	             BR2_PACKAGE_BATOCERA_TARGET_SM8550 || \
	             BR2_PACKAGE_BATOCERA_TARGET_SM8650 || \
	             BR2_PACKAGE_BATOCERA_TARGET_SM8750
	depends on BR2_PACKAGE_BATOCERA_LAUNCH_KODI
```
