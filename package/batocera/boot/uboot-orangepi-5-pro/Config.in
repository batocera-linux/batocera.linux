## package/batocera/boot/uboot-orangepi-5-pro/Config.in
```kconfig
config BR2_PACKAGE_UBOOT_ORANGEPI_5_PRO
    bool "uboot-orangepi-5-pro"
    help
        U-Boot files for OrangePi 5 Pro

        https://github.com/orangepi-xunlong/orangepi-build
```

## package/batocera/boot/uboot-orangepi-5-ultra/Config.in
```kconfig
config BR2_PACKAGE_UBOOT_ORANGEPI_5_ULTRA
    bool "uboot-orangepi-5-ultra"
    help
      U-Boot files for OrangePi 5 Ultra

      https://github.com/orangepi-xunlong/orangepi-build
```

## package/batocera/boot/uboot-orangepi-5/Config.in
```kconfig
config BR2_PACKAGE_UBOOT_ORANGEPI_5
    bool "uboot-orangepi-5"
    help
      U-Boot files for OrangePi 5

      https://github.com/orangepi-xunlong/orangepi-build
```

## package/batocera/boot/uboot-orangepi-5b/Config.in
```kconfig
config BR2_PACKAGE_UBOOT_ORANGEPI_5B
    bool "uboot-orangepi-5b"
    help
      U-Boot files for OrangePi 5b

      https://github.com/orangepi-xunlong/orangepi-build
```

## package/batocera/boot/uboot-orangepi-800/Config.in
```kconfig
config BR2_PACKAGE_UBOOT_ORANGEPI_800
    bool "uboot files for OrangePi 800"
    help
        uboot files for OrangePi 800
```

## package/batocera/boot/uboot-powkiddy-x55/Config.in
```kconfig
config BR2_PACKAGE_UBOOT_POWKIDDY_X55
    bool "uboot-powkiddy-x55"
    help
      U-Boot for the Powkiddy X55

      https://u-boot.org/
```

## package/batocera/boot/uboot-ps5000/Config.in
```kconfig
config BR2_PACKAGE_UBOOT_PS5000
    bool "uboot-ps5000"
    #select BR2_TOOLCHAIN_OPTIONAL_LINARO_ARM
    select BR2_PACKAGE_RK3128_BLOBS
    help
        uboot files for PS5000
```

## package/batocera/boot/uboot-radxa-zero-3/Config.in
```kconfig
config BR2_PACKAGE_UBOOT_RADXA_ZERO_3
    bool "uboot-radxa-zero-3"
    help
      U-Boot for the Radxa Zero 3 devices.

      https://u-boot.org/
```

## package/batocera/boot/uboot-rg351p/Config.in
```kconfig
config BR2_PACKAGE_UBOOT_RG351P
        bool "uboot-rg351p"
        select BR2_TOOLCHAIN_OPTIONAL_LINARO_AARCH64
        help
          uboot files for rg351p rk3326
```

## package/batocera/boot/uboot-rg351v/Config.in
```kconfig
config BR2_PACKAGE_UBOOT_RG351V
        bool "uboot-rg351v"
        select BR2_TOOLCHAIN_OPTIONAL_LINARO_AARCH64
        help
          uboot files for rg351v rk3326
```

## package/batocera/boot/uboot-rk3399/Config.in
```kconfig
config BR2_PACKAGE_UBOOT_RK3399
        bool "uboot files for rk3399"
        help
          uboot files for rk3399
```

## package/batocera/boot/uboot-rk3576/Config.in
```kconfig
config BR2_PACKAGE_UBOOT_RK3576
    bool "uboot-rk3576"
    help
      U-Boot for the Generic RK3576 devices.

      https://u-boot.org/
```

## package/batocera/boot/uboot-rock-3a/Config.in
```kconfig
config BR2_PACKAGE_UBOOT_ROCK_3A
    bool "uboot files for Rock 3A"
    help
        uboot files for Rock 3A
```

## package/batocera/boot/uboot-rock-3c/Config.in
```kconfig
config BR2_PACKAGE_UBOOT_ROCK_3C
    bool "uboot files for Rock 3C"
    help
        uboot files for Rock 3C
```

## package/batocera/boot/uboot-rock-4c-plus/Config.in
```kconfig
config BR2_PACKAGE_UBOOT_ROCK_4C_PLUS
	bool "uboot-rock-4c-plus"
	select BR2_TARGET_ARM_TRUSTED_FIRMWARE
	select BR2_TARGET_ARM_TRUSTED_FIRMWARE_BL31
	select BR2_TARGET_ARM_TRUSTED_FIRMWARE_NEEDS_ARM32_TOOLCHAIN
	help
	  Mainline U-Boot for the Radxa ROCK 4C+.
```

## package/batocera/boot/uboot-rock-5c/Config.in
```kconfig
config BR2_PACKAGE_UBOOT_ROCK_5C
    bool "uboot-rock-5c"
    help
      U-Boot files for the Radxa Rock 5c
```

## package/batocera/boot/uboot-rock4/Config.in
```kconfig
config BR2_PACKAGE_UBOOT_ROCK4
        bool "uboot files for rock4"
        help
          uboot files for rock4
```

## package/batocera/boot/uboot-rock960/Config.in
```kconfig
config BR2_PACKAGE_UBOOT_ROCK960
    bool "uboot files for Rock960"
    help
        uboot files for Rock960
```

## package/batocera/boot/uboot-rockchip/Config.in
```kconfig
config BR2_PACKAGE_UBOOT_ROCKCHIP
	bool "prebuilt uboot rockchip boards"
	help
	  Prebuilt mainline U-Boot for Rockchip boards
```

## package/batocera/boot/uboot-rockpro64/Config.in
```kconfig
config BR2_PACKAGE_UBOOT_ROCKPRO64
        bool "uboot files for rockpro64"
        help
          uboot files for rockpro64
```

## package/batocera/boot/uboot-s905-tvbox/Config.in
```kconfig
config BR2_PACKAGE_UBOOT_S905_TVBOX
        bool "uboot files for s905 tv boxes"
        help
          uboot files for s905 tv boxes
```

## package/batocera/boot/uboot-sm8550/Config.in
```kconfig
config BR2_PACKAGE_UBOOT_SM8550
    bool "uboot files for SM8550"
    help
        uboot files for SM8550
```

## package/batocera/boot/uboot-tinkerboard/Config.in
```kconfig
config BR2_PACKAGE_UBOOT_TINKERBOARD
        bool "uboot files for tinkerboard"
        help
          uboot files for tinkerboard
```

## package/batocera/boot/uboot-vim1s/Config.in
```kconfig
config BR2_PACKAGE_UBOOT_VIM1S
    bool "uboot files for VIM1S"
    help
        uboot files for VIM1S
```
