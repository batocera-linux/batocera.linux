## package/batocera/boot/uboot-vim3/Config.in
```kconfig
config BR2_PACKAGE_UBOOT_VIM3
	bool "uboot-vim3"
	depends on BR2_TARGET_UBOOT
	help
	  U-Boot files for Khadas VIM3
	  based on https://github.com/LibreELEC/LibreELEC.tv/blob/9f00cd296d3988995551a1f765d06f67c02eda88/projects/Amlogic/bootloader/install
```

## package/batocera/boot/uboot-vim4/Config.in
```kconfig
config BR2_PACKAGE_UBOOT_VIM4
    bool "uboot files for VIM4"
    help
        uboot files for VIM4
```

## package/batocera/boot/uboot-visionfive2/Config.in
```kconfig
config BR2_PACKAGE_UBOOT_VISIONFIVE2
    bool "uboot-visionfive2"
    help
        uboot files for VisionFive2
```

## package/batocera/boot/uboot-x96-mate/Config.in
```kconfig
config BR2_PACKAGE_UBOOT_X96_MATE
    bool "uboot files for X96 Mate"
    help
        uboot files for X96 Mate
```

## package/batocera/cases/deskpipro-case/Config.in
```kconfig
config BR2_PACKAGE_DESKPIPRO_CASE
	bool "deskpi-pro-case"
	depends on BR2_PACKAGE_LIRC_TOOLS

	help
	  Enable front USB, fan control & infrared on the DeskPi Pro Case.
      
	  https://deskpi.com/products/deskpi-pro-for-raspberry-pi-4
```

## package/batocera/cases/dockerpi-powerboard/Config.in
```kconfig
config BR2_PACKAGE_DOCKERPI_POWERBOARD
	bool "dockerpi-powerboard"
	help
	  Docker Pi Powerboard module for compatible Raspberry Pi boards.
      
	  https://github.com/geeekpi/dockerpi
```

## package/batocera/cases/element14-pi-desktop/Config.in
```kconfig
config BR2_PACKAGE_ELEMENT14_PI_DESKTOP
	bool "element14-pi-desktop"
	help
	  Enable on / off button for the Element 14 Pi Desktop Case.
      
	  https://github.com/pi-desktop/deb-make
```

## package/batocera/cases/pironman/Config.in
```kconfig
config BR2_PACKAGE_PIRONMAN
	bool "pironman"
	depends on BR2_PACKAGE_PYTHON3
	select BR2_PACKAGE_FREETYPE
	select BR2_PACKAGE_GETENT
	select BR2_PACKAGE_I2C_TOOLS
	select BR2_PACKAGE_LIBPNG
	select BR2_PACKAGE_LIBXCB
	select BR2_PACKAGE_LIRC_TOOLS
	select BR2_PACKAGE_NET_TOOLS
	select BR2_PACKAGE_OPENJPEG
	select BR2_PACKAGE_PYTHON_RPI_GPIO
	select BR2_PACKAGE_PYTHON_RPI_WS281X
	select BR2_PACKAGE_PYTHON_SMBUS_CFFI
	select BR2_PACKAGE_PYTHON_SPIDEV
	select BR2_PACKAGE_TIFF
	select BR2_PACKAGE_ZLIB
	select BR2_PACKAGE_RPI_EEPROM
	help
	  Enable OLED, fan, RGB & infrared for the Pironman case.
      
	  https://github.com/sunfounder/pironman
```

## package/batocera/cases/pironman5/Config.in
```kconfig
config BR2_PACKAGE_PIRONMAN5
	bool "pironman5"
	depends on BR2_PACKAGE_PYTHON3
	select BR2_PACKAGE_PYTHON_INFLUXDB
	select BR2_PACKAGE_LIBJPEG
	select BR2_PACKAGE_FREETYPE
	select BR2_PACKAGE_I2C_TOOLS
	select BR2_PACKAGE_PYTHON_KMOD
	select BR2_PACKAGE_PYTHON_GPIOZERO
	select BR2_PACKAGE_PM_AUTO
	select BR2_PACKAGE_SF_RPI_STATUS
	select BR2_PACKAGE_RPI_EEPROM
	help
	  Enable OLED, fan, RGB & infrared for the Pironman 5 case.
      
	  https://github.com/sunfounder/pironman5
```

## package/batocera/controllers/Config.in
```kconfig
source "package/batocera/controllers/db9_gpio_rpi/Config.in"
source "package/batocera/controllers/gamecon_gpio_rpi/Config.in"
source "package/batocera/controllers/mk_arcade_joystick_rpi/Config.in"
source "package/batocera/controllers/qtsixa/Config.in"
source "package/batocera/controllers/qtsixa-shanwan/Config.in"
source "package/batocera/controllers/virtualgamepads/Config.in"
source "package/batocera/controllers/xarcade2jstick/Config.in"
source "package/batocera/controllers/xboxdrv/Config.in"	
```

## package/batocera/controllers/aimtrak-guns/Config.in
```kconfig
config BR2_PACKAGE_AIMTRAK_GUNS
	bool "aimtrak-guns"
	select BR2_PACKAGE_EVSIEVE

	help
	  aimtrak guns support
```

## package/batocera/controllers/anbernic-gpio-pad/Config.in
```kconfig
config BR2_PACKAGE_ANBERNIC_GPIO_PAD
	bool "anbernic-gpio-pad"
	select BR2_PACKAGE_EVSIEVE
```

## package/batocera/controllers/db9_gpio_rpi/Config.in
```kconfig
config BR2_PACKAGE_DB9_GPIO_RPI
	bool "db9 gpio driver"
	help
	  Kernel module to support db9 joysticks on gpios
```

## package/batocera/controllers/dolphinbar-guns/Config.in
```kconfig
config BR2_PACKAGE_DOLPHINBAR_GUNS
	bool "dolphinbar-guns"

	help
	  dolphinbar guns support
```

## package/batocera/controllers/ds4drv/Config.in
```kconfig
config BR2_PACKAGE_DS4DRV
        bool "ps4 driver"
	select BR2_PACKAGE_PYTHON
	select BR2_PACKAGE_PYTHON_EVDEV
        help
	  https://github.com/chrippa/ds4drv
```

## package/batocera/controllers/fusion-lightguns/Config.in
```kconfig
config BR2_PACKAGE_FUSION_LIGHTGUNS
	bool "fusion-lightguns"
	select BR2_PACKAGE_EVSIEVE

	help
	  fusion lightguns support
```

## package/batocera/controllers/gun4ir-guns/Config.in
```kconfig
config BR2_PACKAGE_GUN4IR_GUNS
	bool "gun4ir-guns"

	help
	  gun4ir guns support
```

## package/batocera/controllers/guncon/Config.in
```kconfig
config BR2_PACKAGE_GUNCON
	bool "guncon"
	select BR2_PACKAGE_BATOCERA_GUN_CALIBRATOR

	help
	  guncon support
```

## package/batocera/controllers/guns/aelightgun/Config.in
```kconfig
config BR2_PACKAGE_AELIGHTGUN
	bool "aelightgun"
	select BR2_PACKAGE_EVSIEVE

	help
	  aelightgun support
```

## package/batocera/controllers/guns/batocera-gun-calibrator/Config.in
```kconfig
config BR2_PACKAGE_BATOCERA_GUN_CALIBRATOR
	bool "batocera-gun-calibrator"
	select BR2_PACKAGE_PYTHON_PYUDEV

	help
	  gun calibration support
```

## package/batocera/controllers/guns/blamcon/Config.in
```kconfig
config BR2_PACKAGE_BLAMCON
	bool "blamcon"
	select BR2_PACKAGE_EVSIEVE

	help
	  blamcon support
```

## package/batocera/controllers/guns/dolphinCrosshairsPack/Config.in
```kconfig
config BR2_PACKAGE_DOLPHINCROSSHAIRSPACK
	bool "dolphinCrosshairsPack"

	help
	  textures to hide crosshair on guns games
```

## package/batocera/controllers/guns/onehit-guns/Config.in
```kconfig
config BR2_PACKAGE_ONEHIT_GUNS
	bool "onehit-guns"
	select BR2_PACKAGE_EVSIEVE

	help
	  onehit guns support
```
