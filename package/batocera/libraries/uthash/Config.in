## package/batocera/libraries/uthash/Config.in
```kconfig
config BR2_PACKAGE_UTHASH
    bool "uthash"
    help
      C macros for hash tables and more.
      
      https://troydhanson.github.io/uthash/
```

## package/batocera/libraries/wildmidi/Config.in
```kconfig
config BR2_PACKAGE_WILDMIDI
    bool "wildmidi"
    help
      WildMIDI is a simple software midi player which has a core softsynth library that can be used in other applications.

      https://github.com/Mindwerks/wildmidi
```

## package/batocera/libraries/wiringop-python/Config.in
```kconfig
config BR2_PACKAGE_WIRINGOP_PYTHON
    bool "wiringop-python"
    select BR2_PACKAGE_LIBXCRYPT
    help
      An implementation of most of the Arduino Wiring functions for the Orange Pi.
      
      https://github.com/orangepi-xunlong/wiringOP-Python
```

## package/batocera/libraries/wxwidgets/Config.in
```kconfig
config BR2_PACKAGE_WXWIDGETS
    bool "wxwidgets"
	select BR2_PACKAGE_GDK_PIXBUF
	select BR2_PACKAGE_GST1_PLUGINS_BASE
	select BR2_PACKAGE_GSTREAMER1
	select BR2_PACKAGE_JPEG
	select BR2_PACKAGE_LIBCURL
	select BR2_PACKAGE_LIBGLU
	select BR2_PACKAGE_LIBGTK3
	select BR2_PACKAGE_LIBPNG
	select BR2_PACKAGE_LIBSECRET
	select BR2_PACKAGE_PCRE2
	select BR2_PACKAGE_SDL2
	select BR2_PACKAGE_WEBP
	select BR2_PACKAGE_XZ
	select BR2_PACKAGE_ZLIB
    help
        A crossplatform gui library
```

## package/batocera/libraries/xlib_libXpresent/Config.in
```kconfig
config BR2_PACKAGE_XLIB_LIBXPRESENT
	bool "libXpresent"
	select BR2_PACKAGE_XLIB_LIBX11
	select BR2_PACKAGE_XLIB_LIBXEXT
	select BR2_PACKAGE_XLIB_LIBXFIXES
	select BR2_PACKAGE_XLIB_LIBXRANDR
	help
	  X11 Present extension library
	  libXpresent provides an X Window System client interface to the
	  Present extension to the X protocol. The Present extension
	  provides a way for applications to update their window contents
	  from a pixmap in a well defined fashion, synchronizing with the
	  display refresh and potentially using a more efficient mechanism
	  than copying the contents of the source pixmap.

	  More information about X.Org can be found at:
	  <URL:http://www.X.org>
```

## package/batocera/libretro-armsnes/Config.in
```kconfig
config BR2_PACKAGE_ARMSNES
        bool "libretro-armsnes"
	depends on BR2_PACKAGE_RETROARCH
	depends on BR2_INSTALL_LIBSTDCPP
        help
          A libretro SNES emulator core for ARM.

	  http://www.libretro.com

comment "ARMSNES needs a toolchain w/ C++"
	depends on !BR2_INSTALL_LIBSTDCPP
```

## package/batocera/libretro-beetle-psx/Config.in
```kconfig
config BR2_PACKAGE_LIBRETRO_BEETLE_PSX
        bool "libretro-psx"
	depends on BR2_PACKAGE_RETROARCH
	depends on BR2_INSTALL_LIBSTDCPP
        help
          A libretro psx emulator core.

	  http://www.libretro.com

comment "LIBRETRO_BEETLE_PSX needs a toolchain w/ C++"
	depends on !BR2_INSTALL_LIBSTDCPP
```

## package/batocera/libretro-beetle-saturn/Config.in
```kconfig
config BR2_PACKAGE_LIBRETRO_BEETLE_SATURN
        bool "libretro-beetle-saturn"
	depends on BR2_PACKAGE_RETROARCH
	depends on BR2_INSTALL_LIBSTDCPP
        help
          A libretro saturn emulator core.

	  http://www.libretro.com

comment "LIBRETRO_BEETLE_SATURN needs a toolchain w/ C++"
	depends on !BR2_INSTALL_LIBSTDCPP
```

## package/batocera/libretro-cap32/Config.in
```kconfig
config BR2_PACKAGE_LIBRETRO_CAP32
        bool "libretro-cap32"
	depends on BR2_PACKAGE_RETROARCH
	depends on BR2_INSTALL_LIBSTDCPP
        help
          A libretro AMSTRAD CPC emulator core.

	  http://www.libretro.com

comment "LIBRETRO_CAP32 needs a toolchain w/ C++"
	depends on !BR2_INSTALL_LIBSTDCPP
```

## package/batocera/libretro-catsfc/Config.in
```kconfig
config BR2_PACKAGE_LIBRETRO_CATSFC
        bool "libretro-catsfc"
	depends on BR2_PACKAGE_RETROARCH
	depends on BR2_INSTALL_LIBSTDCPP
        help
          A libretro SNES emulator core for ARM.

	  http://www.libretro.com

comment "LIBRETRO_CATSFC needs a toolchain w/ C++"
	depends on !BR2_INSTALL_LIBSTDCPP
```

## package/batocera/libretro-desmume/Config.in
```kconfig
config BR2_PACKAGE_LIBRETRO_DESMUME
        bool "libretro-desmume"
	depends on BR2_PACKAGE_RETROARCH
	depends on BR2_INSTALL_LIBSTDCPP
        help
          A libretro nintendo ds emulator core.

	  http://www.libretro.com

comment "LIBRETRO_DESMUME needs a toolchain w/ C++"
	depends on !BR2_INSTALL_LIBSTDCPP
```

## package/batocera/libretro-fba/Config.in
```kconfig
config BR2_PACKAGE_LIBRETRO_FBA
        bool "libretro-fba"
	depends on BR2_PACKAGE_RETROARCH
	depends on BR2_INSTALL_LIBSTDCPP
        help
          A libretro fba emulator core for ARM.

	  http://www.libretro.com

comment "LIBRETRO_FBA needs a toolchain w/ C++"
	depends on !BR2_INSTALL_LIBSTDCPP
```

## package/batocera/libretro-freeintv/Config.in
```kconfig
config BR2_PACKAGE_LIBRETRO_FREEINTV
        bool "libretro-freeintv"
	depends on BR2_PACKAGE_RETROARCH
	depends on BR2_INSTALL_LIBSTDCPP
        help
          A libretro mattel intellivision emulator core.

	  http://www.libretro.com

comment "LIBRETRO_FREEINTV needs a toolchain w/ C++"
	depends on !BR2_INSTALL_LIBSTDCPP
```

## package/batocera/libretro-gambatte/Config.in
```kconfig
config BR2_PACKAGE_LIBRETRO_GAMBATTE
        bool "libretro-gambatte"
	depends on BR2_PACKAGE_RETROARCH
	depends on BR2_INSTALL_LIBSTDCPP
        help
          A libretro GAMEBOY emulator core for ARM.

	  http://www.libretro.com

comment "LIBRETRO_GAMBATTE needs a toolchain w/ C++"
	depends on !BR2_INSTALL_LIBSTDCPP
```

## package/batocera/libretro-mgba/Config.in
```kconfig
config BR2_PACKAGE_LIBRETRO_MGBA
        bool "libretro-mgba"
	depends on BR2_PACKAGE_RETROARCH
	depends on BR2_INSTALL_LIBSTDCPP
        help
          A libretro GBA emulator core for ARM.

	  http://www.libretro.com

comment "LIBRETRO_MGBA needs a toolchain w/ C++"
	depends on !BR2_INSTALL_LIBSTDCPP
```

## package/batocera/libretro-mupen64plus/Config.in
```kconfig
config BR2_PACKAGE_LIBRETRO_MUPEN64PLUS
       bool "libretro-mupen64plus"
       depends on BR2_PACKAGE_RETROARCH
       depends on BR2_INSTALL_LIBSTDCPP
        help
          A alternative libretro N64 emulator core for ARM.

comment "LIBRETRO_MUPEN64PLUS needs a toolchain w/ C++"
       depends on !BR2_INSTALL_LIBSTDCPP
```

## package/batocera/libretro-nestopia/Config.in
```kconfig
config BR2_PACKAGE_LIBRETRO_NESTOPIA
        bool "libretro-nestopia"
	depends on BR2_PACKAGE_RETROARCH
	depends on BR2_INSTALL_LIBSTDCPP
        help
          A libretro NES & FDS emulator core for ARM.

	  http://www.libretro.com

comment "LIBRETRO_NESTOPIA needs a toolchain w/ C++"
	depends on !BR2_INSTALL_LIBSTDCPP
```

## package/batocera/libretro-pcsx/Config.in
```kconfig
config BR2_PACKAGE_LIBRETRO_PCSX
        bool "libretro-pcsx"
	depends on BR2_PACKAGE_RETROARCH
	depends on BR2_INSTALL_LIBSTDCPP
        help
          A libretro psx emulator core for ARM.

	  http://www.libretro.com

comment "LIBRETRO_PCSX needs a toolchain w/ C++"
	depends on !BR2_INSTALL_LIBSTDCPP
```

## package/batocera/libretro-prboom/Config.in
```kconfig
config BR2_PACKAGE_LIBRETRO_PRBOOM
        bool "libretro-prboom"
	depends on BR2_PACKAGE_RETROARCH
	depends on BR2_INSTALL_LIBSTDCPP
        help
          A libretro PrBoom core for ARM.

	  http://www.libretro.com

comment "LIBRETRO_PRBOOM needs a toolchain w/ C++"
	depends on !BR2_INSTALL_LIBSTDCPP
```

## package/batocera/libretro-px68k/Config.in
```kconfig
config BR2_PACKAGE_LIBRETRO_PX68K
        bool "libretro-px68k"
	depends on BR2_PACKAGE_RETROARCH
	depends on BR2_INSTALL_LIBSTDCPP
        help
          A libretro SHARP X68000 emulator core.

	  http://www.libretro.com

comment "LIBRETRO_PX68K needs a toolchain w/ C++"
	depends on !BR2_INSTALL_LIBSTDCPP
```

## package/batocera/libretro-snes9x-next/Config.in
```kconfig
config BR2_PACKAGE_LIBRETRO_SNES9X_NEXT
        bool "libretro-snes9x-next"
	depends on BR2_PACKAGE_RETROARCH
	depends on BR2_INSTALL_LIBSTDCPP
        help
          A libretro SNES emulator core for ARM.

	  http://www.libretro.com

comment "LIBRETRO_SNES9X_NEXT needs a toolchain w/ C++"
	depends on !BR2_INSTALL_LIBSTDCPP
```

## package/batocera/libretro-stella/Config.in
```kconfig
config BR2_PACKAGE_LIBRETRO_STELLA
        bool "libretro-stella"
	depends on BR2_PACKAGE_RETROARCH
	depends on BR2_INSTALL_LIBSTDCPP
        help
          A libretro Atari 2600 emulator core for ARM.

	  http://www.libretro.com

comment "LIBRETRO_STELLA needs a toolchain w/ C++"
	depends on !BR2_INSTALL_LIBSTDCPP
```

## package/batocera/libretro-theodore/Config.in
```kconfig
config BR2_PACKAGE_LIBRETRO_THEODORE
    bool "libretro-theodore"
	depends on BR2_PACKAGE_RETROARCH
	depends on BR2_INSTALL_LIBSTDCPP
	select BR2_PACKAGE_RECALBOX_ROMFS_THOMSON
    help
    A libretro Thomson TO8 emulator core.

	  https://github.com/Zlika/theodore

comment "LIBRETRO_THEODORE needs a toolchain w/ C++"
	depends on !BR2_INSTALL_LIBSTDCPP
```

## package/batocera/libretro/Config.in
```kconfig
source "package/batocera/libretro/libretro-atari800/Config.in"
source "package/batocera/libretro/libretro-pocketsnes/Config.in"
source "package/batocera/libretro/libretro-catsfc/Config.in"
source "package/batocera/libretro/libretro-beetle-vb/Config.in"
source "package/batocera/libretro/libretro-snes9x/Config.in"
source "package/batocera/libretro/libretro-snes9x-next/Config.in"
source "package/batocera/libretro/libretro-desmume/Config.in"
source "package/batocera/libretro/libretro-picodrive/Config.in"
source "package/batocera/libretro/libretro-genesisplusgx/Config.in"
source "package/batocera/libretro/libretro-gambatte/Config.in"
source "package/batocera/libretro/libretro-stella/Config.in"
source "package/batocera/libretro/libretro-pcsx/Config.in"
source "package/batocera/libretro/libretro-beetle-psx/Config.in"
source "package/batocera/libretro/libretro-beetle-saturn/Config.in"
source "package/batocera/libretro/libretro-fceumm/Config.in"
source "package/batocera/libretro/libretro-fceunext/Config.in"
source "package/batocera/libretro/libretro-nestopia/Config.in"
source "package/batocera/libretro/libretro-imame/Config.in"
source "package/batocera/libretro/libretro-scummvm/Config.in"
source "package/batocera/libretro/libretro-beetle-pce/Config.in"
source "package/batocera/libretro/libretro-beetle-pcfx/Config.in"
source "package/batocera/libretro/libretro-meteor/Config.in"
source "package/batocera/libretro/libretro-virtualjaguar/Config.in"
source "package/batocera/libretro/libretro-fmsx/Config.in"
source "package/batocera/libretro/libretro-bluemsx/Config.in"
source "package/batocera/libretro/libretro-gpsp/Config.in"
source "package/batocera/libretro/libretro-4do/Config.in"
source "package/batocera/libretro/libretro-fba/Config.in"
source "package/batocera/libretro/libretro-gw/Config.in"
source "package/batocera/libretro/libretro-prboom/Config.in"
source "package/batocera/libretro/libretro-beetle-ngp/Config.in"
source "package/batocera/libretro/libretro-vecx/Config.in"
source "package/batocera/libretro/libretro-beetle-lynx/Config.in"
source "package/batocera/libretro/libretro-lutro/Config.in"
source "package/batocera/libretro/libretro-beetle-wswan/Config.in"
source "package/batocera/libretro/libretro-uae/Config.in"
source "package/batocera/libretro/libretro-parallel-n64/Config.in"
source "package/batocera/libretro/libretro-beetle-supergrafx/Config.in"
source "package/batocera/libretro/libretro-nxengine/Config.in"
source "package/batocera/libretro/libretro-prosystem/Config.in"
source "package/batocera/libretro/libretro-tgbdual/Config.in"
source "package/batocera/libretro/libretro-mgba/Config.in"
source "package/batocera/libretro/libretro-mame2003/Config.in"
source "package/batocera/libretro/libretro-mame2003-plus/Config.in"
source "package/batocera/libretro/libretro-mame2010/Config.in"
source "package/batocera/libretro/libretro-fuse/Config.in"
source "package/batocera/libretro/libretro-cap32/Config.in"
source "package/batocera/libretro/libretro-81/Config.in"
source "package/batocera/libretro/libretro-imageviewer/Config.in"
source "package/batocera/libretro/libretro-o2em/Config.in"
source "package/batocera/libretro/libretro-hatari/Config.in"
source "package/batocera/libretro/libretro-quicknes/Config.in"
source "package/batocera/libretro/libretro-yabause/Config.in"
source "package/batocera/libretro/libretro-freeintv/Config.in"
source "package/batocera/libretro/libretro-cheats/Config.in"
source "package/batocera/libretro/libretro-mupen64plus/Config.in"
source "package/batocera/libretro/libretro-reicast/Config.in"
source "package/batocera/libretro/libretro-px68k/Config.in"
```

## package/batocera/libretro/libretro-beetle-supergrafx/Config.in
```kconfig
config BR2_PACKAGE_LIBRETRO_BEETLE_SUPERGRAFX
        bool "libretro-beetle-supergrafx"
	depends on BR2_PACKAGE_RETROARCH
	depends on BR2_INSTALL_LIBSTDCPP
        help
          A libretro Supergrafx emulator core for ARM.

	  http://www.libretro.com

comment "LIBRETRO_BEETLE_SUPERGRAFX needs a toolchain w/ C++"
	depends on !BR2_INSTALL_LIBSTDCPP
```
