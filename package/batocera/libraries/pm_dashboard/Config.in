## package/batocera/libraries/pm_dashboard/Config.in
```kconfig
config BR2_PACKAGE_PM_DASHBOARD
    bool "pm_dashboard"
    select BR2_PACKAGE_PYTHON_INFLUXDB
    select BR2_PACKAGE_PYTHON_FLASK
    select BR2_PACKAGE_PYTHON_FLASK_CORS
    select BR2_PACKAGE_INFLUXDB
    help
      Pironman Dashboard.
      
      https://github.com/sunfounder/pm_dashboard
```

## package/batocera/libraries/projectm/Config.in
```kconfig
config BR2_PACKAGE_PROJECTM
	bool "projectm"
	depends on BR2_TOOLCHAIN_HAS_THREADS
	select BR2_PACKAGE_FREETYPE
	help
	  projectM - A MilkDrop compatible opensource music visualizer.

	  https://github.com/projectM-visualizer/projectm	  
```

## package/batocera/libraries/pyqt-builder/Config.in
```kconfig
config BR2_PACKAGE_PYQT_BUILDER
	bool "pyqt-builder"
	help
	  PyQt-builder is the PEP 517 compliant build system for PyQt and projects that extend PyQt.
	  It extends the SIP build system and uses Qt's qmake to perform the actual compilation
	  and installation of extension modules.

	  https://pypi.org/project/PyQt-builder/
```

## package/batocera/libraries/pysdl2/Config.in
```kconfig
config BR2_PACKAGE_PYSDL2
	bool "pysdl2"
	select BR2_PACKAGE_SDL2
	help
	  PySDL2 is a pure Python wrapper around the SDL2,
	  SDL2_mixer, SDL2_image, SDL2_ttf, and SDL2_gfx libraries.

	  http://pysdl2.readthedocs.org/
```

## package/batocera/libraries/pysdl3/Config.in
```kconfig
config BR2_PACKAGE_PYSDL3
	bool "pysdl3"
	select BR2_PACKAGE_SDL3
	help
	  A pure Python wrapper for SDL3.

	  https://pysdl3.readthedocs.io/
```

## package/batocera/libraries/python-adafruit-blinka/Config.in
```kconfig
config BR2_PACKAGE_PYTHON_ADAFRUIT_BLINKA
	bool "python-adafruit-blinka"
	select BR2_PACKAGE_PYTHON_ADAFRUIT_PLATFORMDETECT
	select BR2_PACKAGE_PYTHON_ADAFRUIT_PUREIO
	select BR2_PACKAGE_PYTHON_PYFTDI
	select BR2_PACKAGE_PYTHON_RPI_WS281X
	select BR2_PACKAGE_PYTHON_RPI_GPIO
	select BR2_PACKAGE_PYTHON_SYSV_IPC
	select BR2_PACKAGE_PYTHON_BINHO_HOST_ADAPTER
    select BR2_PACKAGE_PYTHON_NUMPY
	help
	  CircuitPython APIs for non-CircuitPython versions of Python such as
	  CPython on Linux and MicroPython.

	  https://pypi.org/project/Adafruit-Blinka
```

## package/batocera/libraries/python-adafruit-circuitpython-busdevice/Config.in
```kconfig
config BR2_PACKAGE_PYTHON_ADAFRUIT_CIRCUITPYTHON_BUSDEVICE
	bool "python-adafruit-circuitpython-busdevice"
	select BR2_PACKAGE_PYTHON_ADAFRUIT_BLINKA
	select BR2_PACKAGE_PYTHON_ADAFRUIT_CIRCUITPYTHON_TYPING
	help
	  CircuitPython bus device classes to manage bus sharing.

	  https://pypi.org/project/adafruit-circuitpython-busdevice
```

## package/batocera/libraries/python-adafruit-circuitpython-connectionmanager/Config.in
```kconfig
config BR2_PACKAGE_PYTHON_ADAFRUIT_CIRCUITPYTHON_CONNECTIONMANAGER
	bool "python-adafruit-circuitpython-connectionmanager"
	help
	  A urllib3.poolmanager/urllib3.connectionpool-like library for managing sockets and connections.

	  https://pypi.org/project/adafruit-circuitpython-connectionmanager
```

## package/batocera/libraries/python-adafruit-circuitpython-neopixel-spi/Config.in
```kconfig
config BR2_PACKAGE_PYTHON_ADAFRUIT_CIRCUITPYTHON_NEOPIXEL_SPI
	bool "python-adafruit-circuitpython-neopixel-spi"
	select BR2_PACKAGE_PYTHON_ADAFRUIT_CIRCUITPYTHON_BUSDEVICE
	select BR2_PACKAGE_PYTHON_ADAFRUIT_CIRCUITPYTHON_PIXELBUF
	help
	  SPI driven CircuitPython driver for neopixels.

	  https://pypi.org/project/adafruit-circuitpython-neopixel-spi
```

## package/batocera/libraries/python-adafruit-circuitpython-pixelbuf/Config.in
```kconfig
config BR2_PACKAGE_PYTHON_ADAFRUIT_CIRCUITPYTHON_PIXELBUF
	bool "python-adafruit-circuitpython-pixelbuf"
	select BR2_PACKAGE_PYTHON_ADAFRUIT_CIRCUITPYTHON
	help
	  A pure Python implementation of adafruit_pixelbuf for smaller boards.

	  https://pypi.org/project/adafruit-circuitpython-pixelbuf
```

## package/batocera/libraries/python-adafruit-circuitpython-requests/Config.in
```kconfig
config BR2_PACKAGE_PYTHON_ADAFRUIT_CIRCUITPYTHON_REQUESTS
	bool "python-adafruit-circuitpython-requests"
	select BR2_PACKAGE_PYTHON_ADAFRUIT_CIRCUITPYTHON_CONNECTIONMANAGER
	help
	  A requests-like library for HTTP commands.

	  https://pypi.org/project/adafruit-circuitpython-requests
```

## package/batocera/libraries/python-adafruit-circuitpython-typing/Config.in
```kconfig
config BR2_PACKAGE_PYTHON_ADAFRUIT_CIRCUITPYTHON_TYPING
	bool "python-adafruit-circuitpython-typing"
	help
	  Types needed for type annotation that are not in `typing`

	  https://pypi.org/project/adafruit-circuitpython-typing
```

## package/batocera/libraries/python-adafruit-circuitpython-ws2801/Config.in
```kconfig
config BR2_PACKAGE_PYTHON_ADAFRUIT_CIRCUITPYTHON_WS2801
	bool "python-adafruit-circuitpython-ws2801"
	select BR2_PACKAGE_PYTHON_ADAFRUIT_BLINKA
	select BR2_PACKAGE_PYTHON_ADAFRUIT_CIRCUITPYTHON_BUSDEVICE
	help
	  CircuitPython library for WS2801 LEDs.

	  https://pypi.org/project/adafruit-circuitpython-ws2801
```

## package/batocera/libraries/python-adafruit-platformdetect/Config.in
```kconfig
config BR2_PACKAGE_PYTHON_ADAFRUIT_PLATFORMDETECT
	bool "python-adafruit-platformdetect"
	help
	  Platform detection for use by libraries like Adafruit-Blinka.

	  https://pypi.org/project/Adafruit-PlatformDetect
```

## package/batocera/libraries/python-adafruit-pureio/Config.in
```kconfig
config BR2_PACKAGE_PYTHON_ADAFRUIT_PUREIO
	bool "python-adafruit-pureio"
	help
	  Pure python (i.e. no native extensions) access to Linux IO including
	  I2C and SPI. Drop in replacement for smbus and spidev modules.

	  https://pypi.org/project/Adafruit-PureIO
```

## package/batocera/libraries/python-batocera-common/Config.in
```kconfig
config BR2_PACKAGE_PYTHON_BATOCERA_COMMON
	bool "batocera python common"
	select BR2_PACKAGE_PYTHON3
	select BR2_PACKAGE_PYTHON_PYYAML
	select BR2_PACKAGE_PYTHON_RUAMEL_YAML
	select BR2_PACKAGE_PYTHON_TYPING_EXTENSIONS
	help
	  Common python functionality for Batocera
```

## package/batocera/libraries/python-binho-host-adapter/Config.in
```kconfig
config BR2_PACKAGE_PYTHON_BINHO_HOST_ADAPTER
	bool "python-binho-host-adapter"
	select BR2_PACKAGE_PYTHON_SERIAL
	help
	  Cross-platform Python 3.x library for automated control of
	  Binho Multi-Protocol USB Host Adapters.

	  https://pypi.org/project/binho-host-adapter
```

## package/batocera/libraries/python-cog/Config.in
```kconfig
config BR2_PACKAGE_PYTHON_COG
	bool "python-cog"
	help
	  Small bits of Python computation for static files.

	  https://github.com/nedbat/cog
```

## package/batocera/libraries/python-evdev/Config.in
```kconfig
config BR2_PACKAGE_PYTHON_EVDEV
        bool "python-evdev"
	select BR2_PACKAGE_PYTHON3
	select BR2_PACKAGE_PYTHON_PYUDEV
        help
	  https://github.com/gvalkov/python-evdev
```

## package/batocera/libraries/python-hidapi/Config.in
```kconfig
config BR2_PACKAGE_PYTHON_HIDAPI
	bool "python-hidapi"
	depends on BR2_PACKAGE_HAS_UDEV
	select BR2_PACKAGE_PYTHON3
	select BR2_PACKAGE_LIBUSB
	select BR2_PACKAGE_HIDAPI
	select BR2_PACKAGE_HOST_PYTHON_CYTHON
	help
	 https://pypi.org/project/hidapi
```

## package/batocera/libraries/python-lgpio/Config.in
```kconfig
config BR2_PACKAGE_PYTHON_LGPIO
	bool "python-lgpio"
	select BR2_PACKAGE_LIBLGPIO
	help
	  lgpio is a module for Linux Single Board Computers (SBC)
	  which allows control of the General Purpose Input Outputs (GPIO).

	  https://pypi.org/project/lgpio
```

## package/batocera/libraries/python-pyftdi/Config.in
```kconfig
config BR2_PACKAGE_PYTHON_PYFTDI
	bool "python-pyftdi"
	select BR2_PACKAGE_PYTHON_SERIAL
	select BR2_PACKAGE_PYTHON_PYUSB
	help
	  FTDI device driver (pure Python)

	  https://pypi.org/project/pyftdi
```
