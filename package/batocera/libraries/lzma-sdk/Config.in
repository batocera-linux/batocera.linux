## package/batocera/libraries/lzma-sdk/Config.in
```kconfig
config BR2_PACKAGE_LZMA_SDK
	bool "lzma-sdk"
	help
	  Igor Pavlov's LZMA SDK (7-Zip): the C sources for reading and
	  decoding .7z archives. Packaged here as a static library plus a
	  find_package(lzmasdk) config exporting the lzmasdk::lzmasdk target.

	  https://www.7-zip.org/sdk.html
```

## package/batocera/libraries/openxr-sdk/Config.in
```kconfig
config BR2_PACKAGE_OPENXR_SDK
    bool "openxr-sdk"
    select BR2_PACKAGE_XLIB_LIBX11
    help
      Khronos OpenXR loader.

      https://github.com/KhronosGroup/OpenXR-SDK-Source
```

## package/batocera/libraries/python-lazy-loader/Config.in
```kconfig
config BR2_PACKAGE_PYTHON_LAZY_LOADER
	bool "python-lazy-loader"
	select BR2_PACKAGE_PYTHON_PACKAGING
	help
	  A small library that allows you to lazily load Python modules and packages.

	  https://github.com/scientific-python/lazy-loader
```

## package/batocera/looks/odin-bezels/Config.in
```kconfig
config BR2_PACKAGE_ODIN_BEZELS
	bool "odin-bezels"
	depends on BR2_PACKAGE_ODIN
	help
	  The bezels of Odin's Sega Hikaru and Gaelco games, which Odin
	  lays around them itself.

	  https://github.com/Tovarichtch/Odin
```

## package/batocera/network/aic8800/Config.in
```kconfig
comment "aic8800 needs a Linux kernel to be built"
	depends on !BR2_LINUX_KERNEL

config BR2_PACKAGE_AIC8800
	bool "aic8800"
	depends on BR2_LINUX_KERNEL
	help
	  Linux Driver for the aicsemi aic8800 WiFi / BT Adapter.

	  https://github.com/radxa-pkg/aic8800

config BR2_PACKAGE_AIC8800_SDIO
	bool "aic8800sdio"
	depends on BR2_LINUX_KERNEL
	select BR2_PACKAGE_AIC8800
	help
	  Linux Driver for the aicsemi aic8800 WiFi / BT Adapter, SDIO driver.

config BR2_PACKAGE_AIC8800_USB
	bool "aic8800usb"
	depends on BR2_LINUX_KERNEL
	select BR2_PACKAGE_AIC8800
	help
	  Linux Driver for the aicsemi aic8800 WiFi / BT Adapter, USB driver.
```

## package/batocera/network/broadcom-wl/Config.in
```kconfig
config BR2_PACKAGE_BROADCOM_WL
	bool "broadcom-wl"
	depends on BR2_LINUX_KERNEL
	depends on BR2_x86_64
	help
	  Broadcom STA (wl) wifi driver for older Macs.

	  https://docs.broadcom.com/docs-and-downloads/docs/linux_sta

comment "broadcom-wl needs a Linux kernel to be built"
	depends on BR2_x86_64
	depends on !BR2_LINUX_KERNEL
```

## package/batocera/network/seekwave-swt6621s/Config.in
```kconfig
config BR2_PACKAGE_SEEKWAVE_SWT6621S
	bool "seekwave-swt6621s"
	depends on BR2_LINUX_KERNEL
	depends on BR2_aarch64
	help
	  SeekWave SWT6621S SDIO WiFi/BT driver for KICKPI K3B.

	  https://github.com/retro98boy/seekwave-swt6621s
```

## package/batocera/ports/fallout2-ce/Config.in
```kconfig
config BR2_PACKAGE_FALLOUT2_CE
	bool "fallout2-ce"
	select BR2_PACKAGE_SDL2
	select BR2_PACKAGE_BATOCERA_LAUNCH_FALLOUT
	help
	  Fallout 2 CE - Open Source Fallout 2 engine

	  https://github.com/alexbatalov/fallout2-ce
```

## package/batocera/ports/opengoal/Config.in
```kconfig
config BR2_PACKAGE_OPENGOAL
	bool "opengoal"
	depends on BR2_INSTALL_LIBSTDCPP
	depends on BR2_PACKAGE_HAS_LIBGL
	select BR2_PACKAGE_ALSA_LIB
	select BR2_PACKAGE_LIBCURL
	select BR2_PACKAGE_OPENSSL
	select BR2_PACKAGE_PULSEAUDIO
	select BR2_PACKAGE_SDL3
	select BR2_PACKAGE_SQLITE
	select BR2_PACKAGE_ZLIB
	help
	  OpenGOAL - native PC ports of Jak and Daxter, Jak II and Jak 3,
	  decompiled from the PlayStation 2 originals.

	  Ships the runtime, the GOAL compiler and the ISO extractor. You
	  supply your own disc image; the first launch extracts and builds
	  the game from it.

	  https://opengoal.dev

comment "opengoal needs a toolchain w/ C++ and OpenGL"
	depends on !BR2_INSTALL_LIBSTDCPP || !BR2_PACKAGE_HAS_LIBGL
```

## package/batocera/ports/openjazz/Config.in
```kconfig
config BR2_PACKAGE_OPENJAZZ
	bool "openjazz"
	depends on BR2_INSTALL_LIBSTDCPP
	select BR2_PACKAGE_SDL2
	select BR2_PACKAGE_BATOCERA_LAUNCH_OPENJAZZ
	help
	  OpenJazz is a free, open-source version
	  of the classic Jazz Jackrabbit games.

	  https://github.com/AlisterT/openjazz
```

## package/batocera/ports/openmohaa/Config.in
```kconfig
config BR2_PACKAGE_OPENMOHAA
    bool "openmohaa"
    select BR2_PACKAGE_LIBCURL
    select BR2_PACKAGE_OPENAL
    select BR2_PACKAGE_SDL2
    select BR2_PACKAGE_BATOCERA_LAUNCH_OPENMOHAA
    help
      Open re-implementation of Medal of Honor: Allied Assault
      including Spearhead and Breakthrough expansions with modern features.
      
      https://github.com/openmoh/openmohaa
```

## package/batocera/ports/uzdoom/Config.in
```kconfig
config BR2_PACKAGE_UZDOOM
    bool "uzdoom"
    select BR2_PACKAGE_HOST_UZDOOM
    select BR2_PACKAGE_SDL2
    select BR2_PACKAGE_SDL2_NET
    select BR2_PACKAGE_SDL2_MIXER
    select BR2_PACKAGE_LIBGL
    select BR2_PACKAGE_OPENAL
    select BR2_PACKAGE_ZMUSIC
    select BR2_PACKAGE_LIBVPX
    select BR2_PACKAGE_WEBP
    select BR2_PACKAGE_WEBP_DEMUX
    select BR2_PACKAGE_WEBP_MUX
    help
      UZDoom is a continuation of ZDoom and GZDoom, a 3D-accelerated
      Doom source port.

	    https://github.com/UZDoom/UZDoom
```

## package/batocera/ports/uzdoom/Config.in.host
```kconfig
config BR2_PACKAGE_HOST_UZDOOM
	bool "host uzdoom tools"
	select BR2_PACKAGE_HOST_ZLIB
	select BR2_PACKAGE_HOST_BZIP2
	help
	  This package is required for building uzdoom.
```

## package/batocera/screens/batocera-backglass/Config.in
```kconfig
config BR2_PACKAGE_BATOCERA_BACKGLASS
	bool "batocera-backglass"
	select BR2_PACKAGE_SDL2
	select BR2_PACKAGE_SDL2_IMAGE
	select BR2_PACKAGE_SDL2_TTF
	select BR2_PACKAGE_LIBCURL
	select BR2_PACKAGE_OPENSSL
	select BR2_PACKAGE_DEJAVU
	select BR2_PACKAGE_NOTO_CJK_FONTS
	help
	  Helper tool to present Backglass media.
```

## package/batocera/utils/amvdec-tee/Config.in
```kconfig
config BR2_PACKAGE_AMVDEC_TEE
	bool "amvdec-tee"
	depends on BR2_TOOLCHAIN_HAS_THREADS # optee-client
	depends on BR2_USE_MMU # optee-client
	select BR2_PACKAGE_OPTEE_CLIENT
	select BR2_PACKAGE_MESON_FIRMWARE
	help
	  Loads the signed Amlogic video decoder microcode through
	  OP-TEE once per boot, needed by the S4 and later decoders.

	  https://github.com/LibreELEC/amvdec-tee
```

## package/batocera/utils/gamescope/Config.in
```kconfig
config BR2_PACKAGE_GAMESCOPE
    bool "gamescope"
    select BR2_PACKAGE_HWDATA
    select BR2_PACKAGE_LIBDISPLAY_INFO
    select BR2_PACKAGE_LIBINPUT
    select BR2_PACKAGE_LIBXCB
    select BR2_PACKAGE_LIBXKBCOMMON
    select BR2_PACKAGE_PIXMAN
    select BR2_PACKAGE_VULKAN_HEADERS
    select BR2_PACKAGE_VULKAN_LOADER
    select BR2_PACKAGE_WAYLAND
    select BR2_PACKAGE_WAYLAND_PROTOCOLS
    select BR2_PACKAGE_XCB_UTIL_WM
    select BR2_PACKAGE_XLIB_LIBX11
    select BR2_PACKAGE_XLIB_LIBXCOMPOSITE
    select BR2_PACKAGE_XLIB_LIBXCURSOR
    select BR2_PACKAGE_XLIB_LIBXDAMAGE
    select BR2_PACKAGE_XLIB_LIBXEXT
    select BR2_PACKAGE_XLIB_LIBXFIXES
    select BR2_PACKAGE_XLIB_LIBXI
    select BR2_PACKAGE_XLIB_LIBXMU
    select BR2_PACKAGE_XLIB_LIBXRENDER
    select BR2_PACKAGE_XLIB_LIBXRES
    select BR2_PACKAGE_XLIB_LIBXTST
    select BR2_PACKAGE_XLIB_LIBXXF86VM
    select BR2_PACKAGE_XWAYLAND

    help
      SteamOS session compositing window manager

      https://github.com/Plagman/gamescope
```

## package/batocera/utils/hotkeygen/Config.in
```kconfig
config BR2_PACKAGE_HOTKEYGEN
	bool "hotkeygen"
	select BR2_PACKAGE_PYTHON3
	select BR2_PACKAGE_PYTHON_BATOCERA_COMMON
	select BR2_PACKAGE_PYTHON_PYUDEV
	select BR2_PACKAGE_PYTHON_EVDEV
	select BR2_PACKAGE_PYTHON_UVLOOP
	select BR2_PACKAGE_PYTHON_DBUS_FAST
	help
	  hotkeygen is a background utility that listens for specific
	  input events (KEY_ or BTN_) from connected controllers, keyboards,
	  or arcade encoders and maps them to global hotkey actions.
```

## package/batocera/utils/rpigpioswitch/Config.in
```kconfig
config BR2_PACKAGE_RPIGPIOSWITCH
     bool "rpigpioswitch"
     select BR2_PACKAGE_LIBGPIOD2 if BR2_TOOLCHAIN_HEADERS_AT_LEAST_5_10
     select BR2_PACKAGE_LIBGPIOD2_TOOLS if BR2_TOOLCHAIN_HEADERS_AT_LEAST_5_10

comment "RPi powerdevices and GPIO inputs"
```

## package/batocera/wine/d7vk/Config.in
```kconfig
config BR2_PACKAGE_D7VK
	bool "d7vk"
    depends on BR2_i386 || BR2_x86_64
	# Wine unconditionally builds shared libraries
	depends on !BR2_STATIC_LIBS
	depends on BR2_PACKAGE_SPIRV_HEADERS
	help
      D7VK is a Vulkan-based translation layer for DirectDraw and
      Direct3D up to 7, a DXVK fork, for runners not shipping it.

	  https://github.com/WinterSnowfall/d7vk

comment "d7vk needs a toolchain w/ dynamic library"
	depends on BR2_STATIC_LIBS
```

## python-src/batocera-bezel-overlay/Config.in
```kconfig
config BR2_PACKAGE_BATOCERA_BEZEL_OVERLAY
	bool "batocera bezel overlay"
	select BR2_PACKAGE_PYTHON3
	select BR2_PACKAGE_PYTHON_PYCAIRO
	select BR2_PACKAGE_PYTHON_GOBJECT
	select BR2_PACKAGE_LIBGTK3
	select BR2_PACKAGE_GTK_LAYER_SHELL if BR2_PACKAGE_WAYLAND
	help
	  A utility to display bezels while emulators are running
```

## python-src/batocera-discord/Config.in
```kconfig
config BR2_PACKAGE_BATOCERA_DISCORD
	bool "batocera discord"
	depends on BR2_PACKAGE_FLATPAK
	depends on BR2_PACKAGE_XORG7
	select BR2_PACKAGE_PYTHON3
	select BR2_PACKAGE_PYTHON_PYGAME2
	select BR2_PACKAGE_PYTHON_EVDEV
	select BR2_PACKAGE_PYTHON_QRCODE
	select BR2_PACKAGE_XDOTOOL
	help
	  Controller driven Discord voice panel, available as the
	  "discord" service: join voice channels, call friends, mute
	  and set per-user volume from the couch. Uses the Discord
	  flatpak and its local RPC; set up from a phone by scanning
	  a QR code shown on the TV.
```

## python-src/batocera-labwc/Config.in
```kconfig
config BR2_PACKAGE_BATOCERA_LABWC
	bool
	select BR2_PACKAGE_PYTHON3
	select BR2_PACKAGE_PYTHON_BATOCERA_COMMON
	help
	  Helpers to configure labwc
```

## python-src/batocera-launch-cgenius/Config.in
```kconfig
config BR2_PACKAGE_BATOCERA_LAUNCH_CGENIUS
	bool
	depends on BR2_PACKAGE_PYTHON_BATOCERA_COMMON
	depends on BR2_PACKAGE_BATOCERA_LAUNCH
	depends on BR2_PACKAGE_PYTHON3_CONFIGOBJ
```

## python-src/batocera-launch-flycast/Config.in
```kconfig
config BR2_PACKAGE_BATOCERA_LAUNCH_FLYCAST
	bool
	depends on BR2_PACKAGE_PYTHON_BATOCERA_COMMON
	depends on BR2_PACKAGE_BATOCERA_LAUNCH
```

## python-src/batocera-launch-kodi/Config.in
```kconfig
config BR2_PACKAGE_BATOCERA_LAUNCH_KODI
	bool
	depends on BR2_PACKAGE_PYTHON_BATOCERA_COMMON
	depends on BR2_PACKAGE_BATOCERA_LAUNCH

# Boards whose ffmpeg decoders can output DRM PRIME frames
config BR2_PACKAGE_BATOCERA_LAUNCH_KODI_DRMPRIME
	bool
	default y if BR2_PACKAGE_BATOCERA_TARGET_SDM845 || \
	             BR2_PACKAGE_BATOCERA_TARGET_SM6115 || \
	             BR2_PACKAGE_BATOCERA_TARGET_QCS6490 || \
	             BR2_PACKAGE_BATOCERA_TARGET_SM8250 || \
	             BR2_PACKAGE_BATOCERA_TARGET_SM8550 || \
	             BR2_PACKAGE_BATOCERA_TARGET_SM8650 || \
	             BR2_PACKAGE_BATOCERA_TARGET_SM8750
	depends on BR2_PACKAGE_BATOCERA_LAUNCH_KODI
```
