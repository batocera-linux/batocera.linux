## package/batocera/libraries/libframeutil/Config.in
```kconfig
config BR2_PACKAGE_LIBFRAMEUTIL
    bool "libframeutil"
    help
      ZeDMD frame util library.
      
      https://github.com/PPUC/libframeutil
```

## package/batocera/libraries/libglvnd/Config.in
```kconfig
config BR2_PACKAGE_LIBGLVND
  bool "libglvnd"
  # Batocera - removed the reliance on X86 (RPi4)
  depends on BR2_PACKAGE_XSERVER_XORG_SERVER_MODULAR
  depends on BR2_PACKAGE_MESA3D
  help
    libglvnd is a vendor-neutral dispatch layer for arbitrating
    OpenGL API call between multiple vendors.

    https://github.com/NVIDIA/libglvnd
```

## package/batocera/libraries/libgraphene/Config.in
```kconfig
config BR2_PACKAGE_LIBGRAPHENE
	bool "libgraphene"
	help
	  A thin layer of graphic data types.

	  https://github.com/ebassi/graphene
```

## package/batocera/libraries/libheif/Config.in
```kconfig
config BR2_PACKAGE_LIBHEIF
	bool "libheif"
	select BR2_PACKAGE_LIBDE265
	help
	  libheif - HEIF image library

	  https://github.com/strukturag/libheif
```

## package/batocera/libraries/libjanet/Config.in
```kconfig
config BR2_PACKAGE_LIBJANET
	bool "libjanet"

	    help
            Janet is a programming language for system scripting,
            expressive automation, and extending programs written
            in C or C++ with user scripting capabilities.

            https://github.com/janet-lang/janet
```

## package/batocera/libraries/libjpeg-bato/Config.in
```kconfig
config BR2_PACKAGE_LIBJPEG_BATO
    bool "libjpeg-bato"
    help
      out-of-tree libjpeg so that we can compile ScummVM with both jpeg-turbo and libjpeg
```

## package/batocera/libraries/liblgpio/Config.in
```kconfig
config BR2_PACKAGE_LIBLGPIO
	bool "liblgpio"
	help
	  Control GPIO pins via the kernel's gpiochip device interface.
```

## package/batocera/libraries/libliftoff/Config.in
```kconfig
config BR2_PACKAGE_LIBLIFTOFF
    bool "libliftoff"
    select BR2_PACKAGE_LIBDRM
    help
        libliftoff eases the use of KMS planes from userspace without standing in your
        way. Users create "virtual planes" called layers, set KMS properties on them,
        and libliftoff will pick hardware planes for these layers if possible.

	    https://gitlab.freedesktop.org/emersion/libliftoff
```

## package/batocera/libraries/libopenmpt/Config.in
```kconfig
config BR2_PACKAGE_LIBOPENMPT
	bool "libopenmpt"
	select BR2_PACKAGE_HOST_DOXYGEN
	select BR2_PACKAGE_ZLIB
	select BR2_PACKAGE_MPG123
	select BR2_PACKAGE_LIBOGG
	select BR2_PACKAGE_LIBVORBIS
	select BR2_PACKAGE_PULSEAUDIO
	help 
	  OpenMPT and libopenmpt
	  OpenMPT, a free Windows/Wine-based tracker and libopenmpt, a library to render tracker music.

	  https://github.com/OpenMPT/openmpt
```

## package/batocera/libraries/libpinmame/Config.in
```kconfig
config BR2_PACKAGE_LIBPINMAME
    bool "libpinmame"
    select BR2_PACKAGE_ZLIB
    help
      PinMAME - Pinball Multiple Arcade Machine Emulator.
      
      https://github.com/vpinball/pinmame
      www.vpforums.org
```

## package/batocera/libraries/libplacebo/Config.in
```kconfig
config BR2_PACKAGE_LIBPLACEBO
	bool "libplacebo"
	depends on BR2_TOOLCHAIN_HAS_THREADS_NPTL
	depends on BR2_INSTALL_LIBSTDCPP
	depends on BR2_TOOLCHAIN_GCC_AT_LEAST_10 #C20
	depends on BR2_TOOLCHAIN_HAS_ATOMIC
	depends on !BR2_STATIC_LIBS # needs <dlfcn.h>
	help
	  libplacebo is, in a nutshell, the core rendering
	  algorithms and ideas of mpv rewritten as an
	  independent library. As of today, libplacebo
	  contains a large assortment of video processing
	  shaders, focusing on both quality and performance.

comment "libplacebo needs a toolchain w/ dynamic library, threads, and dynamic loading"
	depends on BR2_USE_MMU
	depends on BR2_STATIC_LIBS || !BR2_TOOLCHAIN_HAS_THREADS
```

## package/batocera/libraries/libportmidi/Config.in
```kconfig
config BR2_PACKAGE_LIBPORTMIDI
    bool "libportmidi"
    select BR2_PACKAGE_ALSA_LIB
    help
      PortMidi is a cross-platform MIDI input/output library.
      
      https://github.com/PortMidi/portmidi
```

## package/batocera/libraries/libpupdmd/Config.in
```kconfig
config BR2_PACKAGE_LIBPUPDMD
    bool "libpupdmd"
    select BR2_HOST_CMAKE_AT_LEAST_3_25
    help
      libpupdmd - cross-platform library for matching PUP triggers in DMD frames.
      
      https://github.com/ppuc/libpupdmd
```

## package/batocera/libraries/librga/Config.in
```kconfig
config BR2_PACKAGE_LIBRGA
  bool "librga"
    
  help
    
    https://github.com/rockchip-linux/linux-rga
```

## package/batocera/libraries/libsfdo/Config.in
```kconfig
config BR2_PACKAGE_LIBSFDO
	bool "libsfdo"
	help
	  A collection of libraries which implement some
	  of the freedesktop.org specifications.

	  https://github.com/jlindgren90/libsfdo
```

## package/batocera/libraries/libvni/Config.in
```kconfig
config BR2_PACKAGE_LIBVNI
    bool "libvni"
    help
      Cross platform dynamic library code for VNI file format.

      https://github.com/PPUC/libvni
```

## package/batocera/libraries/libwinevbs/Config.in
```kconfig
config BR2_PACKAGE_LIBWINEVBS
    bool "libwinevbs"
    help
      libwinevbs - cross-platform VBScript engine library.

      https://github.com/vpinball/libwinevbs
```

## package/batocera/libraries/libzedmd/Config.in
```kconfig
config BR2_PACKAGE_LIBZEDMD
    bool "libzedmd"
    select BR2_PACKAGE_CARGS
    select BR2_PACKAGE_LIBSERIALPORT
    select BR2_PACKAGE_SOCKPP
    select BR2_PACKAGE_LIBFRAMEUTIL
    select BR2_PACKAGE_LIBGPIOD2 if BR2_aarch64 && BR2_TOOLCHAIN_HEADERS_AT_LEAST_5_10
    select BR2_PACKAGE_LIBGPIOD  if BR2_aarch64 && !BR2_TOOLCHAIN_HEADERS_AT_LEAST_5_10 && BR2_TOOLCHAIN_HEADERS_AT_LEAST_4_8
    help
      ZeDMD communication library.
      
      https://github.com/PPUC/libzedmd
```

## package/batocera/libraries/miniz/Config.in
```kconfig
config BR2_PACKAGE_MINIZ
    bool "miniz"
    help
      Single C source file zlib-replacement library.
      
      https://github.com/richgel999/miniz
```

## package/batocera/libraries/muparser/Config.in
```kconfig
config BR2_PACKAGE_MUPARSER
        bool "muparser"
        depends on BR2_x86_64

        help
          muparser fast math parser library

          https://github.com/beltoforion/muparser
```

## package/batocera/libraries/nghttp3/Config.in
```kconfig
config BR2_PACKAGE_NGHTTP3
    bool "nghttp3"
    help
      HTTP/3 library written in C.
      
      https://github.com/ngtcp2/nghttp3
```

## package/batocera/libraries/ngtcp2/Config.in
```kconfig
config BR2_PACKAGE_NGTCP2
    bool "ngtcp2"
    select BR2_PACKAGE_LIBEV
    select BR2_PACKAGE_LIBOPENSSL
    select BR2_PACKAGE_LIBOPENSSL_ENABLE_QUIC
    select BR2_PACKAGE_NGHTTP3
    help
      ngtcp2 project is an effort to implement IETF QUIC protocol.
      
      https://nghttp2.org/ngtcp2/	  
```

## package/batocera/libraries/pipewire-ffmpeg-plugins/Config.in
```kconfig
config BR2_PACKAGE_PIPEWIRE_FFMPEG_PLUGINS
	bool "pipewire-ffmpeg-plugins"
	depends on BR2_PACKAGE_PIPEWIRE
	depends on BR2_PACKAGE_FFMPEG
	help
	  FFmpeg integration for PipeWire.

	  This builds the spa-ffmpeg codec plugin, the ffmpeg-based
	  video converter, and pw-cat with FFmpeg format support as a
	  separate package to avoid a circular dependency between
	  pipewire, sdl2, and ffmpeg.

	  pw-cat FFmpeg support requires libsndfile.

	  https://pipewire.org/
```

## package/batocera/libraries/plutosvg/Config.in
```kconfig
config BR2_PACKAGE_PLUTOSVG
    bool "plutosvg"
    help
      Tiny SVG rendering library in C.
      
      https://github.com/sammycage/plutosvg
```

## package/batocera/libraries/pm_auto/Config.in
```kconfig
config BR2_PACKAGE_PM_AUTO
    bool "pm_auto"
    select BR2_PACKAGE_PYTHON_ADAFRUIT_CIRCUITPYTHON_NEOPIXEL_SPI
    select BR2_PACKAGE_PYTHON_SMBUS2
    select BR2_PACKAGE_PYTHON_PSUTIL
    select BR2_PACKAGE_PYTHON_INFLUXDB
    select BR2_PACKAGE_PYTHON_PILLOW
    select BR2_PACKAGE_PYTHON3_GPIOD
    select BR2_PACKAGE_PYTHON_GPIOZERO
    select BR2_PACKAGE_PYTHON_LGPIO
    select BR2_PACKAGE_PYTHON_ADAFRUIT_CIRCUITPYTHON_REQUESTS
    help
      Library for monitoring Raspberry Pi system status.
      
      https://github.com/sunfounder/pm_auto
```
