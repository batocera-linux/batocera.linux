## package/batocera/libraries/python-smbus2/Config.in
```kconfig
config BR2_PACKAGE_PYTHON_SMBUS2
	bool "python-smbus2"
	help
	  A drop-in replacement for smbus-cffi/smbus-python in pure Python.

	  https://pypi.org/project/smbus2
```

## package/batocera/libraries/python3-configobj/Config.in
```kconfig
config BR2_PACKAGE_PYTHON3_CONFIGOBJ
    bool "python3-configobj"
    help
      Python 3+ compatible port of the configobj library.
      
      https://github.com/DiffSK/configobj
```

## package/batocera/libraries/python3-gpiod/Config.in
```kconfig
config BR2_PACKAGE_PYTHON3_GPIOD
    bool "python3-gpiod"
    help
      gpiod Python library with almost the same usage as libgpiodcxx.
      
      https://github.com/hhk7734/python3-gpiod
```

## package/batocera/libraries/pywebview/Config.in
```kconfig
config BR2_PACKAGE_PYWEBVIEW
    bool "pywebview"
	select BR2_PACKAGE_PYTHON_CRYPTOGRAPHY
	select BR2_PACKAGE_WEBKITGTK
	select BR2_PACKAGE_WEBKITGTK_MULTIMEDIA
	select BR2_PACKAGE_PYTHON_PROXY_TOOLS
	select BR2_PACKAGE_PYTHON_BOTTLE
	select BR2_PACKAGE_LIBGTK3
	select BR2_PACKAGE_PYTHON_TYPING_EXTENSIONS
	help
	  pywebview is a lightweight cross-platform wrapper around a webview component 
	  that allows to display HTML content in its own native GUI window.

	  https://github.com/r0x0r/pywebview
```

## package/batocera/libraries/qt6/qt6declarative/Config.in
```kconfig
config BR2_PACKAGE_QT6DECLARATIVE
    bool "qt6declarative"
    depends on BR2_TOOLCHAIN_HEADERS_AT_LEAST_3_6 # CAN FD
    select BR2_PACKAGE_QT6BASE
    select BR2_PACKAGE_QT6BASE_GUI
    select BR2_PACKAGE_QT6BASE_NETWORK
    select BR2_PACKAGE_QT6BASE_WIDGETS
    select BR2_PACKAGE_QT6BASE_OPENGL_DESKTOP
    select BR2_PACKAGE_QT6BASE_SQL
    select BR2_PACKAGE_QT6BASE_CONCURRENT
    select BR2_PACKAGE_QT6BASE_TEST
    select BR2_PACKAGE_QT6BASE_WIDGETS
    select BR2_PACKAGE_QT6SHADERTOOLS
    help
        Qt is a cross-platform application and UI framework for
        developers using C++.
        
        This package corresponds to the qt6declarative module.
        
        https://doc.qt.io/qt-6/qtmodules.html

comment "qt6declarative needs headers >= 3.6"
	depends on !BR2_TOOLCHAIN_HEADERS_AT_LEAST_3_6
```

## package/batocera/libraries/qt6/qt6multimedia/Config.in
```kconfig
config BR2_PACKAGE_QT6MULTIMEDIA
    bool "qt6multimedia"
    depends on BR2_TOOLCHAIN_HEADERS_AT_LEAST_3_6 # CAN FD
    select BR2_PACKAGE_QT6BASE
    select BR2_PACKAGE_QT6BASE_GUI
    select BR2_PACKAGE_QT6BASE_NETWORK
    select BR2_PACKAGE_QT6SHADERTOOLS
    select BR2_PACKAGE_QT6DECLARATIVE
    help
        Qt is a cross-platform application and UI framework for
        developers using C++.
        
        This package corresponds to the qt6multimedia module.
        
        https://doc.qt.io/qt-6/qtmultimedia-index.html

comment "qt6multimedia needs headers >= 3.6"
	depends on !BR2_TOOLCHAIN_HEADERS_AT_LEAST_3_6
```

## package/batocera/libraries/qt6/qt6shadertools/Config.in
```kconfig
config BR2_PACKAGE_QT6SHADERTOOLS
    bool "qt6shadertools"
    depends on BR2_TOOLCHAIN_HEADERS_AT_LEAST_3_6 # CAN FD
    select BR2_PACKAGE_QT6BASE
    select BR2_PACKAGE_QT6BASE_GUI
    select BR2_PACKAGE_QT6BASE_OPENGL
    help
        Qt is a cross-platform application and UI framework for
        developers using C++.
        
        Provides functionality for the shader pipeline that allows Qt Quick to operate
        on Vulkan, Metal, and Direct3D, in addition to OpenGL.
        
        https://doc.qt.io/qt-6/qtshadertools-index.html

comment "qt6shadertools needs headers >= 3.6"
	depends on !BR2_TOOLCHAIN_HEADERS_AT_LEAST_3_6
```

## package/batocera/libraries/qt6/qt6svg/Config.in
```kconfig
config BR2_PACKAGE_QT6SVG
    bool "qt6svg"
    depends on BR2_TOOLCHAIN_HEADERS_AT_LEAST_3_6 # CAN FD
    select BR2_PACKAGE_QT6BASE
    help
        Qt is a cross-platform application and UI framework for
        developers using C++.
        
        This package corresponds to the qt6svg module.
        
        https://doc.qt.io/qt-6/qtsvg-index.html

comment "qt6svg needs headers >= 3.6"
	depends on !BR2_TOOLCHAIN_HEADERS_AT_LEAST_3_6
```

## package/batocera/libraries/qt6/qt6tools/Config.in
```kconfig
config BR2_PACKAGE_QT6TOOLS
    bool "qt6tools"
    depends on BR2_PACKAGE_QT6
    depends on BR2_PACKAGE_QT6BASE

    # Needed Qt6 base components
    select BR2_PACKAGE_QT6BASE_DBUS
    select BR2_PACKAGE_QT6BASE_NETWORK
    select BR2_PACKAGE_QT6BASE_XML
    select BR2_PACKAGE_QT6BASE_PRINTSUPPORT
    
    help
      Qt is a cross-platform application and UI framework for
      developers using C++.
      
      This package corresponds to the qt6tools module
      
      https://doc.qt.io/qt-6/index.html
```

## package/batocera/libraries/qt6/qt6wayland/Config.in
```kconfig
config BR2_PACKAGE_QT6WAYLAND
    bool "qt6wayland"
    depends on BR2_TOOLCHAIN_HEADERS_AT_LEAST_3_6 # CAN FD
    select BR2_PACKAGE_QT6BASE
    help
        Qt is a cross-platform application and UI framework for
        developers using C++.
        
        This package corresponds to the qt6wayland module.
        
        https://doc.qt.io/qt-6/qtwayland-index.html

comment "qt6svg needs headers >= 3.6"
	depends on !BR2_TOOLCHAIN_HEADERS_AT_LEAST_3_6
```

## package/batocera/libraries/qt6/qt6websockets/Config.in
```kconfig
config BR2_PACKAGE_QT6WEBSOCKETS
    bool "qt6websockets"
    depends on BR2_TOOLCHAIN_HEADERS_AT_LEAST_3_6 # CAN FD
    select BR2_PACKAGE_QT6BASE
    help
        Qt is a cross-platform application and UI framework for
        developers using C++.
        
        This package corresponds to the qt6websockets module.
        
        https://doc.qt.io/qt-6/qtwebsockets-index.html

comment "qt6websockets needs headers >= 3.6"
	depends on !BR2_TOOLCHAIN_HEADERS_AT_LEAST_3_6
```

## package/batocera/libraries/rapidyaml/Config.in
```kconfig
config BR2_PACKAGE_RAPIDYAML
    bool "rapidyaml"
    help
      Rapid YAML - a library to parse and emit YAML, and do it fast.

      https://github.com/biojppm/rapidyaml
```

## package/batocera/libraries/sdl12-compat/Config.in
```kconfig
config BR2_PACKAGE_SDL12_COMPAT
    bool "sdl12-compat"
    depends on BR2_PACKAGE_SDL2
    help
      This code is a compatibility layer; it provides a binary and source compatible API for programs written against SDL 1.2, but it uses SDL 2.0 behind the scenes. 

      https://github.com/libsdl-org/sdl12-compat
```

## package/batocera/libraries/sdl3/Config.in
```kconfig
config BR2_PACKAGE_SDL3
	bool "sdl3"
	depends on BR2_PACKAGE_XORG7 || BR2_PACKAGE_WAYLAND
	depends on !BR2_STATIC_LIBS
	help
	  Simple DirectMedia Layer 3 - Simple DirectMedia Layer is a 
	  cross-platform development library designed to provide low level 
	  access to audio, keyboard, mouse, joystick, and graphics 
	  hardware via OpenGL and Direct3D. 

	  http://www.libsdl.org/

if BR2_PACKAGE_SDL3

config BR2_PACKAGE_SDL3_KMSDRM
	bool "KMS/DRM video driver"
	depends on BR2_TOOLCHAIN_HAS_THREADS  # libdrm
	depends on BR2_PACKAGE_HAS_LIBGBM
	depends on BR2_PACKAGE_HAS_LIBEGL
	depends on BR2_PACKAGE_SDL3_OPENGL || BR2_PACKAGE_SDL3_OPENGLES
	select BR2_PACKAGE_LIBDRM

comment "KMS/DRM video driver needs a toolchain w/ threads"
	depends on !BR2_TOOLCHAIN_HAS_THREADS

comment "KMS/DRM video driver needs a GBM provider, and OpenGL or OpenGLES+EGL"
	depends on !BR2_PACKAGE_HAS_LIBGBM || \
		!BR2_PACKAGE_HAS_LIBEGL || \
		!(BR2_PACKAGE_SDL3_OPENGL || BR2_PACKAGE_SDL3_OPENGLES)

config BR2_PACKAGE_SDL3_OPENGL
	bool "OpenGL (GLX)"
	depends on BR2_PACKAGE_HAS_LIBGL
	depends on BR2_PACKAGE_XORG7
	depends on BR2_USE_MMU # X11 video driver
	select BR2_PACKAGE_SDL3_X11

comment "OpenGL support needs X11 and an OpenGL provider"
	depends on BR2_USE_MMU
	depends on !BR2_PACKAGE_HAS_LIBGL || !BR2_PACKAGE_XORG7

config BR2_PACKAGE_SDL3_OPENGLES
	bool "OpenGL ES"
	depends on BR2_PACKAGE_HAS_LIBGLES

comment "OpenGL ES support needs an OpenGL ES provider"
	depends on !BR2_PACKAGE_HAS_LIBGLES

endif

config BR2_PACKAGE_SDL3_WAYLAND
    bool "SDL3 Wayland support"
    depends on BR2_PACKAGE_WAYLAND
    select BR2_PACKAGE_WAYLAND_PROTOCOLS
    select BR2_PACKAGE_LIBXKBCOMMON

comment "SDL3 Wayland support needs wayland"
	depends on !BR2_PACKAGE_WAYLAND

config BR2_PACKAGE_SDL3_X11
	bool "X11 video driver"
	depends on BR2_PACKAGE_XORG7
	depends on BR2_USE_MMU # fork()
	select BR2_PACKAGE_XLIB_LIBX11
	select BR2_PACKAGE_XLIB_LIBXEXT

comment "X11 video driver needs X.org"
	depends on !BR2_PACKAGE_XORG7
	depends on BR2_USE_MMU

comment "SDL3 needs a toolchain w/ dynamic library"
	depends on BR2_STATIC_LIBS
```

## package/batocera/libraries/sdl3_image/Config.in
```kconfig
config BR2_PACKAGE_SDL3_IMAGE
	bool "sdl3_image"
	depends on !BR2_STATIC_LIBS
	select BR2_PACKAGE_SDL3
	select BR2_PACKAGE_WEBP
	select BR2_PACKAGE_WEBP_DEMUX
	select BR2_PACKAGE_LIBAVIF
	select BR2_PACKAGE_TIFF
	help
	  Image decoding for many popular formats for Simple Directmedia Layer.

	  https://github.com/libsdl-org/SDL_image

comment "SDL3_image needs a toolchain w/ dynamic library"
	depends on BR2_STATIC_LIBS
```

## package/batocera/libraries/sdl3_mixer/Config.in
```kconfig
config BR2_PACKAGE_SDL3_MIXER
	bool "sdl3_mixer"
	depends on !BR2_STATIC_LIBS
	depends on BR2_PACKAGE_SDL3
	help
	  SDL3-based simple multi-channel audio mixer.

	  https://github.com/libsdl-org/SDL_mixer

comment "SDL3_Mixer needs a toolchain w/ dynamic library"
	depends on BR2_STATIC_LIBS
```

## package/batocera/libraries/sdl3_ttf/Config.in
```kconfig
config BR2_PACKAGE_SDL3_TTF
	bool "sdl3_ttf"
	depends on !BR2_STATIC_LIBS
	select BR2_PACKAGE_SDL3
	help
	  This library is a wrapper around the FreeType and Harfbuzz libraries,
	  allowing you to use TrueType fonts to render text in SDL applications.

	  https://github.com/libsdl-org/SDL_ttf

comment "SDL3_ttf needs a toolchain w/ dynamic library"
	depends on BR2_STATIC_LIBS
```

## package/batocera/libraries/semver/Config.in
```kconfig
config BR2_PACKAGE_SEMVER
    bool "semver"
    help
      Semantic Versioning for modern C++.
      
      https://github.com/Neargye/semver
```

## package/batocera/libraries/sf_rpi_status/Config.in
```kconfig
config BR2_PACKAGE_SF_RPI_STATUS
    bool "sf_rpi_status"
    select BR2_PACKAGE_PYTHON_REQUESTS
    select BR2_PACKAGE_PYTHON_PSUTIL
    help
      SunFounder Raspberry Pi Status python package.
      
      https://github.com/sunfounder/sf_rpi_status
```

## package/batocera/libraries/sfml/Config.in
```kconfig
config BR2_PACKAGE_SFML
        bool "sfml"
	select BR2_PACKAGE_XCB_UTIL_IMAGE
	select BR2_PACKAGE_OPENAL
	select BR2_PACKAGE_JPEG
	select BR2_PACKAGE_FLAC
	select BR2_PACKAGE_LIBVORBIS
        help
          Simple and Fast Multimedia Library
```

## package/batocera/libraries/shaderc/Config.in
```kconfig
config BR2_PACKAGE_SHADERC
    bool "shaderc"
    select BR2_PACKAGE_GLSLANG
    select BR2_PACKAGE_SPIRV_HEADERS
    select BR2_PACKAGE_SPIRV_TOOLS
    help
      A collection of tools, libraries, and tests for Vulkan shader compilation.
      
      https://github.com/google/shaderc
```

## package/batocera/libraries/sockpp/Config.in
```kconfig
config BR2_PACKAGE_SOCKPP
    bool "sockpp"
    help
      sockpp - Modern C++ socket library.
      
      https://github.com/fpagliughi/sockpp
```

## package/batocera/libraries/stenzek-shaderc/Config.in
```kconfig
config BR2_PACKAGE_STENZEK_SHADERC
    bool "stenzek-shaderc"
    select BR2_PACKAGE_GLSLANG
    help
      A collection of tools, libraries, and tests for Vulkan shader compilation.
      Modified by Stenzek for Duckstation & PCSX2.
      
      https://github.com/google/shaderc
```

## package/batocera/libraries/stormlib/Config.in
```kconfig
config BR2_PACKAGE_STORMLIB
	bool "stormlib"
	select BR2_PACKAGE_BZIP2
	select BR2_PACKAGE_ZLIB
	help
	  StormLib is a library that reads and writes Blizzard MPQ archives.

	  https://github.com/ladislav-zezula/StormLib
```

## package/batocera/libraries/tomlplusplus/Config.in
```kconfig
config BR2_PACKAGE_TOMLPLUSPLUS
    bool "tomlplusplus"
    help
      Header-only TOML config file parser and serializer for C++17.
      
      https://github.com/marzer/tomlplusplus
```
