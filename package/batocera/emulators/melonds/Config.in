## package/batocera/emulators/melonds/Config.in
```kconfig
config BR2_PACKAGE_MELONDS
    bool "melonDS"
    select BR2_PACKAGE_BATOCERA_QT6
    select BR2_PACKAGE_ECM
    select BR2_PACKAGE_LIBARCHIVE
    select BR2_PACKAGE_LIBEPOXY
    select BR2_PACKAGE_SDL2
    select BR2_PACKAGE_SLIRP
    help
      A Ninteno DS emulator

      http://melonds.kuribo64.net/
```

## package/batocera/emulators/model2emu/Config.in
```kconfig
config BR2_PACKAGE_MODEL2EMU
    bool "model2emu"
    depends on BR2_x86_64
    depends on BR2_PACKAGE_WINE_TKG
    help
      Model 2 Emulator 1.1a

      This is a Sega Model 2 Emulator for Windows which runs under Linux
      using WINE and appropriate supporting packages.
      
      http://nebula.emulatronia.com/
```

## package/batocera/emulators/moonlight-embedded/Config.in
```kconfig
config BR2_PACKAGE_MOONLIGHT_EMBEDDED
	bool "moonlight-embedded"
	select BR2_PACKAGE_OPUS
	select BR2_PACKAGE_EXPAT
	select BR2_PACKAGE_LIBEVDEV
	select BR2_PACKAGE_AVAHI
	select BR2_PACKAGE_ALSA_LIB
	select BR2_PACKAGE_HAS_UDEV
	select BR2_PACKAGE_LIBCURL
	select BR2_PACKAGE_LIBCEC
	select BR2_PACKAGE_FFMPEG
	select BR2_PACKAGE_FFMPEG_SWSCALE
	select BR2_PACKAGE_SDL2
	select BR2_PACKAGE_LIBENET
    select BR2_PACKAGE_ROCKCHIP_MPP          if BR2_PACKAGE_ROCKCHIP_RGA
	select BR2_PACKAGE_LIBVA_INTEL_DRIVER    if BR2_PACKAGE_BATOCERA_TARGET_X86_ANY
	select BR2_PACKAGE_INTEL_MEDIADRIVER     if BR2_PACKAGE_BATOCERA_TARGET_X86_ANY
	help
	  Gamestream client for embedded systems.

	  https://github.com/moonlight-stream/moonlight-embedded/wiki
```

## package/batocera/emulators/mupen64plus/Config.in
```kconfig
source "package/batocera/emulators/mupen64plus/mupen64plus-core/Config.in"
source "package/batocera/emulators/mupen64plus/mupen64plus-uiconsole/Config.in"
source "package/batocera/emulators/mupen64plus/mupen64plus-gles2/Config.in"
source "package/batocera/emulators/mupen64plus/mupen64plus-gles2rice/Config.in"
source "package/batocera/emulators/mupen64plus/mupen64plus-video-glide64mk2/Config.in"
source "package/batocera/emulators/mupen64plus/mupen64plus-omx/Config.in"
source "package/batocera/emulators/mupen64plus/mupen64plus-input-sdl/Config.in"
source "package/batocera/emulators/mupen64plus/mupen64plus-audio-sdl/Config.in"
source "package/batocera/emulators/mupen64plus/mupen64plus-rsphle/Config.in"
source "package/batocera/emulators/mupen64plus/mupen64plus-rice/Config.in"
source "package/batocera/emulators/mupen64plus/mupen64plus-gliden64/Config.in"
```

## package/batocera/emulators/mupen64plus/audio/mupen64plus-omx/Config.in
```kconfig
config BR2_PACKAGE_MUPEN64PLUS_OMX
        bool "mupen 64 plus omx"
	depends on BR2_INSTALL_LIBSTDCPP
	depends on BR2_PACKAGE_SDL2
	depends on BR2_PACKAGE_RPI_USERLAND
	depends on BR2_PACKAGE_ALSA_LIB
        help
          mupen 64 plus audio omx module
	  https://github.com/mupen64plus/

comment "MUPEN64PLUS OMX needs a toolchain w/ C++, ALSA and SDL2"
	depends on !BR2_INSTALL_LIBSTDCPP || !BR2_PACKAGE_SDL2 || !BR2_PACKAGE_ALSA_LIB
```

## package/batocera/emulators/mupen64plus/mupen64plus-audio-sdl/Config.in
```kconfig
config BR2_PACKAGE_MUPEN64PLUS_AUDIO_SDL
    bool "mupen64plus-audio-sdl"
	depends on BR2_INSTALL_LIBSTDCPP
	depends on BR2_PACKAGE_SDL2
	depends on BR2_PACKAGE_ALSA_LIB
        help
          Audio plugin for the Mupen64Plus v2.0 project, using SDL.
		  This plugin is based on the original jttl_audio plugin in Mupen64.

	    https://github.com/mupen64plus/
		https://github.com/mupen64plus/mupen64plus-audio-sdl

comment "MUPEN64PLUS_AUDIO_SDL needs a toolchain w/ C++, ALSA and SDL2"
	depends on !BR2_INSTALL_LIBSTDCPP || !BR2_PACKAGE_SDL2 || !BR2_PACKAGE_ALSA_LIB
```

## package/batocera/emulators/mupen64plus/mupen64plus-core/Config.in
```kconfig
config BR2_PACKAGE_MUPEN64PLUS_CORE
    bool "mupen64plus-core"
	depends on BR2_INSTALL_LIBSTDCPP
	depends on BR2_PACKAGE_SDL2
	depends on BR2_PACKAGE_ALSA_LIB
	depends on BR2_PACKAGE_FREETYPE
	depends on BR2_PACKAGE_DEJAVU
      help
        Core module of the Mupen64Plus project

	    https://github.com/mupen64plus/
		https://github.com/mupen64plus/mupen64plus-core

comment "MUPEN64PLUS_CORE  needs a toolchain w/ C++, ALSA and SDL2"
	depends on !BR2_INSTALL_LIBSTDCPP || !BR2_PACKAGE_SDL2 || !BR2_PACKAGE_ALSA_LIB
```

## package/batocera/emulators/mupen64plus/mupen64plus-gliden64/Config.in
```kconfig
config BR2_PACKAGE_MUPEN64PLUS_GLIDEN64
    bool "mupen64plus-gliden64-plugin"
	select BR2_PACKAGE_ZLIB
	select BR2_PACKAGE_LIBPNG
	select BR2_INSTALL_LIBSTDCPP
	select BR2_PACKAGE_SDL2
	select BR2_PACKAGE_ALSA_LIB
        help
          A new generation, open-source graphics plugin for N64 emulators.
	    
		https://github.com/gonetz/GLideN64

comment "MUPEN64PLUS_GLIDEN64 needs a toolchain w/ C++, ALSA and SDL2"
	depends on !BR2_INSTALL_LIBSTDCPP || !BR2_PACKAGE_SDL2 || !BR2_PACKAGE_ALSA_LIB
```

## package/batocera/emulators/mupen64plus/mupen64plus-input-sdl/Config.in
```kconfig
config BR2_PACKAGE_MUPEN64PLUS_INPUT_SDL
    bool "mupen64plus-input-sdl"
	depends on BR2_INSTALL_LIBSTDCPP
	depends on BR2_PACKAGE_SDL2
	depends on BR2_PACKAGE_ALSA_LIB
        help
          Input plugin for Mupen64Plus v2.0 project using SDL.
		  This is derived from the original Mupen64 blight_input plugin.
	    
		https://github.com/mupen64plus/
		https://github.com/mupen64plus/mupen64plus-input-sdl

comment "MUPEN64PLUS_INPUT_SDL needs a toolchain w/ C++, ALSA and SDL2"
	depends on !BR2_INSTALL_LIBSTDCPP || !BR2_PACKAGE_SDL2 || !BR2_PACKAGE_ALSA_LIB
```

## package/batocera/emulators/mupen64plus/mupen64plus-rice/Config.in
```kconfig
config BR2_PACKAGE_MUPEN64PLUS_RICE
        bool "mupen 64 plus rice plugin"
	depends on BR2_INSTALL_LIBSTDCPP
	depends on BR2_PACKAGE_SDL2
	depends on BR2_PACKAGE_RPI_USERLAND
	depends on BR2_PACKAGE_ALSA_LIB
        help
          mupen 64 plus rice plugin
	  https://github.com/mupen64plus/

comment "MUPEN64PLUS RICE needs a toolchain w/ C++, ALSA and SDL2"
	depends on !BR2_INSTALL_LIBSTDCPP || !BR2_PACKAGE_SDL2 || !BR2_PACKAGE_ALSA_LIB
```

## package/batocera/emulators/mupen64plus/mupen64plus-rsp-hle/Config.in
```kconfig
config BR2_PACKAGE_MUPEN64PLUS_RSP_HLE
    bool "mupen64plus-rsp-hle"
	depends on BR2_INSTALL_LIBSTDCPP
	depends on BR2_PACKAGE_SDL2
	depends on BR2_PACKAGE_ALSA_LIB
        help
          RSP processor plugin for the Mupen64Plus v2.0 project.
		  This plugin is based on the Mupen64 HLE RSP plugin v0.2 with Azimers code by Hacktarux

	  https://github.com/mupen64plus/
	  https://github.com/mupen64plus/mupen64plus-rsp-hle

comment "MUPEN64PLUS_RSP_HLE needs a toolchain w/ C++, ALSA and SDL2"
	depends on !BR2_INSTALL_LIBSTDCPP || !BR2_PACKAGE_SDL2 || !BR2_PACKAGE_ALSA_LIB
```

## package/batocera/emulators/mupen64plus/mupen64plus-ui-console/Config.in
```kconfig
config BR2_PACKAGE_MUPEN64PLUS_UI_CONSOLE
    bool "mupen64plus-ui-console"
	depends on BR2_INSTALL_LIBSTDCPP
	depends on BR2_PACKAGE_SDL2
	depends on BR2_PACKAGE_ALSA_LIB
	depends on BR2_PACKAGE_MUPEN64PLUS_CORE
        help
          Console (command-line) front-end user interface for Mupen64Plus v2.0 project
	  
	  https://github.com/mupen64plus/
	  https://github.com/mupen64plus/mupen64plus-ui-console

comment "BR2_PACKAGE_MUPEN64PLUS_UI_CONSOLE needs a toolchain w/ C++, ALSA and SDL2"
	depends on !BR2_INSTALL_LIBSTDCPP || !BR2_PACKAGE_SDL2 || !BR2_PACKAGE_ALSA_LIB
```

## package/batocera/emulators/mupen64plus/mupen64plus-uiconsole/Config.in
```kconfig
config BR2_PACKAGE_MUPEN64PLUS_UICONSOLE
        bool "mupen 64 plus console"
	depends on BR2_INSTALL_LIBSTDCPP
	depends on BR2_PACKAGE_SDL2
	depends on BR2_PACKAGE_ALSA_LIB
	depends on BR2_PACKAGE_MUPEN64PLUS_CORE
        help
          mupen 64 plus ui console
	  https://github.com/mupen64plus/

comment "MUPEN64PLUS UI CONSOLE  needs a toolchain w/ C++, ALSA and SDL2"
	depends on !BR2_INSTALL_LIBSTDCPP || !BR2_PACKAGE_SDL2 || !BR2_PACKAGE_ALSA_LIB
```

## package/batocera/emulators/mupen64plus/mupen64plus-video-glide64mk2/Config.in
```kconfig
config BR2_PACKAGE_MUPEN64PLUS_VIDEO_GLIDE64MK2
    bool "mupen64plus-video-glide64mk2"
	depends on BR2_INSTALL_LIBSTDCPP
	select BR2_PACKAGE_SDL2
	select BR2_PACKAGE_ALSA_LIB
	select BR2_PACKAGE_BOOST
	select BR2_PACKAGE_BOOST_SYSTEM
	select BR2_PACKAGE_BOOST_FILESYSTEM
        help
          Video plugin for Mupen64Plus 2.0 based on 10th anniversary release code from gonetz
	    
		https://github.com/mupen64plus/

comment "MUPEN64PLUS_VIDEO_GLIDE64MK2 needs a toolchain w/ C++, ALSA and SDL2"
	depends on !BR2_INSTALL_LIBSTDCPP || !BR2_PACKAGE_SDL2 || !BR2_PACKAGE_ALSA_LIB
```

## package/batocera/emulators/mupen64plus/mupen64plus-video-rice/Config.in
```kconfig
config BR2_PACKAGE_MUPEN64PLUS_VIDEO_RICE
    bool "mupen64plus-video-rice"
	depends on BR2_INSTALL_LIBSTDCPP
	select BR2_PACKAGE_SDL2
	select BR2_PACKAGE_ALSA_LIB
	select BR2_PACKAGE_BOOST
	select BR2_PACKAGE_BOOST_FILESYSTEM
        help
          Video plugin for the Mupen64Plus v2.0 project, using OpenGL.
		  This plugin is based on the RiceVideoLinux plugin from earlier versions of Mupen64Plus.
	  
	  https://github.com/mupen64plus/
	  https://github.com/mupen64plus/mupen64plus-video-rice

comment "MUPEN64PLUS_VIDEO_RICE needs a toolchain w/ C++, ALSA and SDL2"
	depends on !BR2_INSTALL_LIBSTDCPP || !BR2_PACKAGE_SDL2 || !BR2_PACKAGE_ALSA_LIB
```

## package/batocera/emulators/mupen64plus/video/mupen64plus-gles2/Config.in
```kconfig
config BR2_PACKAGE_MUPEN64PLUS_GLES2
        bool "mupen 64 plus gles2n64"
	depends on BR2_INSTALL_LIBSTDCPP
	depends on BR2_PACKAGE_SDL2
	depends on BR2_PACKAGE_ALSA_LIB
        help
          mupen 64 plus glesn64 module
	  https://github.com/mupen64plus/

comment "MUPEN64PLUS GLES2N64 needs a toolchain w/ C++, ALSA and SDL2"
	depends on !BR2_INSTALL_LIBSTDCPP || !BR2_PACKAGE_SDL2 || !BR2_PACKAGE_ALSA_LIB
```

## package/batocera/emulators/mupen64plus/video/mupen64plus-video-glide64mk2/Config.in
```kconfig
config BR2_PACKAGE_MUPEN64PLUS_VIDEO_GLIDE64MK2
        bool "mupen 64 plus video-glide64mk2"
	depends on BR2_INSTALL_LIBSTDCPP
	select BR2_PACKAGE_SDL2
	select BR2_PACKAGE_ALSA_LIB
	select BR2_PACKAGE_BOOST
	select BR2_PACKAGE_BOOST_SYSTEM
	select BR2_PACKAGE_BOOST_FILESYSTEM
        help
          mupen 64 plus video-glide64mk2 module
	  https://github.com/mupen64plus/

comment "MUPEN64PLUS VIDEO_GLIDE64MK2 needs a toolchain w/ C++, ALSA and SDL2"
	depends on !BR2_INSTALL_LIBSTDCPP || !BR2_PACKAGE_SDL2 || !BR2_PACKAGE_ALSA_LIB
```

## package/batocera/emulators/nanoboyadvance/Config.in
```kconfig
config BR2_PACKAGE_NANOBOYADVANCE
	bool "nanoboyadvance"
	select BR2_PACKAGE_SDL2
	select BR2_PACKAGE_QT6BASE
	help
	  NanoBoyAdvance - Accurate Game Boy Advance emulator.
	  Requires OpenGL 3.3 Core Profile.
	  https://github.com/nba-emu/NanoBoyAdvance
```

## package/batocera/emulators/nba/Config.in
```kconfig
config BR2_PACKAGE_NBA
	bool "nba"
        depends on BR2_INSTALL_LIBSTDCPP
        select BR2_PACKAGE_SDL2
        select BR2_PACKAGE_LIBGLEW

	help
	  A highly accurate Nintendo Game Boy Advance emulator.

	  https://github.com/nba-emu/NanoBoyAdvance
```

## package/batocera/emulators/nesbox-tic80/Config.in
```kconfig
config BR2_PACKAGE_XROAR
        bool "nesbox-tic80"
        help
          TIC-80 is a fantasy computer for making, playing and sharing tiny games. 

		      https://tic80.com/
```

## package/batocera/emulators/openbor/openbor/Config.in
```kconfig
config BR2_PACKAGE_OPENBOR
        bool "openbor"
	select BR2_PACKAGE_LIBVPX
	select BR2_PACKAGE_SDL2
	select BR2_PACKAGE_LIBPNG
	select BR2_PACKAGE_LIBOGG
	select BR2_PACKAGE_LIBVORBIS
```

## package/batocera/emulators/openbor/openbor6330/Config.in
```kconfig
config BR2_PACKAGE_OPENBOR6330
        bool "openbor6330"
	select BR2_PACKAGE_LIBVPX
	select BR2_PACKAGE_SDL2
	select BR2_PACKAGE_SDL2_GFX
	select BR2_PACKAGE_LIBPNG
	select BR2_PACKAGE_LIBOGG
	select BR2_PACKAGE_LIBVORBIS
```

## package/batocera/emulators/openbor/openbor6510/Config.in
```kconfig
config BR2_PACKAGE_OPENBOR6510
        bool "openbor6510"
	select BR2_PACKAGE_LIBVPX
	select BR2_PACKAGE_SDL2
	select BR2_PACKAGE_SDL2_GFX
	select BR2_PACKAGE_LIBPNG
	select BR2_PACKAGE_LIBOGG
	select BR2_PACKAGE_LIBVORBIS
```

## package/batocera/emulators/openbor/openbor7142/Config.in
```kconfig
config BR2_PACKAGE_OPENBOR7142
        bool "openbor7142"
	select BR2_PACKAGE_LIBVPX
	select BR2_PACKAGE_SDL2
	select BR2_PACKAGE_SDL2_GFX
	select BR2_PACKAGE_LIBPNG
	select BR2_PACKAGE_LIBOGG
	select BR2_PACKAGE_LIBVORBIS
```
