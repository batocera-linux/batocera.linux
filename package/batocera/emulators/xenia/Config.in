## package/batocera/emulators/xenia/Config.in
```kconfig
config BR2_PACKAGE_XENIA
    bool "xenia"
    depends on BR2_x86_64
    depends on BR2_PACKAGE_WINE_TKG
    select BR2_PACKAGE_PYTHON_TOML
    help
      Xenia is an open source research project for emulating Xbox 360 games on modern PCs.

      https://xenia.jp/
```

## package/batocera/emulators/xroar/Config.in
```kconfig
config BR2_PACKAGE_XROAR
    bool "xroar"
    select BR2_PACKAGE_ALSA_LIB
    select BR2_PACKAGE_LIBEVDEV
    select BR2_PACKAGE_LIBPNG
    select BR2_PACKAGE_LIBZLIB
    select BR2_PACKAGE_SDL2
    select BR2_PACKAGE_SDL2_IMAGE
    help
      XRoar emulates the Dragon 32/64, Tandy Colour Computers 1, 2 and 3
      the Tandy MC-10 and some other similar machines or clones.

      https://www.6809.org.uk/xroar/
```

## package/batocera/emulators/ymir/Config.in
```kconfig
config BR2_PACKAGE_YMIR
    bool "ymir"
    select BR2_PACKAGE_CATCH2
    select BR2_PACKAGE_CEREAL
    select BR2_PACKAGE_CXXOPTS
    select BR2_PACKAGE_DATE
    select BR2_PACKAGE_FMT
    select BR2_PACKAGE_JSON_FOR_MODERN_CPP
    select BR2_PACKAGE_LIBCURL
    select BR2_PACKAGE_NGHTTP3
    select BR2_PACKAGE_NGTCP2
    select BR2_PACKAGE_OPENSSL
    select BR2_PACKAGE_RTMIDI
    select BR2_PACKAGE_SDL3
    select BR2_PACKAGE_SEMVER
    select BR2_PACKAGE_STB
    select BR2_PACKAGE_TOMLPLUSPLUS
    help
      Sega Saturn emulator.

      https://github.com/StrikerX3/Ymir
```

## package/batocera/emulators/yuzu-cmd/Config.in
```kconfig
config BR2_PACKAGE_YUZU_CMD
    bool "yuzu-cmd"
    depends on BR2_x86_64
    depends on BR2_PACKAGE_XORG7
    select BR2_PACKAGE_SDL2
    select BR2_PACKAGE_FMT
    select BR2_PACKAGE_BOOST
    select BR2_PACKAGE_BOOST_CONTEXT
    select BR2_PACKAGE_FFMPEG  
    select BR2_PACKAGE_ZSTD
    select BR2_PACKAGE_CATCH2
    select BR2_PACKAGE_YUZU
    help
      A Emulator Yuzu core for Nintendo Switch.

	    https://yuzu-emu.org/
```

## package/batocera/emulators/yuzu/Config.in
```kconfig
config BR2_PACKAGE_YUZU
    bool "yuzu"
    depends on BR2_x86_64
    depends on BR2_PACKAGE_XORG7
    select BR2_PACKAGE_JSON_FOR_MODERN_CPP
    select BR2_PACKAGE_BATOCERA_QT6
    select BR2_PACKAGE_SDL2
    select BR2_PACKAGE_FMT
    select BR2_PACKAGE_BOOST
    select BR2_PACKAGE_BOOST_CONTEXT
    select BR2_PACKAGE_FFMPEG  
    select BR2_PACKAGE_ZSTD
    select BR2_PACKAGE_ZLIB
    select BR2_PACKAGE_LIBZIP
    select BR2_PACKAGE_LZ4
    select BR2_PACKAGE_CATCH2
    select BR2_PACKAGE_OPUS
    help
      A Emulator Yuzu core for Nintendo Switch.

	    https://yuzu-emu.org/
```

## package/batocera/evwait/Config.in
```kconfig
config BR2_PACKAGE_EVWAIT
	bool "evtest"
	help
	  evwait wait for a specific evdev kernel event

	  https://github.com/nadenislamarre/evwait
```

## package/batocera/firmware_nonfree/Config.in
```kconfig
config BR2_PACKAGE_FIRMWARE_NONFREE
	bool "firmware_nonfree"
	help
	  This package provides various binary firmware files (closed
	  binary blobs) for such devices like LAN, WLAN cards etc.

	  https://github.com/RPi-Distro/firmware-nonfree.git
```

## package/batocera/firmwares/amlogic-common-drivers/Config.in
```kconfig
config BR2_PACKAGE_AMLOGIC_COMMON_DRIVERS
	bool "Amlogic Common Drivers"
	help
	  Required by Amlogic vendor kernel.

if BR2_PACKAGE_AMLOGIC_COMMON_DRIVERS

config BR2_PACKAGE_AMLOGIC_COMMON_DRIVERS_VERSION
	string "Amlogic common drivers version"
	help
	  The version/tag/commit of the Amlogic common drivers to use.

config BR2_PACKAGE_AMLOGIC_COMMON_DRIVERS_REPOSITORY
	string "Amlogic common drivers git repository URL"
	help
	  URL of the git repository for the Amlogic common drivers.

endif
```

## package/batocera/firmwares/broadcom-bt-firmware/Config.in
```kconfig
config BR2_PACKAGE_BROADCOM_BT_FIRMWARE
    bool "broadcom-bt-firmware"
    help
      Repository for various Broadcom Bluetooth firmware.

      https://github.com/winterheart/broadcom-bt-firmware
```

## package/batocera/firmwares/extralinuxfirmwares/Config.in
```kconfig
config BR2_PACKAGE_EXTRALINUXFIRMWARES
	bool "extralinuxfirmwares"
    select BR2_PACKAGE_ALLLINUXFIRMWARES

	help
	  Batocera extra linux firmwares
```

## package/batocera/firmwares/firmware-esp8089/Config.in
```kconfig
config BR2_PACKAGE_FIRMWARE_ESP8089
	bool "firmware-esp8089"
	help
	  ESP8089 wifi firmware.
	  
	  https://github.com/jwrdegoede/esp8089.git
```

## package/batocera/firmwares/firmware-openelec/Config.in
```kconfig
config BR2_PACKAGE_FIRMWARE_OPENELEC
	bool "firmware-openelec"

	help
	  Provides binary firmware files for linuxtv dvb devices
```

## package/batocera/firmwares/firmware-orangepi/Config.in
```kconfig
config BR2_PACKAGE_FIRMWARE_ORANGEPI
	bool "firmware-orangepi"
	help
	  OrangePi specific firmware

	  https://github.com/orangepi-xunlong/firmware
```

## package/batocera/firmwares/firmware-rk3588/Config.in
```kconfig
config BR2_PACKAGE_FIRMWARE_RK3588
	bool "firmware-rk3588"
	select BR2_PACKAGE_ALLLINUXFIRMWARES
	select BR2_PACKAGE_FIRMWARE_RADXA_RKWIFIBT
```

## package/batocera/firmwares/firmware-rock5b/Config.in
```kconfig
config BR2_PACKAGE_FIRMWARE_ROCK5B
	bool "firmware-rock5b"
    select BR2_PACKAGE_ALLLINUXFIRMWARES
    select BR2_PACKAGE_FIRMWARE_OPENELEC
```

## package/batocera/firmwares/firmware-rockpro64/Config.in
```kconfig
config BR2_PACKAGE_FIRMWARE_ROCKPRO64
	bool "firmware-rockpro64"
    select BR2_PACKAGE_ALLLINUXFIRMWARES
```

## package/batocera/firmwares/firmware-wlan-aml/Config.in
```kconfig
config BR2_PACKAGE_FIRMWARE_WLAN_AML
	bool "firmware-wlan-aml"
    select BR2_PACKAGE_ALLLINUXFIRMWARES

	help
	  Provides binary firmware files for aml tv boxes.
```

## package/batocera/firmwares/sound-open-firmware/Config.in
```kconfig
config BR2_PACKAGE_SOUND_OPEN_FIRMWARE
	bool "sound-open-firmware"
	select BR2_PACKAGE_ALSA_LIB
	select BR2_PACKAGE_ALSA_UTILS
	select BR2_PACKAGE_ALLLINUXFIRMWARES
	help
	  Open source audio DSP firmware and development tools.

	  https://www.sofproject.org/
```

## package/batocera/firmwares/ti-firmware/Config.in
```kconfig
config BR2_PACKAGE_TI_FIRMWARE
	bool "ti-firmware"
    select BR2_PACKAGE_ALLLINUXFIRMWARES
	help
	  Texas Instruments firmware for the
	  Asus ROG Ally X
```

## package/batocera/fonts/noto-cjk-fonts/Config.in
```kconfig
config BR2_PACKAGE_NOTO_CJK_FONTS
    bool "noto-cjk-fonts"
    help
      Noto - Chinese, Japanese & Korean fonts.
      
      https://github.com/notofonts/noto-cjk
```
