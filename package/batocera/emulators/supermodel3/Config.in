## package/batocera/emulators/supermodel3/Config.in
```kconfig
config BR2_PACKAGE_SUPERMODEL3
        bool "supermodel3"
        depends on BR2_x86_64
        depends on BR2_INSTALL_LIBSTDCPP
        select BR2_PACKAGE_SDL2
          select BR2_PACKAGE_SDL2_NET
          select BR2_PACKAGE_ZLIB
        select BR2_PACKAGE_LIBGLEW
        select BR2_PACKAGE_LIBZIP

        help
          A SEGA Model 3 emulator.

	  http://www.supermodel3.com

comment "SUPERMODEL3 needs a toolchain w/ C++"
	depends on !BR2_INSTALL_LIBSTDCPP
```

## package/batocera/emulators/teknoparrot/Config.in
```kconfig
config BR2_PACKAGE_TEKNOPARROT
        bool "teknoparrot"
        depends on BR2_x86_64
        depends on BR2_PACKAGE_WINE_LUTRIS
        help
          TeknoParrot is a software package allowing you to run selected PC-based arcade titles.
          
          https://teknoparrot.com/
```

## package/batocera/emulators/thextech/Config.in
```kconfig
config BR2_PACKAGE_THEXTECH
    bool "thextech"
    depends on BR2_PACKAGE_SDL2
    depends on BR2_PACKAGE_SDL2_MIXER
    select BR2_PACKAGE_SDL2_TTF
    help
      TheXTech is a C++ SMBX engine

      https://github.com/Wohlstand/TheXTech/
```

## package/batocera/emulators/tic80/Config.in
```kconfig
config BR2_PACKAGE_TIC80
	bool "tic80"
	depends on BR2_PACKAGE_SDL2
	depends on BR2_INSTALL_LIBSTDCPP
	depends on BR2_TOOLCHAIN_HAS_THREADS
	depends on !BR2_STATIC_LIBS
	select BR2_PACKAGE_ZLIB
	help
	  TIC-80 is a fantasy computer for making, playing and 
	  sharing tiny games.
	  
	  Standalone version (not libretro core).

	  https://tic80.com

comment "tic80 needs SDL2 and a toolchain w/ C++, threads, dynamic library"
	depends on !BR2_PACKAGE_SDL2 || !BR2_INSTALL_LIBSTDCPP || \
		!BR2_TOOLCHAIN_HAS_THREADS || BR2_STATIC_LIBS
```

## package/batocera/emulators/tsugaru/Config.in
```kconfig
config BR2_PACKAGE_TSUGARU
    bool "tsugaru"
    select BR2_PACKAGE_ALSA_LIB
    select BR2_PACKAGE_LIBGLU
    help
      FM TOWNS Emulator "Tsugaru"

	    https://github.com/captainys/TOWNSEMU
```

## package/batocera/emulators/vice/Config.in
```kconfig
config BR2_PACKAGE_VICE
	bool "vice"
	select BR2_PACKAGE_FFMPEG
	select BR2_PACKAGE_FLAC
	select BR2_PACKAGE_SDL2
	select BR2_PACKAGE_SDL2_IMAGE
	select BR2_PACKAGE_PNG
	select BR2_PACKAGE_JPEG
	select BR2_PACKAGE_GIFLIB
	select BR2_PACKAGE_ZLIB
	select BR2_PACKAGE_LAME
	select BR2_PACKAGE_ALSA_LIB
	select BR2_PACKAGE_LIBCURL
	select BR2_PACKAGE_HOST_XA
	select BR2_PACKAGE_HOST_DOS2UNIX
	select BR2_PACKAGE_LIBVORBIS
	help
	  VICE is an emulator collection which emulates the C64, the C64-DTV, the C128,
	  the VIC20, practically all PET models, the PLUS4 and the CBM-II (aka C610).

	comment "Vice  needs a toolchain w/ OpenGl,  SDL"
```

## package/batocera/emulators/vita3k/Config.in
```kconfig
config BR2_PACKAGE_VITA3K
    bool "vita3k"
    select BR2_PACKAGE_BOOST
    select BR2_PACKAGE_LIBOGG
    select BR2_PACKAGE_LIBVORBIS
    select BR2_PACKAGE_PYTHON_RUAMEL_YAML
    select BR2_PACKAGE_QT6BASE
    select BR2_PACKAGE_QT6MULTIMEDIA
    select BR2_PACKAGE_QT6SVG
    select BR2_PACKAGE_QT6TOOLS
    select BR2_PACKAGE_SDL3
    select BR2_PACKAGE_SDL3_IMAGE
    select BR2_PACKAGE_SDL3_TTF
    select BR2_PACKAGE_ZLIB
    help
      Experimental PlayStation Vita emulator
      
      https://github.com/vita3k/vita3k
```

## package/batocera/emulators/wine-x86/Config.in
```kconfig
config BR2_PACKAGE_WINE_X86
    bool "wine-x86"
    help
      Wine & associated lib32 libraries precompiled for i386 or x86

      https://github.com/batocera-linux/wine-x86
```

## package/batocera/emulators/wine/d8vk/Config.in
```kconfig
config BR2_PACKAGE_D8VK
    bool "d8vk"
	depends on BR2_i386 || BR2_x86_64
	# Wine unconditionally builds shared libraries
	depends on !BR2_STATIC_LIBS
	depends on BR2_PACKAGE_SPIRV_HEADERS
	select BR2_PACKAGE_DXVK
	help
	  Direct3D 8 to Vulkan translation for DXVK.
	  
	  https://github.com/AlpyneDreams/d8vk

comment "d8vk needs a toolchain w/ dynamic library"
    depends on BR2_STATIC_LIBS
```

## package/batocera/emulators/wine/dxvk-nvapi/Config.in
```kconfig
config BR2_PACKAGE_DXVK_NVAPI
	bool "dxvk_nvapi"
    depends on BR2_i386 || BR2_x86_64
	# Wine unconditionally builds shared libraries
	depends on !BR2_STATIC_LIBS
	depends on BR2_PACKAGE_SPIRV_HEADERS
	depends on BR2_PACKAGE_DXVK
	help
      Provides an alternative implementation of NVIDIA's NVAPI library
	  for use with DXVK and VKD3D-Proton.
	  
	  https://github.com/jp7677/dxvk-nvapi

comment "dxvk_nvapi needs a toolchain w/ dynamic library"
	depends on BR2_STATIC_LIBS
```

## package/batocera/emulators/wine/mf/Config.in
```kconfig
config BR2_PACKAGE_MF
	bool "mf"
        depends on BR2_i386 || BR2_x86_64
	# Wine unconditionally builds shared libraries
	depends on !BR2_STATIC_LIBS
	depends on BR2_PACKAGE_SPIRV_HEADERS
	help
          MF
          A Media Foundation workaround for Wine.

          https://github.com/z0z0z/mf-install

comment "dxvk needs a toolchain w/ dynamic library"
	depends on BR2_STATIC_LIBS
```

## package/batocera/emulators/wine/rtkit/Config.in
```kconfig
config BR2_PACKAGE_RTKIT
	bool "rtkit"
	select BR2_PACKAGE_LIBCAP
	select BR2_PACKAGE_POLKIT
	# Wine unconditionally builds shared libraries
	depends on !BR2_STATIC_LIBS
	help
          RealtimeKit
  
	  This is a D-Bus system service that changes the scheduling policy of user processes/threads to SCHED_RR
	  (i.e. realtime scheduling mode) on request. It is intended to be used as a secure mechanism to allow real-time
	  scheduling to be used by normal user processes.

	  Project Website: https://github.com/heftig/rtkit

comment "rtkit needs a toolchain w/ dynamic library"
	depends on BR2_STATIC_LIBS
```

## package/batocera/emulators/wine/vkd3d-proton/Config.in
```kconfig
config BR2_PACKAGE_VKD3D_PROTON
	bool "vkd3d_proton"
        depends on BR2_i386 || BR2_x86_64
	# Wine unconditionally builds shared libraries
	depends on !BR2_STATIC_LIBS
	depends on BR2_PACKAGE_SPIRV_HEADERS
	depends on BR2_PACKAGE_DXVK
	help
          VKD3D PROTON
          A Vulkan-based translation layer for Direct3D 12 which allows running 3D applications on Linux using Wine.

          https://github.com/HansKristian-Work/vkd3d-proton

comment "vkd3d_proton needs a toolchain w/ dynamic library"
	depends on BR2_STATIC_LIBS
```

## package/batocera/emulators/wine/vkd3d/Config.in
```kconfig
config BR2_PACKAGE_VKD3D
	bool "vkd3d"
        depends on BR2_i386 || BR2_x86_64
	# Wine unconditionally builds shared libraries
	depends on !BR2_STATIC_LIBS
	depends on BR2_PACKAGE_SPIRV_HEADERS
	help
	  VkD3D Wine is a compatibility layer capable of running Windows
	  applications on Linux. Instead of simulating internal
	  Windows logic like a virtual machine or emulator, Wine
	  translates Windows API calls into POSIX calls on-the-fly,
	  eliminating the performance and memory penalties of other
	  methods.

	  http://www.winehq.org

comment "vkd3d needs a toolchain w/ dynamic library"
	depends on BR2_STATIC_LIBS
```

## package/batocera/emulators/wine/wine-ge-custom/Config.in
```kconfig
config BR2_PACKAGE_WINE_GE_CUSTOM
	bool "wine-ge-custom"
	# Wine unconditionally builds shared libraries
	depends on !BR2_STATIC_LIBS
	help
	  Wine is a compatibility layer capable of running Windows
	  applications on Linux. Instead of simulating internal
	  Windows logic like a virtual machine or emulator, Wine
	  translates Windows API calls into POSIX calls on-the-fly,
	  eliminating the performance and memory penalties of other
	  methods.

	  This is the custom Glorius Eggroll version.
	  Whih is based on/forked from the most recent bleeding-edge proton experimental wine repo.
	  This is meant to be used with non-steam games outside of Steam.

	  http://www.winehq.org
	  https://github.com/GloriousEggroll/wine-ge-custom

comment "wine needs a toolchain w/ dynamic library"
	depends on BR2_PACKAGE_WINE_ARCH_SUPPORTS
	depends on BR2_STATIC_LIBS
```

## package/batocera/emulators/wine/wine-mono-ge-custom/Config.in
```kconfig
config BR2_PACKAGE_WINE_MONO_GE_CUSTOM
	bool "wine-mono-ge-custom"
    depends on BR2_i386 || BR2_x86_64
    help
      Wine Mono for Wine GE Custom
```

## package/batocera/emulators/wine/wine-mono-lutris/Config.in
```kconfig
config BR2_PACKAGE_WINE_MONO_LUTRIS
	bool "wine-mono-lutris"
        depends on BR2_i386 || BR2_x86_64
```

## package/batocera/emulators/wine/wine-mono-proton/Config.in
```kconfig
config BR2_PACKAGE_WINE_MONO_PROTON
	bool "wine-mono-proton"
        depends on BR2_i386 || BR2_x86_64
```

## package/batocera/emulators/wine/wine-mono/Config.in
```kconfig
config BR2_PACKAGE_WINE_MONO
	bool "wine-mono"
    depends on BR2_i386 || BR2_x86_64
    help
      Wine Mono for Wine.
```

## package/batocera/emulators/wine/wine-proton-wow64_32/Config.in
```kconfig
config BR2_PACKAGE_WINE_PROTON_WOW64_32
	bool "wine-proton-wow64_32"
	# Wine unconditionally builds shared libraries
	depends on !BR2_STATIC_LIBS
	help
	  Wine is a compatibility layer capable of running Windows
	  applications on Linux. Instead of simulating internal
	  Windows logic like a virtual machine or emulator, Wine
	  translates Windows API calls into POSIX calls on-the-fly,
	  eliminating the performance and memory penalties of other
	  methods.

	  http://www.winehq.org

comment "wine needs a toolchain w/ dynamic library"
	depends on BR2_PACKAGE_WINE_ARCH_SUPPORTS
	depends on BR2_STATIC_LIBS
```

## package/batocera/emulators/wine/wine-tkg/Config.in
```kconfig
config BR2_PACKAGE_WINE_TKG
	bool "wine-tkg"
	# Wine unconditionally builds shared libraries
	depends on !BR2_STATIC_LIBS
	help
	  Wine is a compatibility layer capable of running Windows
	  applications on Linux. Instead of simulating internal
	  Windows logic like a virtual machine or emulator, Wine
	  translates Windows API calls into POSIX calls on-the-fly,
	  eliminating the performance and memory penalties of other
	  methods.

	  Wine source generated by the wine-tkg build system.
	  See wine-tkg-config.txt for config.

	  http://www.winehq.org
	  https://github.com/Frogging-Family/wine-tkg-git
	  https://github.com/Kron4ek/wine-tkg

comment "wine needs a toolchain w/ dynamic library"
	depends on BR2_PACKAGE_WINE_ARCH_SUPPORTS
	depends on BR2_STATIC_LIBS
```

## package/batocera/emulators/x16emu/Config.in
```kconfig
config BR2_PACKAGE_X16EMU
    bool "x16emu"
    select BR2_PACKAGE_SDL2
    help
      Emulator for the Commander X16 8-bit computer.
      
      https://github.com/X16Community/x16emu
      https://www.commanderx16.com/
```

## package/batocera/emulators/xemu/Config.in
```kconfig
config BR2_PACKAGE_XEMU
    bool "xemu"
    depends on BR2_TOOLCHAIN_GCC_AT_LEAST_8
    select BR2_PACKAGE_PYTHON3
    select BR2_PACKAGE_BZIP2
    select BR2_PACKAGE_PIXMAN
    select BR2_PACKAGE_ZLIB
    select BR2_PACKAGE_SDL2
    select BR2_PACKAGE_LIBSAMPLERATE
    select BR2_PACKAGE_SLIRP
    select BR2_PACKAGE_LIBGBM
    select BR2_PACKAGE_LIBOPENSSL
    select BR2_PACKAGE_LIBCAP
    select BR2_PACKAGE_GMP
    select BR2_PACKAGE_LIBGTK3
    select BR2_PACKAGE_XLIB_LIBX11
    select BR2_PACKAGE_KEYUTILS
    help
      Xbox (og) emulator based on QEMU

      https://xemu.app/
```

## package/batocera/emulators/xenia-canary/Config.in
```kconfig
config BR2_PACKAGE_XENIA_CANARY
    bool "xenia-canary"
    depends on BR2_x86_64
    select BR2_PACKAGE_WINE_PROTON
    select BR2_PACKAGE_PYTHON_TOML
    help
        Xenia is an open source research project for emulating Xbox 360 games on modern PCs.
        This is the bleeding edge canary release.

        https://xenia.jp/
```

## package/batocera/emulators/xenia-edge/Config.in
```kconfig
config BR2_PACKAGE_XENIA_EDGE
    bool "xenia-edge"
    depends on BR2_x86_64
    select BR2_PACKAGE_SDL2
    select BR2_PACKAGE_VULKAN_HEADERS
    select BR2_PACKAGE_VULKAN_LOADER
    select BR2_PACKAGE_LZ4
    select BR2_PACKAGE_ALSA_LIB
    select BR2_PACKAGE_PYTHON_TOML
    select BR2_PACKAGE_QT6BASE
    help
        Xenia is an open source research project for emulating Xbox 360 games on modern PCs.
        Xenia Edge is the native Linux port, running without Wine using Vulkan for graphics
        and ALSA/SDL for audio.

        https://github.com/has207/xenia-edge
```
