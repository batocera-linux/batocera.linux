## package/batocera/emulators/gametank-emulator/Config.in
```kconfig
config BR2_PACKAGE_GAMETANK_EMULATOR
	bool "gametank-emulator"
	depends on BR2_PACKAGE_SDL2
	depends on BR2_INSTALL_LIBSTDCPP
	help
	  Emulator for the GameTank, an 8-bit homebrew game console
	  built around the 6502.

	  https://github.com/clydeshaffer/GameTankEmulator
	  https://gametank.zone/

comment "gametank-emulator needs SDL2 and a toolchain w/ C++"
	depends on !BR2_PACKAGE_SDL2 || !BR2_INSTALL_LIBSTDCPP
```

## package/batocera/emulators/odin/Config.in
```kconfig
config BR2_PACKAGE_ODIN
    bool "odin"
    depends on BR2_INSTALL_LIBSTDCPP
    depends on (BR2_x86_64 && BR2_PACKAGE_HAS_LIBGL) || \
        (BR2_aarch64 && BR2_PACKAGE_HAS_LIBGLES)
    select BR2_PACKAGE_SDL3
    select BR2_PACKAGE_LIBGLEW if BR2_x86_64
    select BR2_PACKAGE_JANSSON
    select BR2_PACKAGE_XLIB_LIBX11
    select BR2_PACKAGE_VULKAN_HEADERS
    help
      A low-level emulator of the SEGA Hikaru and Gaelco ATV Track
      arcade boards, drawing with OpenGL (ES on aarch64) or Vulkan.

      https://github.com/Tovarichtch/Odin

comment "odin needs a toolchain w/ C++ and OpenGL (ES on aarch64)"
    depends on BR2_aarch64 || BR2_x86_64
    depends on !BR2_INSTALL_LIBSTDCPP || \
        (BR2_x86_64 && !BR2_PACKAGE_HAS_LIBGL) || \
        (BR2_aarch64 && !BR2_PACKAGE_HAS_LIBGLES)
```

## package/batocera/emulators/retroarch/libretro/libretro-anybor/Config.in
```kconfig
config BR2_PACKAGE_LIBRETRO_ANYBOR
    bool "libretro-anybor"
	depends on BR2_INSTALL_LIBSTDCPP
	select BR2_PACKAGE_ZLIB
	select BR2_PACKAGE_LIBPNG
	select BR2_PACKAGE_LIBOGG
	select BR2_PACKAGE_LIBVORBIS
	select BR2_PACKAGE_LIBVPX
	help
	  A libretro openbor emulator

	  http://www.libretro.com

comment "LIBRETRO_ANYBOR needs a toolchain w/ C++"
	depends on !BR2_INSTALL_LIBSTDCPP
```

## package/batocera/emulators/retroarch/libretro/libretro-fbneo-korean/Config.in
```kconfig
config BR2_PACKAGE_LIBRETRO_FBNEO_KOREAN
    bool "libretro-fbneo-korean"
	depends on BR2_INSTALL_LIBSTDCPP
    help
      A libretro FBNeo core built from dsno/Zansword's Korean-patched
      driver fork, for CRC-tolerant Korean-translated arcade ROMs that
      the standard libretro-fbneo core rejects.

	  https://github.com/Pyohwan/FBNeo/tree/korean-patches

comment "LIBRETRO_FBNEO_KOREAN needs a toolchain w/ C++"
	depends on !BR2_INSTALL_LIBSTDCPP
```

## package/batocera/emulators/retroarch/libretro/libretro-fbneo/Config.in
```kconfig
config BR2_PACKAGE_LIBRETRO_FBNEO
    bool "libretro-fbneo"
	depends on BR2_INSTALL_LIBSTDCPP
	select BR2_PACKAGE_BATOCERA_LAUNCH_LIBRETRO_FBNEO
    help
      A libretro fbneo emulator core for ARM.

	  http://www.libretro.com

comment "LIBRETRO_FBNEO needs a toolchain w/ C++"
	depends on !BR2_INSTALL_LIBSTDCPP
```

## package/batocera/emulators/retroarch/libretro/libretro-mame/Config.in
```kconfig
config BR2_PACKAGE_LIBRETRO_MAME
	bool "libretro-mame"
	depends on BR2_INSTALL_LIBSTDCPP
	depends on BR2_PACKAGE_PYTHON_BATOCERA_COMMON
	depends on BR2_PACKAGE_BATOCERA_LAUNCH
	depends on BR2_PACKAGE_BATOCERA_LAUNCH_LIBRETRO
	select BR2_PACKAGE_ALSA_LIB
	select BR2_PACKAGE_BATOCERA_LAUNCH_LIBRETRO_MAME
	help
	  A libretro mame core for Mame.

	  http://www.libretro.com

comment "LIBRETRO_MAME needs a toolchain w/ C++"
	depends on !BR2_INSTALL_LIBSTDCPP
```

## package/batocera/emulators/retroarch/libretro/libretro-same-cdi/Config.in
```kconfig
config BR2_PACKAGE_LIBRETRO_SAME_CDI
	bool "libretro-same-cdi"
	depends on BR2_PACKAGE_PYTHON_BATOCERA_COMMON
	depends on BR2_PACKAGE_BATOCERA_LAUNCH
	depends on BR2_PACKAGE_BATOCERA_LAUNCH_LIBRETRO
	select BR2_PACKAGE_BATOCERA_LAUNCH_LIBRETRO_MAME
	help
	  A libretro CD-i emulator core (branched from MAME)

	  http://www.libretro.com
```

## package/batocera/emulators/retroarch/libretro/libretro-scummvm/Config.in
```kconfig
config BR2_PACKAGE_LIBRETRO_SCUMMVM
    bool "libretro-scummvm"
	depends on BR2_INSTALL_LIBSTDCPP
	select BR2_PACKAGE_BATOCERA_LAUNCH_LIBRETRO_SCUMMVM
    help
      A libretro SCUMMVM emulator core for ARM.

	  http://www.libretro.com

comment "LIBRETRO_SCUMMVM needs a toolchain w/ C++"
	depends on !BR2_INSTALL_LIBSTDCPP
```

## package/batocera/emulators/retroarch/libretro/libretro-vba-m/Config.in
```kconfig
config BR2_PACKAGE_LIBRETRO_VBA_M
    bool "libretro-vba-m"
	depends on BR2_INSTALL_LIBSTDCPP
    select BR2_PACKAGE_ZLIB
    help
      VBA-M

	  http://www.libretro.com

comment "LIBRETRO_VBA_M needs a toolchain w/ C++"
	depends on !BR2_INSTALL_LIBSTDCPP
```

## package/batocera/emulators/retroarch/libretro/libretro-zesarpcw/Config.in
```kconfig
config BR2_PACKAGE_LIBRETRO_ZESARPCW
	bool "libretro-zesarpcw"
	help
	  A libretro Amstrad PCW 8256/8512 emulator core, derived from
	  ZEsarUX. It boots disk images without an external BIOS.

	  https://github.com/retrodiv/ZEsarPCW-libretro
```

## package/batocera/emulators/sm2-emu/Config.in
```kconfig
config BR2_PACKAGE_SM2_EMU
    bool "sm2-emu"
    depends on BR2_INSTALL_LIBSTDCPP
    depends on BR2_PACKAGE_HAS_UDEV
    depends on BR2_PACKAGE_HAS_LIBGL || BR2_PACKAGE_HAS_LIBGLES
    select BR2_PACKAGE_SDL3
    select BR2_PACKAGE_PUGIXML
    select BR2_PACKAGE_MINIZ
    select BR2_PACKAGE_IMGUI
    select BR2_PACKAGE_LIBCURL
    select BR2_PACKAGE_LZMA_SDK
    select BR2_PACKAGE_VULKAN_HEADERS         if BR2_PACKAGE_BATOCERA_VULKAN
    select BR2_PACKAGE_VULKAN_LOADER          if BR2_PACKAGE_BATOCERA_VULKAN
    select BR2_PACKAGE_VULKAN_VALIDATIONLAYERS if BR2_PACKAGE_BATOCERA_VULKAN
    help
      A Sega Model 2 arcade emulator with software, OpenGL and
      optional Vulkan rendering backends.

      https://github.com/dmanlfc/sm2-emu

comment "sm2-emu needs udev /dev management, a toolchain w/ C++ and OpenGL or OpenGL ES"
    depends on !BR2_INSTALL_LIBSTDCPP || !BR2_PACKAGE_HAS_UDEV || \
        (!BR2_PACKAGE_HAS_LIBGL && !BR2_PACKAGE_HAS_LIBGLES)
```

## package/batocera/emulators/vpinball/Config.in
```kconfig
config BR2_PACKAGE_VPINBALL
    bool "vpinball"
    select BR2_PACKAGE_BGFX
    select BR2_PACKAGE_LIBFREEIMAGE
    select BR2_PACKAGE_LIBPINMAME
    select BR2_PACKAGE_LIBALTSOUND
    select BR2_PACKAGE_LIBDMDUTIL
    select BR2_PACKAGE_LIBDOF
    select BR2_PACKAGE_SDL3
    select BR2_PACKAGE_SDL3_IMAGE
    select BR2_PACKAGE_SDL3_TTF
    select BR2_PACKAGE_FFMPEG
    select BR2_PACKAGE_LIBWINEVBS
    select BR2_PACKAGE_OPENXR_SDK
    select BR2_PACKAGE_LIBSPATIALAUDIO
    select BR2_PACKAGE_ZLIB
    select BR2_PACKAGE_VULKAN_HEADERS
    select BR2_PACKAGE_VULKAN_LOADER if BR2_PACKAGE_BATOCERA_VULKAN
    help
      Visual Pinball.
      
      www.vpforums.org
```

## package/batocera/emulators/xemu-chihiro/Config.in
```kconfig
config BR2_PACKAGE_XEMU_CHIHIRO
    bool "xemu-chihiro"
    depends on BR2_TOOLCHAIN_GCC_AT_LEAST_8
    select BR2_PACKAGE_PYTHON3
    select BR2_PACKAGE_BZIP2
    select BR2_PACKAGE_PIXMAN
    select BR2_PACKAGE_ZLIB
    select BR2_PACKAGE_SDL3
    select BR2_PACKAGE_LIBSAMPLERATE
    select BR2_PACKAGE_SLIRP
    select BR2_PACKAGE_LIBGBM
    select BR2_PACKAGE_LIBOPENSSL
    select BR2_PACKAGE_LIBCAP
    select BR2_PACKAGE_GMP
    select BR2_PACKAGE_LIBGTK3
    select BR2_PACKAGE_XLIB_LIBX11
    select BR2_PACKAGE_KEYUTILS
    select BR2_PACKAGE_BATOCERA_LAUNCH_XEMU_CHIHIRO if BR2_PACKAGE_BATOCERA_LAUNCH
    help
      Sega Chihiro emulator, a fork of xemu

      https://github.com/Tovarichtch/xemu
```

## package/batocera/firmwares/firmware-armbian/Config.in
```kconfig
config BR2_PACKAGE_FIRMWARE_ARMBIAN
	bool "firmware-armbian"
	help
	  Armbian firmware repository to support various boards
	  to work correctly with the Linux kernel.

	  https://github.com/armbian/firmware

config BR2_PACKAGE_FIRMWARE_ARMBIAN_FILES
	string "files to install"
	depends on BR2_PACKAGE_FIRMWARE_ARMBIAN
	help
	  Space-separated paths in the repository to install.
	  Leave empty to install the whole repository.
```

## package/batocera/firmwares/firmware-radxa/Config.in
```kconfig
config BR2_PACKAGE_FIRMWARE_RADXA
	bool "firmware-radxa"
	help
	  Radxa specific firmware

	  https://github.com/radxa-pkg/radxa-firmware
```

## package/batocera/firmwares/meson-firmware/Config.in
```kconfig
config BR2_PACKAGE_MESON_FIRMWARE
	bool "meson-firmware"
	help
	  Amlogic video decoder microcode, including the signed S4
	  package and its OP-TEE trusted application.

	  https://github.com/LibreELEC/meson-firmware
```

## package/batocera/gpu/gtk-layer-shell/Config.in
```kconfig
config BR2_PACKAGE_GTK_LAYER_SHELL
	bool "gtk-layer-shell"
	depends on BR2_PACKAGE_LIBGTK3 # select creates a recursive dependancy
	depends on BR2_PACKAGE_WAYLAND
	help
	  A library to create panels and other desktop components 
	  for Wayland using the Layer Shell protocol.

	  https://github.com/wmww/gtk-layer-shell
```

## package/batocera/libraries/appstream/Config.in
```kconfig
config BR2_PACKAGE_APPSTREAM
	bool "appstream"
	depends on BR2_USE_WCHAR # libglib2
	depends on BR2_TOOLCHAIN_HAS_THREADS # libglib2
	depends on BR2_USE_MMU # libglib2
	depends on !BR2_STATIC_LIBS # libxmlb
	select BR2_PACKAGE_LIBCURL
	select BR2_PACKAGE_LIBFYAML
	select BR2_PACKAGE_LIBGLIB2
	select BR2_PACKAGE_LIBXML2
	select BR2_PACKAGE_LIBXMLB
	help
	  Library to read and write AppStream metadata, used by
	  software centres and Flatpak.

	  https://www.freedesktop.org/wiki/Distributions/AppStream/
```

## package/batocera/libraries/asio/Config.in
```kconfig
config BR2_PACKAGE_ASIO
	bool "asio"
	depends on BR2_INSTALL_LIBSTDCPP
	help
	  Asio is a cross-platform C++ library for network and low-level
	  I/O programming that provides developers with a consistent
	  asynchronous model using a modern C++ approach. This is the
	  standalone (non-Boost) header-only variant.

	  https://think-async.com/Asio/

comment "asio needs a toolchain w/ C++"
	depends on !BR2_INSTALL_LIBSTDCPP
```

## package/batocera/libraries/libdovi/Config.in
```kconfig
config BR2_PACKAGE_LIBDOVI
	bool "libdovi"
	depends on BR2_PACKAGE_HOST_RUSTC_TARGET_ARCH_SUPPORTS
	select BR2_PACKAGE_HOST_RUSTC
	help
	  Library to read and write Dolby Vision metadata.

	  https://github.com/quietvoid/dovi_tool/tree/main/dolby_vision
```

## package/batocera/libraries/libfreeimage-vpinball/Config.in
```kconfig
config BR2_PACKAGE_LIBFREEIMAGE_VPINBALL
    bool "libfreeimage-vpinball"
    help
      toxie's FreeImage fork, built static into a private staging
      prefix for Visual Pinball only.

      https://github.com/toxieainc/freeimage
```

## package/batocera/libraries/libfyaml/Config.in
```kconfig
config BR2_PACKAGE_LIBFYAML
	bool "libfyaml"
	depends on BR2_TOOLCHAIN_HAS_THREADS
	help
	  Fully feature complete YAML parser and emitter, supporting
	  the latest YAML spec and passing the full YAML testsuite.

	  https://github.com/pantoniou/libfyaml
```

## package/batocera/libraries/libmysofa/Config.in
```kconfig
config BR2_PACKAGE_LIBMYSOFA
    bool "libmysofa"
    select BR2_PACKAGE_ZLIB
    help
      Reader for AES SOFA (Spatially Oriented Format for Acoustics) files.

      https://github.com/hoene/libmysofa
```

## package/batocera/libraries/libserum/Config.in
```kconfig
config BR2_PACKAGE_LIBSERUM
    bool "libserum"
    select BR2_PACKAGE_LIBFRAMEUTIL 
    help
      Cross platform dynamic library code for Serum file format.
      
      https://github.com/zesinger/libserum
```

## package/batocera/libraries/libspatialaudio/Config.in
```kconfig
config BR2_PACKAGE_LIBSPATIALAUDIO
    bool "libspatialaudio"
    select BR2_PACKAGE_LIBMYSOFA
    help
      Ambisonic encoding, decoding and binaural rendering library.

      https://github.com/videolan/libspatialaudio
```
