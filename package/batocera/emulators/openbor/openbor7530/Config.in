## package/batocera/emulators/openbor/openbor7530/Config.in
```kconfig
config BR2_PACKAGE_OPENBOR7530
    bool "openbor7530"
    select BR2_PACKAGE_LIBVPX
    select BR2_PACKAGE_SDL2
    select BR2_PACKAGE_SDL2_GFX
    select BR2_PACKAGE_LIBPNG
    select BR2_PACKAGE_LIBOGG
    select BR2_PACKAGE_LIBVORBIS
    help
      OpenBOR 4 is the ultimate 2D side scrolling engine for beat em' ups, shooters, and more!

      https://www.chronocrash.com/
```

## package/batocera/emulators/openmsx/Config.in
```kconfig
config BR2_PACKAGE_OPENMSX
    bool "openmsx"
    depends on BR2_x86_64
    depends on BR2_PACKAGE_XORG7
    depends on BR2_PACKAGE_HAS_LIBGL # libglew
    select BR2_PACKAGE_SDL2
    select BR2_PACKAGE_SDL2_TTF
    select BR2_PACKAGE_LIBPNG
    select BR2_PACKAGE_LIBOGG
    select BR2_PACKAGE_LIBVORBIS
    select BR2_PACKAGE_LIBTHEORA
    select BR2_PACKAGE_LIB
    select BR2_PACKAGE_TCL
    select BR2_PACKAGE_ZLIB
    select BR2_PACKAGE_ALSA_LIB
    select BR2_PACKAGE_LIBGLEW
    select BR2_PACKAGE_FREETYPE
    help
      A MSX emulator that aims for perfection.

	    https://github.com/openMSX/openMSX
```

## package/batocera/emulators/openmw/Config.in
```kconfig
# OpenMW and dependencies
source "$BR2_EXTERNAL_BATOCERA_PATH/package/batocera/emulators/openmw/openmw/Config.in"

if BR2_PACKAGE_OPENMW

config BR2_OPENMW_ENABLE_LTO
	bool "compile openmw with LTO"
	default y

source "$BR2_EXTERNAL_BATOCERA_PATH/package/batocera/emulators/openmw/gl4es-openmw/Config.in"
endif
```

## package/batocera/emulators/openmw/gl4es-openmw/Config.in
```kconfig
config BR2_PACKAGE_GL4ES_OPENMW
	# (hidden package) A version of gl4es for the OpenMW Morrowind Engine
	bool

	depends on BR2_PACKAGE_HAS_LIBGLES
	help
	  GL4ES provides OpenGL for GLES Hardware.

	  This version is known to work with OpenMW and is patched to allow gamma adjustement.
	  Based on https://gitlab.com/OpenMW/openmw-android/-/tree/841887fc55bccb75f9de6a968035bbcd8aaca0ac/.

	  https://github.com/ptitSeb/gl4es/
```

## package/batocera/emulators/openmw/openmw/Config.in
```kconfig
config BR2_PACKAGE_OPENMW
	bool "OpenMW Morrowind Engine"
	select BR2_PACKAGE_BOOST
	select BR2_PACKAGE_BOOST_FILESYSTEM
	select BR2_PACKAGE_BOOST_IOSTREAMS
	select BR2_PACKAGE_BOOST_PROGRAM_OPTIONS
	select BR2_PACKAGE_BOOST_SYSTEM
	select BR2_PACKAGE_FFMPEG
	select BR2_PACKAGE_FFMPEG_AVRESAMPLE
	select BR2_PACKAGE_FFMPEG_SWSCALE
	select BR2_PACKAGE_FONTCONFIG
	select BR2_PACKAGE_FREETYPE
	select BR2_PACKAGE_JPEG
	select BR2_PACKAGE_LIBPNG
	select BR2_PACKAGE_LZ4
	select BR2_PACKAGE_OPENAL
	select BR2_PACKAGE_SDL2

	select BR2_PACKAGE_GL4ES_OPENMW if !BR2_PACKAGE_HAS_LIBGL

	depends on BR2_INSTALL_LIBSTDCPP
	depends on BR2_PACKAGE_HAS_LIBGL || BR2_PACKAGE_HAS_LIBGLES
	help
	  OpenMW is an open-source open-world RPG game engine that supports playing Morrowind.

	  https://gitlab.com/OpenMW/openmw
```

## package/batocera/emulators/pcsx2-avx2/Config.in
```kconfig
config BR2_PACKAGE_PCSX2_AVX2
    bool "pcsx2-avx2"
	depends on BR2_x86_64
	depends on BR2_PACKAGE_XORG7
	select BR2_PACKAGE_FMT
	select BR2_PACKAGE_ALSA_LIB
	select BR2_PACKAGE_FREETYPE
	select BR2_PACKAGE_ZLIB
	select BR2_PACKAGE_LIBPNG
	select BR2_PACKAGE_WXWIDGETS
	select BR2_PACKAGE_LIBAIO
	select BR2_PACKAGE_PORTAUDIO
	select BR2_PACKAGE_LIBSOUNDTOUCH
	select BR2_PACKAGE_LIBSAMPLERATE
	select BR2_PACKAGE_SDL2
	select BR2_PACKAGE_DEJAVU
	select BR2_PACKAGE_LIBPCAP
	select BR2_PACKAGE_YAML_CPP
	select BR2_PACKAGE_LIBGTK3
	select BR2_PACKAGE_BATOCERA_VULKAN
    help
        PCSX2 is a free and open-source PlayStation 2 (PS2) emulator.
		This version requires a CPU with AVX2 support.

		https://github.com/PCSX2/pcsx2
```

## package/batocera/emulators/pcsx2-x86/Config.in
```kconfig
config BR2_PACKAGE_PCSX2_X86
    bool "pcsx2-x86"
    help
      pcsx2 precompiled for x86

      https://github.com/batocera-linux/pcsx2-x86
```

## package/batocera/emulators/pcsx2/Config.in
```kconfig
config BR2_PACKAGE_PCSX2
    bool "pcsx2"
    depends on BR2_x86_64
    depends on BR2_PACKAGE_XORG7
    select BR2_PACKAGE_FMT
    select BR2_PACKAGE_ALSA_LIB
    select BR2_PACKAGE_FREETYPE
    select BR2_PACKAGE_ZLIB
    select BR2_PACKAGE_LIBPNG
    select BR2_PACKAGE_LIBAIO
    select BR2_PACKAGE_PORTAUDIO
    select BR2_PACKAGE_LIBSOUNDTOUCH
    select BR2_PACKAGE_LIBSAMPLERATE
    select BR2_PACKAGE_SDL2
    select BR2_PACKAGE_DEJAVU
    select BR2_PACKAGE_LIBPCAP
    select BR2_PACKAGE_YAML_CPP
    select BR2_PACKAGE_LIBGTK3
    select BR2_PACKAGE_VULKAN_HEADERS    if BR2_PACKAGE_BATOCERA_VULKAN
    select BR2_PACKAGE_VULKAN_LOADER     if BR2_PACKAGE_BATOCERA_VULKAN
    select BR2_PACKAGE_BATOCERA_QT6
    select BR2_PACKAGE_WXWIDGETS
    select BR2_PACKAGE_STENZEK_SHADERC
    help
      PCSX2 is a free and open-source PlayStation 2 (PS2) emulator.
      
      https://github.com/PCSX2/pcsx2
```

## package/batocera/emulators/pcsx2x6/Config.in
```kconfig
config BR2_PACKAGE_PCSX2X6
    bool "pcsx2x6"
    depends on BR2_x86_64
    depends on BR2_PACKAGE_XORG7
    select BR2_PACKAGE_ALSA_LIB  
    select BR2_PACKAGE_BATOCERA_QT6  
    select BR2_PACKAGE_BR2_PACKAGE_FMT  
    select BR2_PACKAGE_DEJAVU
    select BR2_PACKAGE_ECM
    select BR2_PACKAGE_FREETYPE
    select BR2_PACKAGE_KDDOCKWIDGETS 
    select BR2_PACKAGE_LIBAIO  
    select BR2_PACKAGE_LIBBACKTRACE  
    select BR2_PACKAGE_LIBCURL  
    select BR2_PACKAGE_LIBGTK3  
    select BR2_PACKAGE_LIBPCAP  
    select BR2_PACKAGE_LIBPNG  
    select BR2_PACKAGE_LIBSAMPLERATE  
    select BR2_PACKAGE_LIBSOUNDTOUCH
    select BR2_PACKAGE_PLUTOSVG
    select BR2_PACKAGE_PORTAUDIO
    select BR2_PACKAGE_RAPIDYAML
    select BR2_PACKAGE_SDL3  
    select BR2_PACKAGE_SHADERC  
    select BR2_PACKAGE_VULKAN_HEADERS    if BR2_PACKAGE_BATOCERA_VULKAN  
    select BR2_PACKAGE_VULKAN_LOADER     if BR2_PACKAGE_BATOCERA_VULKAN  
    select BR2_PACKAGE_WEBP  
    select BR2_PACKAGE_WXWIDGETS  
    select BR2_PACKAGE_YAML_CPP  
    select BR2_PACKAGE_ZLIB
    help
      PCSX2X6 is a fork of PCSX2 to emulate NAMCO System246 and System256 arcade units.
      
      https://github.com/PS2Homebrew-arcade/pcsx2x6
```

## package/batocera/emulators/pifba/Config.in
```kconfig
config BR2_PACKAGE_PIFBA
        bool "Pifba"
	depends on BR2_INSTALL_LIBSTDCPP
	depends on BR2_PACKAGE_SDL2
	depends on BR2_PACKAGE_RPI_USERLAND
	depends on BR2_PACKAGE_ALSA_LIB
        help
          FBA arm optimized

	  https://github.com/batocera-linux/pifba

comment "Pifba needs a toolchain w/ C++, ALSA and SDL2"
	depends on !BR2_INSTALL_LIBSTDCPP || !BR2_PACKAGE_SDL2 || !BR2_PACKAGE_ALSA_LIB
```

## package/batocera/emulators/play/Config.in
```kconfig
config BR2_PACKAGE_PLAY
    bool "play"
    select BR2_PACKAGE_PCRE2
    select BR2_PACKAGE_LIBCURL
    select BR2_PACKAGE_LIBCURL_OPENSSL
    select BR2_PACKAGE_LIBGLEW		               if BR2_PACKAGE_BATOCERA_TARGET_X86_64_ANY
    select BR2_PACKAGE_OPENAL
    select BR2_PACKAGE_BATOCERA_QT6
    select BR2_PACKAGE_SQLITE
    select BR2_PACKAGE_VULKAN_HEADERS	           if BR2_PACKAGE_BATOCERA_VULKAN
    select BR2_PACKAGE_VULKAN_LOADER	           if BR2_PACKAGE_BATOCERA_VULKAN
    select BR2_PACKAGE_ECM

    help
      Play! is a PlayStation2 emulator.

      https://purei.org/
```

## package/batocera/emulators/ppsspp/Config.in
```kconfig
config BR2_PACKAGE_PPSSPP
	bool "ppsspp"
	select BR2_PACKAGE_SDL2
	select BR2_PACKAGE_SDL2_TTF
	select BR2_PACKAGE_LIBZIP
	select BR2_PACKAGE_LIBGLEW if BR2_PACKAGE_BATOCERA_TARGET_X86_ANY
	select BR2_PACKAGE_LIBGLU  if BR2_PACKAGE_BATOCERA_TARGET_X86_ANY
	help
	  A  PSP emulator
```

## package/batocera/emulators/ppsspp15/Config.in
```kconfig
config BR2_PACKAGE_PPSSPP15
	bool "ppsspp15"
	select BR2_PACKAGE_SDL2
	select BR2_PACKAGE_LIBZIP
	select BR2_PACKAGE_FFMPEG_SWSCALE
    help
      A  PSP emulator
```

## package/batocera/emulators/python-pygame2/Config.in
```kconfig
config BR2_PACKAGE_PYTHON_PYGAME2
	bool "python-pygame2"

	select BR2_PACKAGE_SDL2
	select BR2_PACKAGE_SDL2_IMAGE
	select BR2_PACKAGE_SDL2_TTF
	select BR2_PACKAGE_SDL2_MIXER
	select BR2_PACKAGE_LIBPNG
	select BR2_PACKAGE_JPEG
	select BR2_PACKAGE_PYTHON_PSUTIL
	select BR2_PACKAGE_HOST_PYTHON_CYTHON

	help
	  Pygame is a cross-platfrom library designed to make it easy
	  to write multimedia software, such as games, in
	  Python. Pygame requires the Python language and SDL
	  multimedia library.
	  It can also make use of several other popular libraries.

	  http://www.pygame.org/
```

## package/batocera/emulators/python-pyxel/Config.in
```kconfig
config BR2_PACKAGE_PYTHON_PYXEL
	bool "python-pyxel"

    depends on BR2_PACKAGE_HOST_RUSTC_TARGET_ARCH_SUPPORTS
        select BR2_PACKAGE_HOST_RUSTC

	select BR2_PACKAGE_SDL2
	select BR2_PACKAGE_HOST_PYTHON_MATURIN

	help
	  Pyxel is a retro game engine for Python.
	  Inspired by other fantasy consoles like PICO-8 and TIC-80,
	  it displays 16 colors, 4 sounds and is coded in Python
	  
	  https://github.com/kitao/pyxel
```

## package/batocera/emulators/raine/Config.in
```kconfig
config BR2_PACKAGE_RAINE
	bool "raine"
        depends on BR2_INSTALL_LIBSTDCPP
        select BR2_PACKAGE_SDL2
        select BR2_PACKAGE_SDL2_NET
        select BR2_PACKAGE_SDL2_IMAGE
        select BR2_PACKAGE_SDL2_TTF
        select BR2_PACKAGE_MUPARSER

	help
	  A multiple arcade emulator focused on 680x0/z80 machines like
          NeoCD and Neo Geo, C version

	  https://github.com/zelurker/raine
```

## package/batocera/emulators/redream/Config.in
```kconfig
config BR2_PACKAGE_REDREAM
    bool "redream"
    help
      Redream is a Dreamcast Emulator for Windows / Mac & Linux.

      https://redream.io
```

## package/batocera/emulators/reicast/Config.in
```kconfig
config BR2_PACKAGE_REICAST
        bool "reicast"
        depends on BR2_PACKAGE_SDL2
        depends on BR2_PACKAGE_LIBPNG
        depends on BR2_GCC_ENABLE_OPENMP
        help
          A  Dreamcast emulator
```

## package/batocera/emulators/retroarch/batocera-retroachievements-sounds/Config.in
```kconfig
config BR2_PACKAGE_BATOCERA_RETROACHIEVEMENTS_SOUNDS
        bool "batocera retroachievements sounds"
        help
          Play a sound when a retroachievement is unlocked
```

## package/batocera/emulators/retroarch/batocera-shaders/Config.in
```kconfig
config BR2_PACKAGE_BATOCERA_SHADERS
        bool "batocera shaders"
	depends on BR2_PACKAGE_RETROARCH
        help
          Batocera shaders for retroarch
```

## package/batocera/emulators/retroarch/libretro/libretro-2048/Config.in
```kconfig
config BR2_PACKAGE_LIBRETRO_2048
	bool "libretro-2048"
	depends on BR2_PACKAGE_RETROARCH
	depends on BR2_INSTALL_LIBSTDCPP
	help
	  A libretro port of 2048, a game.

	  http://www.libretro.com

comment "LIBRETRO_2048 needs a toolchain w/ C++"
	depends on !BR2_INSTALL_LIBSTDCPP
```

## package/batocera/emulators/retroarch/libretro/libretro-a5200/Config.in
```kconfig
config BR2_PACKAGE_LIBRETRO_A5200
        bool "libretro-a5200"
	depends on BR2_PACKAGE_RETROARCH
	depends on BR2_INSTALL_LIBSTDCPP
        help
          A libretro ATARI5200 emulator core.

	  http://www.libretro.com

comment "LIBRETRO_A5200 needs a toolchain w/ C++"
	depends on !BR2_INSTALL_LIBSTDCPP
```

## package/batocera/emulators/retroarch/libretro/libretro-arduous/Config.in
```kconfig
config BR2_PACKAGE_LIBRETRO_ARDUOUS
    bool "libretro-arduous"
    help
      A libretro Arduboy core.

      http://www.libretro.com
```

## package/batocera/emulators/retroarch/libretro/libretro-atari800/Config.in
```kconfig
config BR2_PACKAGE_LIBRETRO_ATARI800
    bool "libretro-atari800"
	depends on BR2_INSTALL_LIBSTDCPP
    help
      A libretro ATARI800 E ATARI5200 emulator core.

	  http://www.libretro.com

comment "LIBRETRO_ATARI800 needs a toolchain w/ C++"
	depends on !BR2_INSTALL_LIBSTDCPP
```
