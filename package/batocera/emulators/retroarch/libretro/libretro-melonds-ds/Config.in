## package/batocera/emulators/retroarch/libretro/libretro-melonds-ds/Config.in
```kconfig
config BR2_PACKAGE_LIBRETRO_MELONDS_DS
    bool "libretro-melonds-ds"
	depends on BR2_INSTALL_LIBSTDCPP
	select BR2_PACKAGE_LIBPCAP
    help
      A remake of the libretro melonDS core that prioritizes standalone parity, reliability, and usability.
	  
	  http://www.libretro.com

comment "BR2_PACKAGE_LIBRETRO_MELONDS_DS needs a toolchain w/ C++"
	depends on !BR2_INSTALL_LIBSTDCPP
```

## package/batocera/emulators/retroarch/libretro/libretro-melonds/Config.in
```kconfig
config BR2_PACKAGE_LIBRETRO_MELONDS
        bool "libretro-melonds"
	depends on BR2_PACKAGE_RETROARCH
	depends on BR2_INSTALL_LIBSTDCPP
	select BR2_PACKAGE_LIBPCAP
        help
          A libretro nintendo ds emulator core.

	  http://www.libretro.com

comment "LIBRETRO_MELONDS needs a toolchain w/ C++"
	depends on !BR2_INSTALL_LIBSTDCPP
```

## package/batocera/emulators/retroarch/libretro/libretro-mesen-s/Config.in
```kconfig
config BR2_PACKAGE_LIBRETRO_MESEN_S
        bool "libretro-mesen-s"
	depends on BR2_PACKAGE_RETROARCH
	depends on BR2_INSTALL_LIBSTDCPP
        help
          Mesen-S

	  http://www.libretro.com

comment "LIBRETRO_MESEN_S needs a toolchain w/ C++"
	depends on !BR2_INSTALL_LIBSTDCPP
```

## package/batocera/emulators/retroarch/libretro/libretro-mesen/Config.in
```kconfig
config BR2_PACKAGE_LIBRETRO_MESEN
    bool "libretro-mesen"
    help
      A libretro NES/Famicom emulator core.
        
      http://www.libretro.com
```

## package/batocera/emulators/retroarch/libretro/libretro-mesens/Config.in
```kconfig
config BR2_PACKAGE_LIBRETRO_MESENS
    bool "libretro-mesens"
    help
      A libretro SNES/Game Boy/Super Game Boy emulator core.

      http://www.libretro.com
```

## package/batocera/emulators/retroarch/libretro/libretro-mgba/Config.in
```kconfig
config BR2_PACKAGE_LIBRETRO_MGBA
        bool "libretro-mgba"
	depends on BR2_PACKAGE_RETROARCH
	depends on BR2_INSTALL_LIBSTDCPP
	select BR2_PACKAGE_LIBZIP
	select BR2_PACKAGE_LIBPNG
	select BR2_PACKAGE_ZLIB
        help
          A libretro GBA emulator core for ARM.

	  http://www.libretro.com

comment "LIBRETRO_MGBA needs a toolchain w/ C++"
	depends on !BR2_INSTALL_LIBSTDCPP
```

## package/batocera/emulators/retroarch/libretro/libretro-minivmac/Config.in
```kconfig
config BR2_PACKAGE_LIBRETRO_MINIVMAC
    bool "libretro-minivmac"
    help
      MiniVMac emulator for 68k Macintosh
```

## package/batocera/emulators/retroarch/libretro/libretro-mrboom/Config.in
```kconfig
config BR2_PACKAGE_LIBRETRO_MRBOOM
        bool "libretro-mrboom"
	depends on BR2_PACKAGE_RETROARCH
	depends on BR2_INSTALL_LIBSTDCPP
        help
          A libretro mrboom core for ARM.

	  http://www.libretro.com

comment "LIBRETRO_MRBOOM needs a toolchain w/ C++"
	depends on !BR2_INSTALL_LIBSTDCPP
```

## package/batocera/emulators/retroarch/libretro/libretro-mupen64plus-next/Config.in
```kconfig
config BR2_PACKAGE_LIBRETRO_MUPEN64PLUS_NEXT
	bool "libretro-mupen64plus-next"
	depends on BR2_PACKAGE_RETROARCH
	depends on (BR2_PACKAGE_HAS_LIBGLES  && !BR2_PACKAGE_BATOCERA_TARGET_X86_64_ANY) || \
		   (BR2_PACKAGE_HAS_LIBGL && BR2_PACKAGE_BATOCERA_TARGET_X86_64_ANY)
	  help
	    Improved mupen64plus libretro core reimplementation

		https://github.com/libretro/mupen64plus-libretro-nx/tree/master
```

## package/batocera/emulators/retroarch/libretro/libretro-neocd/Config.in
```kconfig
config BR2_PACKAGE_LIBRETRO_NEOCD
        bool "libretro-neocd"
	depends on BR2_PACKAGE_RETROARCH
	depends on BR2_INSTALL_LIBSTDCPP
        help
          Neo Geo CD emulator for libretro

	  http://www.libretro.com

comment "LIBRETRO_NEOCD needs a toolchain w/ C++"
	depends on !BR2_INSTALL_LIBSTDCPP
```

## package/batocera/emulators/retroarch/libretro/libretro-openlara/Config.in
```kconfig
config BR2_PACKAGE_LIBRETRO_OPENLARA
    bool "libretro-openlara"
    depends on BR2_PACKAGE_RETROARCH
    depends on BR2_INSTALL_LIBSTDCPP
    help
      A libretro core using the classic Tomb Raider open-source engine.
      
      https://github.com/libretro/OpenLara

comment "LIBRETRO_OPENLARA needs a toolchain w/ C++"
	depends on !BR2_INSTALL_LIBSTDCPP
```

## package/batocera/emulators/retroarch/libretro/libretro-opera/Config.in
```kconfig
config BR2_PACKAGE_LIBRETRO_OPERA
        bool "libretro-opera"
	depends on BR2_PACKAGE_RETROARCH
	depends on BR2_INSTALL_LIBSTDCPP
        help
          Port of 4DO/libfreedo to libretro.

	  http://www.libretro.com

comment "LIBRETRO_OPERA needs a toolchain w/ C++"
	depends on !BR2_INSTALL_LIBSTDCPP
```

## package/batocera/emulators/retroarch/libretro/libretro-parallel-n64/Config.in
```kconfig
config BR2_PACKAGE_LIBRETRO_PARALLEL_N64
    bool "libretro-parallel-n64"
    depends on BR2_PACKAGE_RETROARCH
    depends on BR2_INSTALL_LIBSTDCPP
    help
      Optimized/rewritten Nintendo 64 emulator made specifically for Libretro.
      Originally based on Mupen64 Plus.

comment "LIBRETRO_PARALLEL_N64 needs a toolchain w/ C++"
       depends on !BR2_INSTALL_LIBSTDCPP
```

## package/batocera/emulators/retroarch/libretro/libretro-pc88/Config.in
```kconfig
config BR2_PACKAGE_LIBRETRO_PC88
    bool "libretro-pc88"
	depends on BR2_PACKAGE_RETROARCH
	depends on BR2_INSTALL_LIBSTDCPP
        
		help
          A port of QUASI88, a PC-8800 series emulator by Showzoh Fukunaga, to the libretro API.

	  http://www.libretro.com

comment "LIBRETRO_PC88 needs a toolchain w/ C++"
	depends on !BR2_INSTALL_LIBSTDCPP
```

## package/batocera/emulators/retroarch/libretro/libretro-pc98/Config.in
```kconfig
config BR2_PACKAGE_LIBRETRO_PC98
    bool "libretro-pc98"
	depends on BR2_PACKAGE_RETROARCH
	depends on BR2_INSTALL_LIBSTDCPP
        
		help
          Libretro core for NEC - PC-98 (Neko Project II Kai).

	  http://www.libretro.com

comment "LIBRETRO_PC98 needs a toolchain w/ C++"
	depends on !BR2_INSTALL_LIBSTDCPP
```

## package/batocera/emulators/retroarch/libretro/libretro-pcsx2/Config.in
```kconfig
config BR2_PACKAGE_LIBRETRO_PCSX2
    bool "libretro-pcsx2"
	depends on BR2_INSTALL_LIBSTDCPP
	select BR2_PACKAGE_LIBAIO
	select BR2_PACKAGE_XZ
    help
      A libretro core for PS2

	  http://www.libretro.com

comment "LIBRETRO_PCSX2 needs a toolchain w/ C++"
	depends on !BR2_INSTALL_LIBSTDCPP
```

## package/batocera/emulators/retroarch/libretro/libretro-pd777/Config.in
```kconfig
config BR2_PACKAGE_LIBRETRO_PD777
	bool "libretro-pd777"
	depends on BR2_INSTALL_LIBSTDCPP
	help
	  PD777 is an Epoch Cassette Vision emulator.

	  http://www.libretro.com

comment "LIBRETRO_PD777 needs a toolchain w/ C++"
	depends on !BR2_INSTALL_LIBSTDCPP
```

## package/batocera/emulators/retroarch/libretro/libretro-picodrive/Config.in
```kconfig
config BR2_PACKAGE_LIBRETRO_PICODRIVE
        bool "libretro-picodrive"
	depends on BR2_PACKAGE_RETROARCH
	depends on BR2_INSTALL_LIBSTDCPP
	select BR2_PACKAGE_LIBPNG
        help
          A libretro Megadrive SMS emulator core for ARM.

	  http://www.libretro.com

comment "Picodrive needs a toolchain w/ C++"
	depends on !BR2_INSTALL_LIBSTDCPP && !BR2_PACKAGE_LIBPNG
```

## package/batocera/emulators/retroarch/libretro/libretro-play/Config.in
```kconfig
config BR2_PACKAGE_LIBRETRO_PLAY
    bool "libretro-play"
    select BR2_PACKAGE_LIBGLEW              if BR2_PACKAGE_BATOCERA_TARGET_X86_64_ANY
    select BR2_PACKAGE_VULKAN_HEADERS       if BR2_PACKAGE_BATOCERA_VULKAN
    select BR2_PACKAGE_VULKAN_LOADER        if BR2_PACKAGE_BATOCERA_VULKAN

      help
        Play! - PlayStation2 Emulator

        https://purei.org/
```

## package/batocera/emulators/retroarch/libretro/libretro-pokemini/Config.in
```kconfig
config BR2_PACKAGE_LIBRETRO_POKEMINI
        bool "libretro-pokemini"
	depends on BR2_PACKAGE_RETROARCH
	depends on BR2_INSTALL_LIBSTDCPP
        help
          A libretro PokeMini emulator core.

	  http://www.libretro.com

comment "LIBRETRO_POKEMINI needs a toolchain w/ C++"
	depends on !BR2_INSTALL_LIBSTDCPP
```

## package/batocera/emulators/retroarch/libretro/libretro-ppsspp/Config.in
```kconfig
config BR2_PACKAGE_LIBRETRO_PPSSPP
	bool "libretro-ppsspp"
	depends on BR2_PACKAGE_RETROARCH
	depends on BR2_INSTALL_LIBSTDCPP
	select BR2_PACKAGE_LIBZIP
	select BR2_PACKAGE_FFMPEG
	select BR2_PACKAGE_FFMPEG_SWSCALE
	select BR2_PACKAGE_FFMPEG_AVRESAMPLE
	help
	  A libretro PSP core

	  http`://www.libretro.com

comment "LIBRETRO_PPSSPP needs a toolchain w/ C++"
	depends on !BR2_INSTALL_LIBSTDCPP
```

## package/batocera/emulators/retroarch/libretro/libretro-ps2/Config.in
```kconfig
config BR2_PACKAGE_LIBRETRO_PS2
    bool "libretro-ps2"
	depends on BR2_PACKAGE_RETROARCH
	depends on BR2_INSTALL_LIBSTDCPP
	select BR2_PACKAGE_LIBAIO
	select BR2_PACKAGE_XZ
    help
      A libretro core for PS2

	  http://www.libretro.com

comment "LIBRETRO_PS2 needs a toolchain w/ C++"
	depends on !BR2_INSTALL_LIBSTDCPP
```

## package/batocera/emulators/retroarch/libretro/libretro-puae/Config.in
```kconfig
config BR2_PACKAGE_LIBRETRO_PUAE
        bool "libretro-puae"
	depends on BR2_PACKAGE_RETROARCH
	depends on BR2_INSTALL_LIBSTDCPP
        help
          A libretro AMIGA emulator core for ARM.

	  http://www.libretro.com

comment "LIBRETRO_PUAE needs a toolchain w/ C++"
	depends on !BR2_INSTALL_LIBSTDCPP
```

## package/batocera/emulators/retroarch/libretro/libretro-puae2021/Config.in
```kconfig
config BR2_PACKAGE_LIBRETRO_PUAE2021
    bool "libretro-puae2021"
    depends on BR2_PACKAGE_RETROARCH
    depends on BR2_INSTALL_LIBSTDCPP
      help
        2021 libretro AMIGA emulator core for ARM.
        
        http://www.libretro.com
        https://github.com/libretro/libretro-uae/tree/2.6.1

comment "LIBRETRO_PUAE needs a toolchain w/ C++"
	depends on !BR2_INSTALL_LIBSTDCPP
```

## package/batocera/emulators/retroarch/libretro/libretro-redream/Config.in
```kconfig
config BR2_PACKAGE_LIBRETRO_REDREAM
        bool "libretro-redream"
	depends on BR2_PACKAGE_RETROARCH
	depends on BR2_INSTALL_LIBSTDCPP
        help
          A libretro dreamcast emulator core.

	  http://www.libretro.com

comment "LIBRETRO_REDREAM needs a toolchain w/ C++"
	depends on !BR2_INSTALL_LIBSTDCPP
```
