## package/batocera/emulators/retroarch/libretro/libretro-xrick/Config.in
```kconfig
config BR2_PACKAGE_LIBRETRO_XRICK
	bool "libretro-xrick"
	depends on BR2_INSTALL_LIBSTDCPP
	help
	  A libretro clone of Rick Dangerous.
	  
	  http://www.libretro.com

comment "LIBRETRO_XRICK needs a toolchain w/ C++"
	depends on !BR2_INSTALL_LIBSTDCPP
```

## package/batocera/emulators/retroarch/libretro/libretro-yabasanshiro/Config.in
```kconfig
config BR2_PACKAGE_LIBRETRO_YABASANSHIRO
    bool "libretro-yabasanshiro"
	depends on BR2_PACKAGE_RETROARCH
	depends on BR2_INSTALL_LIBSTDCPP
	select BR2_PACKAGE_LIBGLVND	if BR2_PACKAGE_XORG7
      help
        A libretro YABASANSHIRO emulator core.

	  http://www.libretro.com

comment "LIBRETRO_YABASANSHIRO needs a toolchain w/ C++"
	depends on !BR2_INSTALL_LIBSTDCPP
```

## package/batocera/emulators/retroarch/libretro/libretro-zepto8/Config.in
```kconfig
config BR2_PACKAGE_LIBRETRO_ZEPTO8
        bool "libretro-zepto8"
	depends on BR2_PACKAGE_RETROARCH
	depends on BR2_INSTALL_LIBSTDCPP
        help
          A libretro Pico-8 engine

comment "LIBRETRO_ZEPTO8 needs a toolchain w/ C++"
	depends on !BR2_INSTALL_LIBSTDCPP
```

## package/batocera/emulators/retroarch/retroarch-assets/Config.in
```kconfig
config BR2_PACKAGE_RETROARCH_ASSETS
        bool "retroarch-assets"
	
        help
          RetroArch assets. Background and icon themes for the menu drivers.

	  http://www.libretro.com
```

## package/batocera/emulators/retroarch/retroarch/Config.in
```kconfig
config BR2_PACKAGE_RETROARCH
    bool "Retroarch"
	depends on (BR2_PACKAGE_HAS_LIBGLES || BR2_PACKAGE_HAS_LIBEGL || BR2_PACKAGE_HAS_LIBGL)
	select dejavu
	select BR2_PACKAGE_RETROARCH_ASSETS
	select BR2_PACKAGE_LIBRETRO_CORE_INFO
	select BR2_PACKAGE_FLAC
	select BR2_PACKAGE_SLANG_SHADERS if BR2_PACKAGE_VULKAN_LOADER && BR2_PACKAGE_VULKAN_HEADERS
	select BR2_PACKAGE_NOTO_CJK_FONTS
    help
      A multi emulator frontend.
	  
	  http://www.libretro.com

comment "Retroarch depends on EGL or OpenGLES"
	depends on !(BR2_PACKAGE_HAS_LIBEGL || BR2_PACKAGE_HAS_LIBGLES || BR2_PACKAGE_HAS_LIBGL)
```

## package/batocera/emulators/retroarch/shaders/batocera-shaders/Config.in
```kconfig
config BR2_PACKAGE_BATOCERA_SHADERS
    bool "batocera shaders"
    select BR2_PACKAGE_COMMON_SHADERS
    select BR2_PACKAGE_GLSL_SHADERS
    select BR2_PACKAGE_SLANG_SHADERS
    help
      Batocera shaders for retroarch
```

## package/batocera/emulators/retroarch/shaders/common-shaders/Config.in
```kconfig
config BR2_PACKAGE_COMMON_SHADERS
    bool "common-shaders"
    help
      Common CG shaders for RetroArch.
      
      http://www.libretro.com
```

## package/batocera/emulators/retroarch/shaders/glsl-shaders/Config.in
```kconfig
config BR2_PACKAGE_GLSL_SHADERS
    bool "glsl-shaders"
    help
      Common GSLS shaders for RetroArch.

      http://www.libretro.com
```

## package/batocera/emulators/retroarch/shaders/hsm-shaders/Config.in
```kconfig
config BR2_PACKAGE_HSM_SHADERS
        bool "hsm-shaders"
	depends on BR2_PACKAGE_RETROARCH
        help
          HyperspaceMadness' Mega Bezel (reflective) shader pack

	  http://www.libretro.com
```

## package/batocera/emulators/retroarch/shaders/slang-shaders/Config.in
```kconfig
config BR2_PACKAGE_SLANG_SHADERS
    bool "slang-shaders"
    help
      Common Slang shaders for RetroArch.

      http://www.libretro.com
```

## package/batocera/emulators/rpcs3/Config.in
```kconfig
config BR2_PACKAGE_RPCS3
    bool "rpcs3"
    select BR2_HOST_CMAKE_AT_LEAST_3_24
    select BR2_PACKAGE_ALSA_LIB
    select BR2_PACKAGE_BATOCERA_QT6
    select BR2_PACKAGE_FAUDIO
    select BR2_PACKAGE_FFMPEG_SWSCALE
    select BR2_PACKAGE_FLATBUFFERS
    select BR2_PACKAGE_LIBEVDEV
    select BR2_PACKAGE_LIBGLEW
    select BR2_PACKAGE_LIBGLU
    select BR2_PACKAGE_LIBUSB
    select BR2_PACKAGE_LIBXML2
    select BR2_PACKAGE_LLVM
    select BR2_PACKAGE_MESA3D
    select BR2_PACKAGE_NCURSES
    select BR2_PACKAGE_OPENAL
    select BR2_PACKAGE_OPENCV4
    select BR2_PACKAGE_OPENCV4_LIB_PHOTO
    select BR2_PACKAGE_RTMPDUMP
    select BR2_PACKAGE_SDL3
    select BR2_PACKAGE_WOLFSSL
    select BR2_PACKAGE_WOLFSSL_ALL
    help
      RPCS3 is a multi-platform open-source Sony PlayStation 3 emulator.

      https://rpcs3.net/
```

## package/batocera/emulators/ruffle/Config.in
```kconfig
config BR2_PACKAGE_RUFFLE
	bool "ruffle"
	depends on BR2_PACKAGE_HOST_RUSTC_TARGET_ARCH_SUPPORTS
	depends on BR2_PACKAGE_HAS_UDEV
	select BR2_PACKAGE_HOST_RUSTC
	select BR2_PACKAGE_OPENSSL
	select BR2_PACKAGE_NGHTTP2
	select BR2_PACKAGE_ALSA_LIB
	help
	  ruffle is a Flash Player emulator built in the Rust programming language.

	  https://ruffle.rs/
```

## package/batocera/emulators/ryujinx/Config.in
```kconfig
config BR2_PACKAGE_RYUJINX
    bool "ryujinx"
    depends on BR2_x86_64
    depends on BR2_PACKAGE_XORG7
    select BR2_PACKAGE_SDL2
    select BR2_PACKAGE_OPENAL
    select BR2_PACKAGE_HICOLOR_ICON_THEME
    select BR2_PACKAGE_ADWAITA_ICON_THEME
    select BR2_PACKAGE_LIBRSVG
    help
      Ryujinx is an open-source Nintendo Switch emulator created by gdkchan and written in C sharp.

	    https://ryujinx.org
```

## package/batocera/emulators/scummvm/Config.in
```kconfig
config BR2_PACKAGE_SCUMMVM
        bool "Scummvm"
	depends on BR2_INSTALL_LIBSTDCPP
	select BR2_PACKAGE_SDL2
	select BR2_PACKAGE_LIBMPEG2
	select BR2_PACKAGE_JPEG
	select BR2_PACKAGE_LIBOGG
        select BR2_PACKAGE_LIBVORBIS
        select BR2_PACKAGE_FLAC
        select BR2_PACKAGE_LIBMAD
        select BR2_PACKAGE_LIBPNG
        select BR2_PACKAGE_LIBTHEORA
        select BR2_PACKAGE_FAAD2
        select BR2_PACKAGE_FREETYPE
	select BR2_PACKAGE_ZLIB  
	depends on BR2_PACKAGE_FLUIDSYNTH

        help
		ScummVM point and click 
		http://wiki.scummvm.org/

comment "Scummvm  needs a toolchain w/ C++,  SDL2"
	depends on !BR2_INSTALL_LIBSTDCPP || !BR2_PACKAGE_SDL2
```

## package/batocera/emulators/sdlpop/Config.in
```kconfig
config BR2_PACKAGE_SDLPOP
	bool "sdlpop"
	depends on BR2_INSTALL_LIBSTDCPP
	select BR2_PACKAGE_SDL2
	select BR2_PACKAGE_SDL2_IMAGE
	help
	  SDLPoP
	  An open-source port of Prince of Persia, based on the disassembly of the DOS version.

	  https://github.com/NagyD/SDLPoP
```

## package/batocera/emulators/shadps4-qtlauncher/Config.in
```kconfig
config BR2_PACKAGE_SHADPS4_QTLAUNCHER
    bool "shadps4-qtlauncher"
    select BR2_PACKAGE_BATOCERA_QT6
    select BR2_PACKAGE_OPENSSL
    select BR2_PACKAGE_QT6WAYLAND    if BR2_PACKAGE_BATOCERA_WAYLAND
    select BR2_PACKAGE_SDL3
    select BR2_PACKAGE_VULKAN_HEADERS
    help
      QT6 launcher for shadPS4.

      https://github.com/shadps4-emu/shadps4-qtlauncher
```

## package/batocera/emulators/shadps4/Config.in
```kconfig
config BR2_PACKAGE_SHADPS4
    bool "shadps4"
    depends on BR2_TOOLCHAIN_GCC_AT_LEAST_8
    select BR2_HOST_CMAKE_AT_LEAST_3_24
    select BR2_PACKAGE_ALSA_LIB
    select BR2_PACKAGE_PULSEAUDIO
    select BR2_PACKAGE_OPENAL
    select BR2_PACKAGE_OPENSSL
    select BR2_PACKAGE_LIBZLIB
    select BR2_PACKAGE_LIBEDIT
    select BR2_PACKAGE_UDEV
    select BR2_PACKAGE_LIBEVDEV
    select BR2_PACKAGE_JACK2
    select BR2_PACKAGE_QT6BASE
    select BR2_PACKAGE_QT6SVG
    select BR2_PACKAGE_QT6TOOLS
    select BR2_PACKAGE_QT6MULTIMEDIA
    select BR2_PACKAGE_VULKAN_HEADERS
    select BR2_PACKAGE_VULKAN_LOADER
    select BR2_PACKAGE_VULKAN_VALIDATIONLAYERS
    help
      Sony Playstation 4 emulator.

      https://github.com/shadps4-emu/shadPS4
      https://shadps4.net/
```

## package/batocera/emulators/simcoupe/Config.in
```kconfig
config BR2_PACKAGE_SIMCOUPE
	bool "simcoupe"
	depends on BR2_INSTALL_LIBSTDCPP
	select BR2_PACKAGE_SDL2
	help
	  SimCoupe emulates the SAM Coupe - a Britsh Z80-based home computer released in 1989 by Miles Gordon Technology.

	  https://github.com/simonowen/simcoupe

comment "SIMCOUPE needs a toolchain w/ C++"
	depends on !BR2_INSTALL_LIBSTDCPP
```

## package/batocera/emulators/snes9x/Config.in
```kconfig
config BR2_PACKAGE_SNES9X
	bool "snes9x"
	select BR2_PACKAGE_BATOCERA_QT6
	select BR2_PACKAGE_SDL2		if BR2_x86_64

	help
	  Snes9x - Portable Super Nintendo Entertainment System (TM) emulator

	  https://github.com/snes9xgit/snes9x/
```

## package/batocera/emulators/soniccd/Config.in
```kconfig
config BR2_PACKAGE_SONICCD
	bool "soniccd"
		select BR2_PACKAGE_SDL2
		select BR2_PACKAGE_SDL2_NET
		select BR2_PACKAGE_SDL2_MIXER
		select BR2_PACKAGE_LIBOGG
		select BR2_PACKAGE_LIBVORBIS
		select BR2_PACKAGE_LIBGBM
		select BR2_PACKAGE_LIBDRM
		select BR2_PACKAGE_LIBTHEORA
    
    help
      The Sonic CD 2011 decompilation is for the Android, iOS, & Steam ports of Sonic 1 and 2

	    https://github.com/Rubberduckycooly/Sonic-CD-11-Decompilation
```

## package/batocera/emulators/sugarbox/Config.in
```kconfig
config BR2_PACKAGE_SUGARBOX
	bool "sugarbox"

	select BR2_PACKAGE_BATOCERA_QT6                      

	help
	  SugarBox - Amstrad CPC emulator
	  https://github.com/Tom1975/SugarboxV2
```

## package/batocera/emulators/supermodel-RPi4/Config.in
```kconfig
config BR2_PACKAGE_SUPERMODEL_RPI4
        bool "supermodel-RPi4"
        depends on BR2_PACKAGE_XORG7
        select BR2_PACKAGE_SDL2
        select BR2_PACKAGE_SDL2_NET
        select BR2_PACKAGE_ZLIB
        select BR2_PACKAGE_LIBZIP

        help
          Supermodel is a SEGA Model 3 emulator that uses the SDL-Library.

	  http://www.supermodel3.com
	  source: https://sourceforge.net/p/model3emu/

comment "SUPERMODEL needs a toolchain w/ C++"
  depends on !BR2_PACKAGE_XORG7
```

## package/batocera/emulators/supermodel-es/Config.in
```kconfig
config BR2_PACKAGE_SUPERMODEL_ES
    bool "supermodel-es"
    depends on BR2_INSTALL_LIBSTDCPP
    depends on BR2_PACKAGE_HAS_LIBGLES
    select BR2_PACKAGE_SDL2
    select BR2_PACKAGE_SDL2_NET
    select BR2_PACKAGE_ZLIB
    select BR2_PACKAGE_LIBZIP
    help
        Supermodel-ES fork is a SEGA Model 3 emulator that uses the SDL-Library targeting OpenGL ES 3.2 devices.
        
        http://www.supermodel3.com
        source: https://github.com/rtissera/Supermodel-es

comment "SUPERMODEL-ES needs a toolchain w/ C++"
	depends on !BR2_INSTALL_LIBSTDCPP || !BR2_PACKAGE_HAS_LIBGLES
```

## package/batocera/emulators/supermodel/Config.in
```kconfig
config BR2_PACKAGE_SUPERMODEL
    bool "supermodel"
    depends on BR2_INSTALL_LIBSTDCPP
    depends on BR2_PACKAGE_XORG7 # libglew
    depends on BR2_PACKAGE_HAS_LIBGL # libglew
    select BR2_PACKAGE_SDL2
    select BR2_PACKAGE_SDL2_NET
    select BR2_PACKAGE_ZLIB
    select BR2_PACKAGE_LIBGLEW
    select BR2_PACKAGE_LIBZIP
    help
        Supermodel is a SEGA Model 3 emulator that uses the SDL-Library.
        
        http://www.supermodel3.com
        source: https://github.com/trzy/Supermodel

comment "SUPERMODEL needs a toolchain w/ C++"
    depends on BR2_PACKAGE_XORG7
	depends on !BR2_INSTALL_LIBSTDCPP || !BR2_PACKAGE_HAS_LIBGL
```
