## package/batocera/emulators/retroarch/libretro/libretro-azahar/Config.in
```kconfig
config BR2_PACKAGE_LIBRETRO_AZAHAR
    bool "libretro-azahar"            
    select BR2_PACKAGE_BOOST
    select BR2_PACKAGE_BOOST_SERIALIZATION
    select BR2_PACKAGE_BOOST_IOSTREAMS
    select BR2_PACKAGE_BOOST_REGEX
    select BR2_PACKAGE_BOOST_LOCALE
    select BR2_PACKAGE_BOOST_MATH
    select BR2_PACKAGE_BOOST_CONTAINER
    select BR2_PACKAGE_FDK_AAC
    select BR2_PACKAGE_FFMPEG  
    select BR2_PACKAGE_FMT
    help
      Azahar is a Citra fork and emulator for the Nintendo 3DS.
      
      https://github.com/azahar-emu/azahar
```

## package/batocera/emulators/retroarch/libretro/libretro-beetle-lynx/Config.in
```kconfig
config BR2_PACKAGE_LIBRETRO_BEETLE_LYNX
    bool "libretro-beetle-lynx"
	depends on BR2_PACKAGE_RETROARCH
	depends on BR2_INSTALL_LIBSTDCPP
    help
      A libretro Lynx emulator core for ARM.

	  http://www.libretro.com

comment "LIBRETRO_BEETLE_LYNX needs a toolchain w/ C++"
	depends on !BR2_INSTALL_LIBSTDCPP
```

## package/batocera/emulators/retroarch/libretro/libretro-beetle-pce-fast/Config.in
```kconfig
config BR2_PACKAGE_LIBRETRO_BEETLE_PCE_FAST
        bool "libretro-beetle-pce-fast"
        depends on BR2_PACKAGE_RETROARCH
        depends on BR2_INSTALL_LIBSTDCPP
        help
          A libretro PCE-FAST emulator core for ARM.

          http://www.libretro.com

comment "LIBRETRO_BEETLE_PCE_FAST needs a toolchain w/ C++"
        depends on !BR2_INSTALL_LIBSTDCPP
```

## package/batocera/emulators/retroarch/libretro/libretro-beetle-pce/Config.in
```kconfig
config BR2_PACKAGE_LIBRETRO_BEETLE_PCE
        bool "libretro-beetle-pce"
	depends on BR2_PACKAGE_RETROARCH
	depends on BR2_INSTALL_LIBSTDCPP
        help
          A libretro PCE accurate emulator core.

	  http://www.libretro.com

comment "LIBRETRO_BEETLE_PCE needs a toolchain w/ C++"
	depends on !BR2_INSTALL_LIBSTDCPP
```

## package/batocera/emulators/retroarch/libretro/libretro-beetle-psx/Config.in
```kconfig
config BR2_PACKAGE_LIBRETRO_BEETLE_PSX
    bool "libretro-beetle-psx"
	depends on BR2_INSTALL_LIBSTDCPP
	select BR2_PACKAGE_LIBGLVND if BR2_PACKAGE_XORG7
    help
      A libretro psx emulator core.

	  http://www.libretro.com

comment "LIBRETRO_BEETLE_PSX needs a toolchain w/ C++"
	depends on !BR2_INSTALL_LIBSTDCPP
```

## package/batocera/emulators/retroarch/libretro/libretro-beetle-wswan/Config.in
```kconfig
config BR2_PACKAGE_LIBRETRO_BEETLE_WSWAN
    bool "libretro-beetle-wswan"
	depends on BR2_PACKAGE_RETROARCH
	depends on BR2_INSTALL_LIBSTDCPP
	select BR2_PACKAGE_LIBPNG
    help
      A libretro Wonderswan emulator core for ARM.

	  http://www.libretro.com

comment "LIBRETRO_LIBRETRO_BEETLE_WSWAN needs a toolchain w/ C++"
	depends on !BR2_INSTALL_LIBSTDCPP
```

## package/batocera/emulators/retroarch/libretro/libretro-bennugd/Config.in
```kconfig
config BR2_PACKAGE_LIBRETRO_BENNUGD
    bool "libretro-bennugd"
    help
      A libretro core for BennuGD development engine games.

      https://github.com/diekleinekuh/BennuGD_libretro
```

## package/batocera/emulators/retroarch/libretro/libretro-bk/Config.in
```kconfig
config BR2_PACKAGE_LIBRETRO_BK
    bool "libretro-bk"
    depends on BR2_INSTALL_LIBSTDCPP
    help
      A libretro core for BK-0010/0011/Terak 8510a emulation.

      https://github.com/libretro/bk-emulator

comment "LIBRETRO_BK needs a toolchain w/ C++"
    depends on !BR2_INSTALL_LIBSTDCPP
```

## package/batocera/emulators/retroarch/libretro/libretro-blastem/Config.in
```kconfig
config BR2_PACKAGE_LIBRETRO_BLASTEM
        bool "libretro-blastem"
	depends on BR2_PACKAGE_RETROARCH
	depends on BR2_INSTALL_LIBSTDCPP
        help
          A libretro SEGA 16 bits emulator core for x86.

	  http://www.libretro.com

comment "LIBRETRO_BLASTEM needs a toolchain w/ C++"
	depends on !BR2_INSTALL_LIBSTDCPP
```

## package/batocera/emulators/retroarch/libretro/libretro-boom3/Config.in
```kconfig
config BR2_PACKAGE_LIBRETRO_BOOM3
    bool "libretro-boom3"
    depends on BR2_PACKAGE_RETROARCH
    depends on BR2_INSTALL_LIBSTDCPP
    select BR2_PACKAGE_LIBCURL
    select BR2_PACKAGE_LIBJPEG
    select BR2_PACKAGE_LIBOGG
    select BR2_PACKAGE_LIBVORBIS
    select BR2_PACKAGE_OPENAL
    select BR2_PACKAGE_SDL2
    select BR2_PACKAGE_ZLIB
    help
      boom3 is a Doom 3 GPL source port.
      
      https://github.com/libretro/boom3

comment "BR2_PACKAGE_LIBRETRO_BOOM3 needs a toolchain w/ C++"
	depends on !BR2_INSTALL_LIBSTDCPP
```

## package/batocera/emulators/retroarch/libretro/libretro-bsnes-hd/Config.in
```kconfig
config BR2_PACKAGE_LIBRETRO_BSNES_HD
    bool "libretro-bsnes-hd"
	depends on BR2_INSTALL_LIBSTDCPP
	depends on BR2_GCC_ENABLE_OPENMP
      help
        A libretro SNES emulator core.

	  http://www.libretro.com

comment "LIBRETRO_BSNES_HD needs a toolchain w/ C++"
	depends on !BR2_INSTALL_LIBSTDCPP
```

## package/batocera/emulators/retroarch/libretro/libretro-chailove/Config.in
```kconfig
config BR2_PACKAGE_LIBRETRO_CHAILOVE
	bool "libretro-chailove"
	depends on BR2_PACKAGE_RETROARCH
	depends on BR2_INSTALL_LIBSTDCPP
	help
	  ChaiLove is an awesome framework you can use to make 2D games in ChaiScript.
	  
	  http://www.libretro.com

comment "LIBRETRO_CHAILOVE needs a toolchain w/ C++"
	depends on !BR2_INSTALL_LIBSTDCPP
```

## package/batocera/emulators/retroarch/libretro/libretro-citra/Config.in
```kconfig
config BR2_PACKAGE_LIBRETRO_CITRA
        bool "libretro-citra"
        depends on BR2_PACKAGE_RETROARCH
        depends on BR2_INSTALL_LIBSTDCPP
        select BR2_PACKAGE_FMT
        select BR2_PACKAGE_BOOST
        help
          A libretro Citra core for Nintendo 3DS.

	  http://www.libretro.com

comment "LIBRETRO_CITRA needs a toolchain w/ C++"
	depends on !BR2_INSTALL_LIBSTDCPP
```

## package/batocera/emulators/retroarch/libretro/libretro-craft/Config.in
```kconfig
config BR2_PACKAGE_LIBRETRO_CRAFT
	bool "libretro-craft"
	depends on BR2_PACKAGE_RETROARCH
	depends on BR2_INSTALL_LIBSTDCPP
	  help
	    A simple Minecraft clone written in C
	    using modern OpenGL (shaders).
		
		http://www.libretro.com

comment "LIBRETRO_CRAFT needs a toolchain w/ C++"
	depends on !BR2_INSTALL_LIBSTDCPP
```

## package/batocera/emulators/retroarch/libretro/libretro-daphne/Config.in
```kconfig
config BR2_PACKAGE_LIBRETRO_DAPHNE
        bool "libretro-daphne"
	depends on BR2_PACKAGE_RETROARCH
	depends on BR2_INSTALL_LIBSTDCPP
	depends on BR2_PACKAGE_BATOCERA_ES_SYSTEM
        help
          Daphne

	  http://www.libretro.com

comment "LIBRETRO_DAPHNE needs a toolchain w/ C++"
	depends on !BR2_INSTALL_LIBSTDCPP
```

## package/batocera/emulators/retroarch/libretro/libretro-desmume/Config.in
```kconfig
config BR2_PACKAGE_LIBRETRO_DESMUME
    bool "libretro-desmume"
	depends on BR2_INSTALL_LIBSTDCPP
	select BR2_PACKAGE_LIBPCAP
    help
      A libretro Nintendo DS emulator core.

	  http://www.libretro.com

comment "LIBRETRO_DESMUME needs a toolchain w/ C++"
	depends on !BR2_INSTALL_LIBSTDCPP
```

## package/batocera/emulators/retroarch/libretro/libretro-dice/Config.in
```kconfig
config BR2_PACKAGE_LIBRETRO_DICE
    bool "libretro-dice"
	depends on BR2_PACKAGE_RETROARCH
	depends on BR2_INSTALL_LIBSTDCPP
    help
      DICE is a Discrete Integrated Circuit Emulator for games without any type of CPU.

	  http://www.libretro.com

comment "LIBRETRO_DICE needs a toolchain w/ C++"
	depends on !BR2_INSTALL_LIBSTDCPP
```

## package/batocera/emulators/retroarch/libretro/libretro-dinothawr/Config.in
```kconfig
config BR2_PACKAGE_LIBRETRO_DINOTHAWR
	bool "libretro-dinothawr"
	depends on BR2_INSTALL_LIBSTDCPP
	help
	  A libretro block pushing puzzle game.

	  http://www.libretro.com

comment "LIBRETRO_DINOTHAWR needs a toolchain w/ C++"
	depends on !BR2_INSTALL_LIBSTDCPP
```

## package/batocera/emulators/retroarch/libretro/libretro-dolphin/Config.in
```kconfig
config BR2_PACKAGE_LIBRETRO_DOLPHIN
    bool "libretro-dolphin"
	depends on BR2_PACKAGE_RETROARCH
    depends on BR2_PACKAGE_HAS_UDEV
    help
      A libretro core for GameCube / Wii emulation.

	  http://www.libretro.com
	  https://github.com/libretro/dolphin
```

## package/batocera/emulators/retroarch/libretro/libretro-dosbox-pure/Config.in
```kconfig
config BR2_PACKAGE_LIBRETRO_DOSBOX_PURE
        bool "libretro-dosbox-pure"
	depends on BR2_PACKAGE_RETROARCH
	depends on BR2_INSTALL_LIBSTDCPP
        help
          A libretro DOS emulator core.

	  http://www.libretro.com

comment "LIBRETRO_DOSBOX_PURE needs a toolchain w/ C++"
	depends on !BR2_INSTALL_LIBSTDCPP
```

## package/batocera/emulators/retroarch/libretro/libretro-dosbox/Config.in
```kconfig
config BR2_PACKAGE_LIBRETRO_DOSBOX
        bool "libretro-dosbox"
	depends on BR2_PACKAGE_RETROARCH
	depends on BR2_INSTALL_LIBSTDCPP
        help
          A libretro DOS emulator core.

	  http://www.libretro.com

comment "LIBRETRO_DOSBOX needs a toolchain w/ C++"
	depends on !BR2_INSTALL_LIBSTDCPP
```

## package/batocera/emulators/retroarch/libretro/libretro-duckstation/Config.in
```kconfig
config BR2_PACKAGE_LIBRETRO_DUCKSTATION
    bool "libretro-duckstation"
    depends on BR2_PACKAGE_RETROARCH
    help
      LR-Duckstation - PlayStation1 PSX Emulator

	    https://github.com/stenzek/duckstation#libretro-core
	    binaries from https://www.duckstation.org/libretro/ as they can't be build from GitHub
```

## package/batocera/emulators/retroarch/libretro/libretro-ecwolf/Config.in
```kconfig
config BR2_PACKAGE_LIBRETRO_ECWOLF
    bool "libretro-ecwolf"
	depends on BR2_PACKAGE_RETROARCH
	depends on BR2_INSTALL_LIBSTDCPP
      help
        ECWolf is a port of the Wolfenstein 3D engine based of Wolf4SDL.

	  http://www.libretro.com

comment "LIBRETRO_ECWOLF needs a toolchain w/ C++"
	depends on !BR2_INSTALL_LIBSTDCPP
```

## package/batocera/emulators/retroarch/libretro/libretro-emuscv/Config.in
```kconfig
config BR2_PACKAGE_LIBRETRO_EMUSCV
    bool "libretro-emuscv"
    depends on BR2_PACKAGE_RETROARCH
    depends on BR2_INSTALL_LIBSTDCPP
    select SDL2
    help
      A libretro EPOCH/YENO Super Cassette Vision emulator core.

	  http://www.libretro.com

comment "LIBRETRO_EMUSCV needs a toolchain w/ C++"
	depends on !BR2_INSTALL_LIBSTDCPP
```

## package/batocera/emulators/retroarch/libretro/libretro-ep128emu-core/Config.in
```kconfig
config BR2_PACKAGE_LIBRETRO_EP128EMU_CORE
	bool "libretro-ep128emu-core"
	depends on BR2_PACKAGE_RETROARCH
	help
	  Enterprise 128 emulator (ep128emu) libretro core.
```
