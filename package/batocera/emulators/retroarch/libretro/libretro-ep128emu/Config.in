## package/batocera/emulators/retroarch/libretro/libretro-ep128emu/Config.in
```kconfig
config BR2_PACKAGE_LIBRETRO_EP128EMU
    bool "libretro-ep128emu"
	depends on BR2_INSTALL_LIBSTDCPP
    help
      A libretro Enterprise 64/128 emulator core.

	  http://www.libretro.com

comment "LIBRETRO_EP128EMU needs a toolchain w/ C++"
	depends on !BR2_INSTALL_LIBSTDCPP
```

## package/batocera/emulators/retroarch/libretro/libretro-fake08/Config.in
```kconfig
config BR2_PACKAGE_LIBRETRO_FAKE08
    bool "libretro-fake08"
    depends on BR2_PACKAGE_RETROARCH
    depends on BR2_INSTALL_LIBSTDCPP
      help
        A more accurate libretro Pico-8 engine

comment "LIBRETRO_FAKE08 needs a toolchain w/ C++"
	depends on !BR2_INSTALL_LIBSTDCPP
```

## package/batocera/emulators/retroarch/libretro/libretro-fbalpha/Config.in
```kconfig
config BR2_PACKAGE_LIBRETRO_FBALPHA
    bool "libretro-fbalpha"
	depends on BR2_INSTALL_LIBSTDCPP
    help
      A libretro fbalpha emulator core for ARM.

	  http://www.libretro.com

comment "LIBRETRO_FBALPHA needs a toolchain w/ C++"
	depends on !BR2_INSTALL_LIBSTDCPP
```

## package/batocera/emulators/retroarch/libretro/libretro-flycast-wince/Config.in
```kconfig
config BR2_PACKAGE_LIBRETRO_FLYCAST_WINCE
        bool "libretro-flycast-wince"
	depends on BR2_PACKAGE_RETROARCH
	depends on BR2_INSTALL_LIBSTDCPP
        help
          A libretro dreamcast emulator core.

	  http://www.libretro.com

comment "LIBRETRO_FLYCAST_WINCE needs a toolchain w/ C++"
	depends on !BR2_INSTALL_LIBSTDCPP
```

## package/batocera/emulators/retroarch/libretro/libretro-flycast/Config.in
```kconfig
config BR2_PACKAGE_LIBRETRO_FLYCAST
        bool "libretro-flycast"
	depends on BR2_PACKAGE_RETROARCH
	depends on BR2_INSTALL_LIBSTDCPP
	depends on BR2_GCC_ENABLE_OPENMP
	depends on (BR2_PACKAGE_HAS_LIBGLES || BR2_PACKAGE_HAS_LIBGL)
        help
          A libretro dreamcast emulator core.

	  http://www.libretro.com

comment "LIBRETRO_FLYCAST needs a toolchain w/ C++ and OpenGL ES or OpenGL"
	depends on !BR2_INSTALL_LIBSTDCPP || \
		(!BR2_PACKAGE_HAS_LIBGLES && !BR2_PACKAGE_HAS_LIBGL)
```

## package/batocera/emulators/retroarch/libretro/libretro-flycastv1-1/Config.in
```kconfig
config BR2_PACKAGE_LIBRETRO_FLYCASTV1_1
        bool "libretro-flycastv1-1"
	depends on BR2_PACKAGE_RETROARCH
	depends on BR2_INSTALL_LIBSTDCPP
	depends on BR2_GCC_ENABLE_OPENMP
        help
          A libretro dreamcast emulator core.

	  http://www.libretro.com

comment "LIBRETRO_FLYCAST needs a toolchain w/ C++"
	depends on !BR2_INSTALL_LIBSTDCPP
```

## package/batocera/emulators/retroarch/libretro/libretro-flycastvl/Config.in
```kconfig
config BR2_PACKAGE_LIBRETRO_FLYCASTVL
        bool "libretro-flycastvl"
	depends on BR2_PACKAGE_RETROARCH
	depends on BR2_INSTALL_LIBSTDCPP
	depends on BR2_GCC_ENABLE_OPENMP
	select BR2_PACKAGE_GL4ES
        help
          A libretro dreamcast emulator core.

	  http://www.libretro.com

comment "LIBRETRO_FLYCAST needs a toolchain w/ C++"
	depends on !BR2_INSTALL_LIBSTDCPP
```

## package/batocera/emulators/retroarch/libretro/libretro-fmsx/Config.in
```kconfig
config BR2_PACKAGE_LIBRETRO_FMSX
        bool "libretro-fmsx"
	depends on BR2_PACKAGE_RETROARCH
	depends on BR2_INSTALL_LIBSTDCPP
        help
          A libretro MSX emulator core.

	  http://www.libretro.com

comment "LIBRETRO_FMSX needs a toolchain w/ C++"
	depends on !BR2_INSTALL_LIBSTDCPP
```

## package/batocera/emulators/retroarch/libretro/libretro-freechaf/Config.in
```kconfig
config BR2_PACKAGE_LIBRETRO_FREECHAF
    bool "libretro-freechaf"
    help
      A libretro Fairchild ChannelF emulator.
```

## package/batocera/emulators/retroarch/libretro/libretro-freej2me/Config.in
```kconfig
config BR2_PACKAGE_LIBRETRO_FREEJ2ME
		bool "libretro-freej2me"
	depends on BR2_PACKAGE_RETROARCH
	depends on BR2_INSTALL_LIBSTDCPP
		help
          A free J2ME emulator.

	  http://libretro.com

comment "LIBRETRO_FREEJ2ME needs a toolchain w/ C++"
	depends on !BR2_INSTALL_LIBSTDCPP
```

## package/batocera/emulators/retroarch/libretro/libretro-gearcoleco/Config.in
```kconfig
config BR2_PACKAGE_LIBRETRO_GEARCOLECO
    bool "libretro-gearcoleco"
	depends on BR2_INSTALL_LIBSTDCPP
    help
      A libretro Gearcoleco emulator core.

	  https://github.com/drhelius/Gearcoleco

comment "LIBRETRO_GEARCOLECO needs a toolchain w/ C++"
	depends on !BR2_INSTALL_LIBSTDCPP
```

## package/batocera/emulators/retroarch/libretro/libretro-gearsystem/Config.in
```kconfig
config BR2_PACKAGE_LIBRETRO_GEARSYSTEM
    bool "libretro-gearsystem"
	depends on BR2_PACKAGE_RETROARCH
	depends on BR2_INSTALL_LIBSTDCPP

      help
        Gearsystem is a very accurate, cross-platform
        Sega Master System / Game Gear / SG-1000 / Othello Multivision
        emulator ritten in C++ that runs on Windows, macOS, Linux,
        BSD, iOS, Raspberry Pi and RetroArch.

	  https://github.com/drhelius/Gearsystem

comment "LIBRETRO_GEARSYSTEM needs a toolchain w/ C++"
	depends on !BR2_INSTALL_LIBSTDCPP
```

## package/batocera/emulators/retroarch/libretro/libretro-genesisplusgx-expanded/Config.in
```kconfig
config BR2_PACKAGE_LIBRETRO_GENESISPLUSGX_EXPANDED
    bool "libretro-genesisplusgx-expanded"
	depends on BR2_INSTALL_LIBSTDCPP
    help
      A libretro SEGA 8 / 16 bits emulator core with expanded rom support.

	  http://www.libretro.com

comment "LIBRETRO_GENESISPLUSGX needs a toolchain w/ C++"
	depends on !BR2_INSTALL_LIBSTDCPP
```

## package/batocera/emulators/retroarch/libretro/libretro-genesisplusgx-wide/Config.in
```kconfig
config BR2_PACKAGE_LIBRETRO_GENESISPLUSGX_WIDE
    bool "libretro-genesisplusgx-wide"
	depends on BR2_INSTALL_LIBSTDCPP
    help
      A libretro SEGA 8 / 16 bits emulator core for ARM.

	  http://www.libretro.com

comment "LIBRETRO_GENESISPLUSGX_WIDE needs a toolchain w/ C++"
	depends on !BR2_INSTALL_LIBSTDCPP
```

## package/batocera/emulators/retroarch/libretro/libretro-gong/Config.in
```kconfig
config BR2_PACKAGE_LIBRETRO_GONG
    bool "libretro-gong"
	depends on BR2_PACKAGE_RETROARCH
	depends on BR2_INSTALL_LIBSTDCPP
      help
        A libretro clone of pong.

	  http://www.libretro.com

comment "LIBRETRO_GONG needs a toolchain w/ C++"
	depends on !BR2_INSTALL_LIBSTDCPP
```

## package/batocera/emulators/retroarch/libretro/libretro-gp32emu/Config.in
```kconfig
config BR2_PACKAGE_LIBRETRO_GP32EMU
	bool "libretro-gp32emu"
	help
	  A libretro GamePark GP32 emulator core.

	  https://github.com/gameblabla/gp32emu
```

## package/batocera/emulators/retroarch/libretro/libretro-handy/Config.in
```kconfig
config BR2_PACKAGE_LIBRETRO_HANDY
        bool "libretro-handy"
	depends on BR2_PACKAGE_RETROARCH
	depends on BR2_INSTALL_LIBSTDCPP
        help
          A libretro Lynx emulator core for ARM.

	  http://www.libretro.com

comment "LIBRETRO_HANDY needs a toolchain w/ C++"
	depends on !BR2_INSTALL_LIBSTDCPP
```

## package/batocera/emulators/retroarch/libretro/libretro-hatari/Config.in
```kconfig
config BR2_PACKAGE_LIBRETRO_HATARI
	bool "libretro-hatari"
	depends on BR2_PACKAGE_RETROARCH
	depends on BR2_INSTALL_LIBSTDCPP
	select BR2_PACKAGE_LIBCAPSIMAGE
	select BR2_PACKAGE_ZLIB
	  help
	    A libretro Atari ST emulator core.
		
		http://www.libretro.com

comment "LIBRETRO_HATARI needs a toolchain w/ C++"
	depends on !BR2_INSTALL_LIBSTDCPP
```

## package/batocera/emulators/retroarch/libretro/libretro-hatarib/Config.in
```kconfig
config BR2_PACKAGE_LIBRETRO_HATARIB
	bool "libretro-hatarib"
	depends on BR2_PACKAGE_RETROARCH
	depends on BR2_INSTALL_LIBSTDCPP
	select BR2_PACKAGE_LIBCAPSIMAGE
	select BR2_PACKAGE_LIBPNG
	select BR2_PACKAGE_SDL2
	select BR2_PACKAGE_ZLIB
	help
	  A libretro core for Hatari emulation of Atari ST STE TT Falcon.

	  https://github.com/bbbradsmith/hatariB

comment "LIBRETRO_HATARIB needs a toolchain w/ C++"
	depends on !BR2_INSTALL_LIBSTDCPP
```

## package/batocera/emulators/retroarch/libretro/libretro-hbmame/Config.in
```kconfig
config BR2_PACKAGE_LIBRETRO_HBMAME
        bool "libretro-hbmame"
	depends on BR2_PACKAGE_RETROARCH
	depends on BR2_INSTALL_LIBSTDCPP
        help
          A libretro HBMame core.

	  http://www.libretro.com

comment "LIBRETRO_HBMAME needs a toolchain w/ C++"
	depends on !BR2_INSTALL_LIBSTDCPP
```

## package/batocera/emulators/retroarch/libretro/libretro-holani/Config.in
```kconfig
config BR2_PACKAGE_LIBRETRO_HOLANI
	bool "libretro-holani"
	depends on BR2_PACKAGE_RETROARCH
	depends on BR2_PACKAGE_HOST_RUSTC_TARGET_ARCH_SUPPORTS
	select BR2_PACKAGE_HOST_RUSTC
	help
	A cycle-stepped libretro Lynx emulator core.

	https://docs.libretro.com/library/holani/
```

## package/batocera/emulators/retroarch/libretro/libretro-kronos/Config.in
```kconfig
config BR2_PACKAGE_LIBRETRO_KRONOS
	bool "libretro-kronos"
	depends on BR2_INSTALL_LIBSTDCPP
	select BR2_PACKAGE_MESA3D
    help
      A libretro saturn emulator core.
	  
	  http://www.libretro.com

comment "LIBRETRO_KRONOS needs a toolchain w/ C++"
	depends on !BR2_INSTALL_LIBSTDCPP
```

## package/batocera/emulators/retroarch/libretro/libretro-lowresnx/Config.in
```kconfig
config BR2_PACKAGE_LIBRETRO_LOWRESNX
  bool "libretro-lowresnx"
	help
    lowresnx fantasy console for retroarch

	  http://www.libretro.com
```

## package/batocera/emulators/retroarch/libretro/libretro-mame2010/Config.in
```kconfig
config BR2_PACKAGE_LIBRETRO_MAME2010
    bool "libretro-mame2010"
	depends on BR2_PACKAGE_RETROARCH
	depends on BR2_INSTALL_LIBSTDCPP
	select BR2_PACKAGE_ZLIB
      help
        A libretro mame2010 core for ARM.

	  http://www.libretro.com

comment "LIBRETRO_MAME2010 needs a toolchain w/ C++"
	depends on !BR2_INSTALL_LIBSTDCPP
```

## package/batocera/emulators/retroarch/libretro/libretro-mame2016/Config.in
```kconfig
config BR2_PACKAGE_LIBRETRO_MAME2016
        bool "libretro-mame2016"
	depends on BR2_PACKAGE_RETROARCH
	depends on BR2_INSTALL_LIBSTDCPP
        help
          A libretro mame2016 core for Mame.

	  http://www.libretro.com

comment "LIBRETRO_MAME2016 needs a toolchain w/ C++"
	depends on !BR2_INSTALL_LIBSTDCPP
```
