## package/batocera/emulators/retroarch/libretro/libretro-reicast-wince/Config.in
```kconfig
config BR2_PACKAGE_LIBRETRO_REICAST_WINCE
        bool "libretro-reicast-wince"
	depends on BR2_PACKAGE_RETROARCH
	depends on BR2_INSTALL_LIBSTDCPP
        help
          A libretro dreamcast emulator core.

	  http://www.libretro.com

comment "LIBRETRO_REICAST_WINCE needs a toolchain w/ C++"
	depends on !BR2_INSTALL_LIBSTDCPP
```

## package/batocera/emulators/retroarch/libretro/libretro-reminiscence/Config.in
```kconfig
config BR2_PACKAGE_LIBRETRO_REMINISCENCE
	bool "libretro-reminiscence"
	depends on BR2_INSTALL_LIBSTDCPP
	help
	  A libretro Flashback engine reimplementation.
	  
	  http://www.libretro.com

comment "LIBRETRO_REMINISCENCE needs a toolchain w/ C++"
	depends on !BR2_INSTALL_LIBSTDCPP
```

## package/batocera/emulators/retroarch/libretro/libretro-retro8/Config.in
```kconfig
config BR2_PACKAGE_LIBRETRO_RETRO8
        bool "libretro-retro8"
	depends on BR2_PACKAGE_RETROARCH
	depends on BR2_INSTALL_LIBSTDCPP
        help
          A libretro Pico-8 engine

comment "LIBRETRO_RETRO8 needs a toolchain w/ C++"
	depends on !BR2_INSTALL_LIBSTDCPP
```

## package/batocera/emulators/retroarch/libretro/libretro-sameduck/Config.in
```kconfig
config BR2_PACKAGE_LIBRETRO_SAMEDUCK
	bool "libretro-sameduck"
	depends on BR2_INSTALL_LIBSTDCPP
	help
	  A libretro Mega Duck / Cougar Boy core.

	  http://www.libretro.com

comment "LIBRETRO_SAMEDUCK needs a toolchain w/ C++"
	depends on !BR2_INSTALL_LIBSTDCPP
```

## package/batocera/emulators/retroarch/libretro/libretro-smsplus-gx/Config.in
```kconfig
config BR2_PACKAGE_LIBRETRO_SMSPLUS_GX
    bool "libretro-smsplus-gx"
	depends on BR2_INSTALL_LIBSTDCPP
    help
      Improved port of SMSPlus-GX by gameblabla for libretro.

	  http://www.libretro.com

comment "LIBRETRO_SMSPLUS_GX needs a toolchain w/ C++"
	depends on !BR2_INSTALL_LIBSTDCPP
```

## package/batocera/emulators/retroarch/libretro/libretro-snes9x/Config.in
```kconfig
config BR2_PACKAGE_LIBRETRO_SNES9X
    bool "libretro-snes9x"
	depends on BR2_PACKAGE_RETROARCH
	depends on BR2_INSTALL_LIBSTDCPP
	select BR2_PACKAGE_ZLIB
      help
        Snes9x - Portable Super Nintendo Entertainment System (TM) emulator http://www.snes9x.com

	  http://www.libretro.com

comment "LIBRETRO_SNES9X needs a toolchain w/ C++"
	depends on !BR2_INSTALL_LIBSTDCPP
```

## package/batocera/emulators/retroarch/libretro/libretro-squirreljme/Config.in
```kconfig
config BR2_PACKAGE_LIBRETRO_SQUIRRELJME
		bool "libretro-squirreljme"
	depends on BR2_PACKAGE_RETROARCH
	depends on BR2_INSTALL_LIBSTDCPP
		help
          SquirrelJME is a Java ME 8 Virtual Machine for embedded and IoT devices. It has the ultimate goal of being 99.9% compatible with the Java ME standard.

	  http://squirreljme.cc

comment "LIBRETRO_SQUIRRELJME needs a toolchain w/ C++"
	depends on !BR2_INSTALL_LIBSTDCPP
```

## package/batocera/emulators/retroarch/libretro/libretro-stella2014/Config.in
```kconfig
config BR2_PACKAGE_LIBRETRO_STELLA2014
    bool "libretro-stella2014"
	depends on BR2_INSTALL_LIBSTDCPP
    help
      A libretro Atari 2600 emulator core for ARM.

	  http://www.libretro.com

comment "LIBRETRO_STELLA needs a toolchain w/ C++"
	depends on !BR2_INSTALL_LIBSTDCPP
```

## package/batocera/emulators/retroarch/libretro/libretro-superbroswar/Config.in
```kconfig
config BR2_PACKAGE_LIBRETRO_SUPERBROSWAR
    bool "libretro-superbroswar"
    help
      Libretro port of SuperMarioWar
```

## package/batocera/emulators/retroarch/libretro/libretro-superflappybirds/Config.in
```kconfig
config BR2_PACKAGE_LIBRETRO_SUPERFLAPPYBIRDS
	bool "libretro-superflappybirds"
	depends on BR2_INSTALL_LIBSTDCPP
	help
	  A multiplayer Flappy Bird clone designed for the libretro framework.
	  
	  https://github.com/IgniparousTempest/libretro-superflappybirds

comment "LIBRETRO_SUPERFLAPPYBIRDS needs a toolchain w/ C++"
	depends on !BR2_INSTALL_LIBSTDCPP
```

## package/batocera/emulators/retroarch/libretro/libretro-swanstation/Config.in
```kconfig
config BR2_PACKAGE_LIBRETRO_SWANSTATION
    bool "libretro-swanstation"
    depends on BR2_PACKAGE_RETROARCH
    depends on BR2_INSTALL_LIBSTDCPP
    depends on BR2_GCC_ENABLE_OPENMP
    select BR2_PACKAGE_FMT
    select BR2_PACKAGE_BOOST
    select BR2_PACKAGE_FFMPEG  
      help
        SwanStation - PlayStation 1, aka. PSX Emulator

	    https://github.com/libretro/swanstation
```

## package/batocera/emulators/retroarch/libretro/libretro-theodore/Config.in
```kconfig
config BR2_PACKAGE_LIBRETRO_THEODORE
    bool "libretro-theodore"
	depends on BR2_PACKAGE_RETROARCH
	depends on BR2_INSTALL_LIBSTDCPP
        
		help
          Libretro core for Thomson MO/TO emulation.

	  http://www.libretro.com

comment "LIBRETRO_THEODORE needs a toolchain w/ C++"
	depends on !BR2_INSTALL_LIBSTDCPP
```

## package/batocera/emulators/retroarch/libretro/libretro-tic80/Config.in
```kconfig
config BR2_PACKAGE_LIBRETRO_TIC80
    bool "libretro-tic80"
    depends on BR2_PACKAGE_RETROARCH
    depends on BR2_INSTALL_LIBSTDCPP
    select BR2_PACKAGE_JANET
    help
      A libretro TIC-80 engine

comment "LIBRETRO_TIC80 needs a toolchain w/ C++"
	depends on !BR2_INSTALL_LIBSTDCPP
```

## package/batocera/emulators/retroarch/libretro/libretro-tyrquake/Config.in
```kconfig
config BR2_PACKAGE_LIBRETRO_TYRQUAKE
        bool "libretro-tyrquake"
	depends on BR2_PACKAGE_RETROARCH
	depends on BR2_INSTALL_LIBSTDCPP
        help
          A libretro Quake1 engine

	  http://www.libretro.com

comment "LIBRETRO_TYRQUAKE needs a toolchain w/ C++"
	depends on !BR2_INSTALL_LIBSTDCPP
```

## package/batocera/emulators/retroarch/libretro/libretro-uae4arm/Config.in
```kconfig
config BR2_PACKAGE_LIBRETRO_UAE4ARM
        bool "libretro-uae4arm"
	depends on BR2_PACKAGE_RETROARCH
	select BR2_PACKAGE_ZLIB
	select BR2_PACKAGE_FLAC
	select BR2_PACKAGE_MPG123
        help
          A libretro AMIGA emulator core optimized for ARM.

	  http://www.libretro.com

comment "LIBRETRO_UAE4ARM needs a toolchain w/ C++"
	depends on !BR2_INSTALL_LIBSTDCPP
```

## package/batocera/emulators/retroarch/libretro/libretro-uzem/Config.in
```kconfig
config BR2_PACKAGE_LIBRETRO_UZEM
    bool "libretro-uzem"
	depends on BR2_PACKAGE_RETROARCH
	depends on BR2_INSTALL_LIBSTDCPP
      help
        A libretro Uzebox emulator

	  https://docs.libretro.com/library/uzem/

comment "LIBRETRO_UZEM needs a toolchain w/ C++"
	depends on !BR2_INSTALL_LIBSTDCPP
```

## package/batocera/emulators/retroarch/libretro/libretro-vemulator/Config.in
```kconfig
config BR2_PACKAGE_LIBRETRO_VEMULATOR
    bool "libretro-vemulator"
	depends on BR2_PACKAGE_RETROARCH
	depends on BR2_INSTALL_LIBSTDCPP
      help
        A libretro SEGA Dreamcast VMU emulator core.

	  http://www.libretro.com

comment "LIBRETRO_VEMULATOR needs a toolchain w/ C++"
	depends on !BR2_INSTALL_LIBSTDCPP
```

## package/batocera/emulators/retroarch/libretro/libretro-vice/Config.in
```kconfig
config BR2_PACKAGE_LIBRETRO_VICE
        bool "libretro-vice"
	depends on BR2_PACKAGE_RETROARCH
	depends on BR2_INSTALL_LIBSTDCPP
        help
          Versatile Commodore 8-bit Emulator

	  http://www.libretro.com

comment "LIBRETRO_VICE needs a toolchain w/ C++"
	depends on !BR2_INSTALL_LIBSTDCPP
```

## package/batocera/emulators/retroarch/libretro/libretro-vircon32/Config.in
```kconfig
config BR2_PACKAGE_LIBRETRO_VIRCON32
    bool "libretro-vricon32"
    help
      A Fantasy Console, based on a 32-bit architecture
```

## package/batocera/emulators/retroarch/libretro/libretro-virtualjaguar/Config.in
```kconfig
config BR2_PACKAGE_LIBRETRO_VIRTUALJAGUAR
    bool "libretro-virtualjaguar"
	depends on BR2_INSTALL_LIBSTDCPP
    help
      A libretro Virtual Jaguar emulator core for ARM.

	  http://www.libretro.com

comment "LIBRETRO_VIRTUALJAGUAR needs a toolchain w/ C++"
	depends on !BR2_INSTALL_LIBSTDCPP
```

## package/batocera/emulators/retroarch/libretro/libretro-vitaquake2/Config.in
```kconfig
config BR2_PACKAGE_LIBRETRO_VITAQUAKE2
	bool "libretro-vitaquake2"
	depends on BR2_INSTALL_LIBSTDCPP
	help
      A libretro Quake 2 core.

	  http://www.libretro.com

comment "LIBRETRO_VITAQUAKE2 needs a toolchain w/ C++"
	depends on !BR2_INSTALL_LIBSTDCPP
```

## package/batocera/emulators/retroarch/libretro/libretro-vitaquake3/Config.in
```kconfig
config BR2_PACKAGE_LIBRETRO_VITAQUAKE3
    bool "libretro-vitaquake3"
	depends on BR2_PACKAGE_RETROARCH
	depends on BR2_INSTALL_LIBSTDCPP
	help
	  A libretro Quake 3 core.
	  
	  https://github.com/libretro/vitaquake3

comment "LIBRETRO_VITAQUAKE3 needs a toolchain w/ C++"
	depends on !BR2_INSTALL_LIBSTDCPP
```

## package/batocera/emulators/retroarch/libretro/libretro-wasm4/Config.in
```kconfig
config BR2_PACKAGE_LIBRETRO_WASM4
	bool "libretro-wasm4"
	help
	  Fantasy console using WebAssembly.

	  https://github.com/aduros/wasm4
```

## package/batocera/emulators/retroarch/libretro/libretro-watara/Config.in
```kconfig
config BR2_PACKAGE_LIBRETRO_WATARA
    bool "libretro-watara"
	depends on BR2_PACKAGE_RETROARCH
	depends on BR2_INSTALL_LIBSTDCPP
      help
        A libretro Watara emulator core.

	  http://www.libretro.com

comment "LIBRETRO_WATARA needs a toolchain w/ C++"
	depends on !BR2_INSTALL_LIBSTDCPP
```

## package/batocera/emulators/retroarch/libretro/libretro-xmil/Config.in
```kconfig
config BR2_PACKAGE_LIBRETRO_XMIL
    bool "libretro-xmil"
    help
      A libretro Sharp X1 emulator
```
