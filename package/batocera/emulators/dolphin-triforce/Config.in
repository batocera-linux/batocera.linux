## package/batocera/emulators/dolphin-triforce/Config.in
```kconfig
config BR2_PACKAGE_DOLPHIN_TRIFORCE
	bool "dolphin-triforce"
	depends on BR2_x86_64
	select BR2_PACKAGE_LIBEVDEV
	select BR2_PACKAGE_FFMPEG
	select BR2_PACKAGE_ZLIB
	select BR2_PACKAGE_XZ
	select BR2_PACKAGE_LIBPNG
	select BR2_PACKAGE_LZO
	select BR2_PACKAGE_LIBUSB
	select BR2_PACKAGE_LIBCURL
	select BR2_PACKAGE_BLUEZ5_UTILS
	select BR2_PACKAGE_HIDAPI
	select BR2_PACKAGE_BATOCERA_QT6
	select BR2_PACKAGE_SPEEX
	help
	  TriForce arcade emulator

comment "DOLPHIN_TRIFORCE needs a toolchain w/ C++, OpenGL"
    depends on !BR2_INSTALL_LIBSTDCPP || !BR2_PACKAGE_HAS_LIBGL
```

## package/batocera/emulators/dosbox-staging/Config.in
```kconfig
config BR2_PACKAGE_DOSBOX_STAGING
	bool "dosbox-staging"
	depends on BR2_INSTALL_LIBSTDCPP
	select BR2_PACKAGE_ALSA_LIB
	select BR2_PACKAGE_SPEEXDSP
	select BR2_PACKAGE_SDL2
	select BR2_PACKAGE_SDL2_IMAGE
	select BR2_PACKAGE_SDL2_NET
    select BR2_PACKAGE_FLUIDSYNTH
    select BR2_PACKAGE_FLUIDSYNTH_SDL2
	select BR2_PACKAGE_FLUIDSYNTH_ALSA_LIB
	select BR2_PACKAGE_ZLIB
	select BR2_PACKAGE_LIBPNG
	select BR2_PACKAGE_LIBOGG
	select BR2_PACKAGE_LIBVORBIS
	select BR2_PACKAGE_OPUS
	select BR2_PACKAGE_OPUSFILE
	select BR2_PACKAGE_LIBCURL
    select BR2_PACKAGE_SLIRP
    select BR2_PACKAGE_IIR

	help
	  Modernized DOSBox soft-fork

	  https://github.com/dosbox-staging/dosbox-staging
```

## package/batocera/emulators/dosbox-x/Config.in
```kconfig
config BR2_PACKAGE_DOSBOX_X
	bool "dosbox-x"
        depends on BR2_INSTALL_LIBSTDCPP
        select BR2_PACKAGE_SDL2
		select BR2_PACKAGE_SDL2_NET
		select BR2_PACKAGE_SDL_SOUND
		select BR2_PACKAGE_ZLIB
        select BR2_PACKAGE_LIBPNG
        select BR2_PACKAGE_LIBOGG
        select BR2_PACKAGE_LIBVORBIS      

	help
	  DOSBox is a DOS-emulator that uses the SDL-library 
          which makes DOSBox very easy to port to different platforms

	  https://github.com/joncampbell123/dosbox-x
```

## package/batocera/emulators/dosbox/Config.in
```kconfig
config BR2_PACKAGE_DOSBOX
	bool "dosbox"
    depends on BR2_INSTALL_LIBSTDCPP
    select BR2_PACKAGE_FLUIDSYNTH
    select BR2_PACKAGE_FLUIDSYNTH_SDL2
    select BR2_PACKAGE_LIBGLEW
    select BR2_PACKAGE_LIBOGG
    select BR2_PACKAGE_LIBPNG
    select BR2_PACKAGE_LIBVORBIS
	select BR2_PACKAGE_SDL2
	select BR2_PACKAGE_SDL2_NET
	select BR2_PACKAGE_ZLIB
    help
      DOSBox is a DOS-emulator that uses the SDL-library
      which makes DOSBox very easy to port to different platforms.

      https://github.com/duganchen/dosbox

comment "dosbox needs a toolchain w/ C++"
	depends on !BR2_INSTALL_LIBSTDCPP
```

## package/batocera/emulators/drastic/Config.in
```kconfig
config BR2_PACKAGE_DRASTIC
	bool "drastic"
    select BR2_PACKAGE_SDL2
	help
      Drastic is a Nintendo DS emulator.
      This is an Aarch64 specific binary.

      libdrastouch.c courtesy of Rocknix development.
      
      https://www.drastic-ds.com/
```

## package/batocera/emulators/duckstation-legacy/Config.in
```kconfig
config BR2_PACKAGE_DUCKSTATION_LEGACY
	bool "duckstation-legacy"
	select BR2_PACKAGE_BATOCERA_QT6      if BR2_x86_64
	select BR2_PACKAGE_FMT
	select BR2_PACKAGE_BOOST
	select BR2_PACKAGE_FFMPEG
	select BR2_PACKAGE_SDL2
	select BR2_PACKAGE_LIBEVDEV
	select BR2_PACKAGE_LIBDRM
	select BR2_PACKAGE_LIBCURL
	select BR2_PACKAGE_ECM
	select BR2_PACKAGE_LIBXKBCOMMON
	select BR2_PACKAGE_DBUS
	help
		DuckStation - PlayStation 1, aka. PSX Emulator
		https://github.com/stenzek/duckstation
```

## package/batocera/emulators/duckstation/Config.in
```kconfig
config BR2_PACKAGE_DUCKSTATION
	bool "duckstation"
	select BR2_PACKAGE_BATOCERA_QT6
	select BR2_PACKAGE_FMT
	select BR2_PACKAGE_BOOST
	select BR2_PACKAGE_FFMPEG
	select BR2_PACKAGE_SDL2
	select BR2_PACKAGE_LIBEVDEV
	select BR2_PACKAGE_LIBDRM
	select BR2_PACKAGE_LIBCURL
	select BR2_PACKAGE_ECM
	select BR2_PACKAGE_LIBXKBCOMMON
	select BR2_PACKAGE_QT6WAYLAND    if BR2_PACKAGE_BATOCERA_WAYLAND
	select BR2_PACKAGE_LIBBACKTRACE
	select BR2_PACKAGE_WEBP
	select BR2_PACKAGE_CPUINFO
	select BR2_PACKAGE_SPIRV_CROSS
	select BR2_PACKAGE_STENZEK_SHADERC
	help
		DuckStation - PlayStation 1, aka. PSX Emulator
		
		https://github.com/stenzek/duckstation
```

## package/batocera/emulators/easyrpg/easyrpg-player/Config.in
```kconfig
config BR2_PACKAGE_EASYRPG_PLAYER
    bool "easyrpg-player"
    select BR2_PACKAGE_LIBLCF
    select BR2_PACKAGE_SDL2
    select BR2_PACKAGE_SDL2_MIXER
    select BR2_PACKAGE_LIBPNG
    select BR2_PACKAGE_ZLIB
    select BR2_PACKAGE_FMT
    select BR2_PACKAGE_FREETYPE
    select BR2_PACKAGE_MPG123
    select BR2_PACKAGE_LIBVORBIS
    select BR2_PACKAGE_OPUSFILE
    select BR2_PACKAGE_PIXMAN
    select BR2_PACKAGE_SPEEXDSP
    select BR2_PACKAGE_LIBXMP
    select BR2_PACKAGE_WILDMIDI
    help
      EasyRPG Player is a game interpreter to play RPG Maker 2000, 2003 and EasyRPG games. It uses the LCF parser library (liblcf) to read RPG Maker game data.

      EasyRPG Player is part of the EasyRPG Project. More information is available at the project website: https://easyrpg.org/
```

## package/batocera/emulators/easyrpg/liblcf/Config.in
```kconfig
config BR2_PACKAGE_LIBLCF
    bool "liblcf"
    select BR2_PACKAGE_EXPAT
    select BR2_PACKAGE_ICU
    select BR2_PACKAGE_INIH
    help
      liblcf is a library to handle RPG Maker 2000 and 2003 game data.
      It can read and write LCF and XML files.
      
      liblcf is part of the EasyRPG Project.
      https://easyrpg.org/
```

## package/batocera/emulators/flycast/Config.in
```kconfig
config BR2_PACKAGE_FLYCAST
    bool "flycast"
    depends on BR2_PACKAGE_SDL2
    depends on BR2_PACKAGE_LIBPNG
    depends on BR2_PACKAGE_LIBZIP
    depends on BR2_GCC_ENABLE_OPENMP
    select BR2_PACKAGE_BOOST
    select BR2_PACKAGE_BOOST_NOWIDE
    select BR2_PACKAGE_LIBAO
    select BR2_PACKAGE_LIBCURL
    select BR2_PACKAGE_LIBMINIUPNPC
    select BR2_PACKAGE_ELFUTILS
    help
        Flycast is a multi-platform Sega Dreamcast, Naomi and Atomiswave emulator.
```

## package/batocera/emulators/fpinball/Config.in
```kconfig
config BR2_PACKAGE_FPINBALL
    bool "fpinball"
    depends on BR2_x86_64
    select BR2_PACKAGE_WINE_TKG
    help
      Future Pinball precompiled for 32bit Windows running through Wine.

      https://futurepinball.com

      Updated Better Arcade Mode (BAM)

      https://ravarcade.pl
```

## package/batocera/emulators/fsuae/Config.in
```kconfig
config BR2_PACKAGE_FSUAE
        bool "fs-uae"
	depends on BR2_PACKAGE_LIBGLIB2
	depends on BR2_PACKAGE_XORG7
	select BR2_PACKAGE_OPENAL
	select BR2_PACKAGE_LIBPNG
	select BR2_PACKAGE_SDL2
	select BR2_PACKAGE_ZLIB
	select BR2_PACKAGE_LIBMPEG2
	select BR2_PACKAGE_LIBCAPSIMAGE
        help
          A crossplatform amiga emulator
```

## package/batocera/emulators/gsplus/Config.in
```kconfig
config BR2_PACKAGE_GSPLUS
    bool "gsplus"
    select BR2_PACKAGE_SDL2
    select BR2_PACKAGE_LIBPCAP
    select BR2_PACKAGE_READLINE
    select BR2_PACKAGE_FREETYPE
    select BR2_PACKAGE_SDL2_IMAGE

    help
    	An Apple ][ GS emulator
```

## package/batocera/emulators/gta/re3-miami/Config.in
```kconfig
config BR2_PACKAGE_RE3_MIAMI
	bool "re3-miami"
	depends on BR2_PACKAGE_FREETYPE
	depends on BR2_PACKAGE_PCRE
	depends on BR2_PACKAGE_JPEG
	depends on BR2_PACKAGE_LIBPNG
	depends on BR2_PACKAGE_SDL2
	depends on BR2_PACKAGE_SDL2_MIXER
	depends on BR2_PACKAGE_CAIRO
	depends on BR2_PACKAGE_FFMPEG
	depends on BR2_PACKAGE_LIBCURL

	help
          RE3
          GTA Vice City for windows / mac / linux.

          https://github.com/GTAmodding/re3
```

## package/batocera/emulators/gta/re3/Config.in
```kconfig
config BR2_PACKAGE_RE3
	bool "re3"
	depends on BR2_PACKAGE_FREETYPE
	depends on BR2_PACKAGE_PCRE
	depends on BR2_PACKAGE_JPEG
	depends on BR2_PACKAGE_LIBPNG
	depends on BR2_PACKAGE_SDL2
	depends on BR2_PACKAGE_SDL2_MIXER
	depends on BR2_PACKAGE_CAIRO
	depends on BR2_PACKAGE_FFMPEG
	depends on BR2_PACKAGE_LIBCURL

	help
          RE3
          GTA III for windows / mac / linux.

          https://github.com/GTAmodding/re3
```

## package/batocera/emulators/hatari/Config.in
```kconfig
config BR2_PACKAGE_HATARI
    bool "hatari"
    select BR2_PACKAGE_SDL2

    help
    	An Atari ST/STe/TT/Falcon emulator
```

## package/batocera/emulators/hypseus-singe/Config.in
```kconfig
config BR2_PACKAGE_HYPSEUS_SINGE
    bool "hypseus-singe"
    select BR2_PACKAGE_SDL2
    select BR2_PACKAGE_SDL2_IMAGE
    select BR2_PACKAGE_SDL2_TTF
    select BR2_PACKAGE_ZLIB
    select BR2_PACKAGE_LIBOGG
    select BR2_PACKAGE_LIBVORBIS
    select BR2_PACKAGE_LIBMPEG2
    select BR2_PACKAGE_LIBZIP
    # add opencv4 dependencies for configgen
    select BR2_PACKAGE_OPENCV4
    select BR2_PACKAGE_OPENCV4_LIB_PYTHON
    select BR2_PACKAGE_OPENCV4_LIB_VIDEO
    select BR2_PACKAGE_OPENCV4_LIB_VIDEOIO
    select BR2_PACKAGE_OPENCV4_WITH_FFMPEG
    select BR2_PACKAGE_OPENCV4_WITH_GSTREAMER1
    select BR2_PACKAGE_GST1_PLUGINS_BASE
    help
      Hypseus is a fork of Daphne with support for Action Max (Singe) games.

      https://github.com/DirtBagXon/hypseus-singe
```

## package/batocera/emulators/ikemen/Config.in
```kconfig
config BR2_PACKAGE_IKEMEN
    bool "ikemen"
    depends on BR2_PACKAGE_HOST_GO_TARGET_ARCH_SUPPORTS
    depends on BR2_PACKAGE_XORG7
    select BR2_PACKAGE_MESA3D
    select BR2_PACKAGE_LIBGTK3
    select BR2_PACKAGE_OPENAL
    select BR2_PACKAGE_LIBGLFW
    help
        A MUGEN emulator written in GoLang

comment "ikemen needs a toolchain w/ threads"
	depends on BR2_PACKAGE_HOST_GO_TARGET_ARCH_SUPPORTS
```

## package/batocera/emulators/lexaloffle-pico8/Config.in
```kconfig
config BR2_PACKAGE_LEXALOFFLE_PICO8
        bool "lexaloffle-pico8"
        help
          Support for the officiel Pico-8 engine
```

## package/batocera/emulators/lexaloffle-voxatron/Config.in
```kconfig
config BR2_PACKAGE_LEXALOFFLE_VOXATRON
        bool "lexaloffle-voxatron"
        help
          Support for the officiel Voxatron engine
```

## package/batocera/emulators/lightspark/Config.in
```kconfig
config BR2_PACKAGE_LIGHTSPARK
	bool "lightspark"
	select BR2_PACKAGE_FREETYPE
	select BR2_PACKAGE_PCRE
	select BR2_PACKAGE_JPEG
	select BR2_PACKAGE_LIBPNG
	select BR2_PACKAGE_SDL2
	select BR2_PACKAGE_CAIRO
	select BR2_PACKAGE_FFMPEG
	select BR2_PACKAGE_LIBCURL
	select BR2_PACKAGE_PANGO
	select BR2_PACKAGE_RTMPDUMP
	help
          LightSpark
          Flash emulator for windows / mac / linux.

          https://github.com/lightspark/lightspark
```

## package/batocera/emulators/linapple/Config.in
```kconfig
config BR2_PACKAGE_LINAPPLE
	bool "linapple"
	depends on BR2_INSTALL_LIBSTDCPP
	select BR2_PACKAGE_SDL
	select BR2_PACKAGE_SDL_IMAGE
	select BR2_PACKAGE_SDL_IMAGE_BMP
	select BR2_PACKAGE_SDL_IMAGE_XPM
	select BR2_PACKAGE_LIBCURL
	select BR2_PACKAGE_ZLIB
	select BR2_PACKAGE_LIBZIP
	help
	  LinApple is an emulator for Apple II, Apple II+, Apple //e, and Enhanced Apple //e computers.

	  https://github.com/linappleii/linapple

comment "LinApple needs a toolchain w/ C++, and following librarie : sdl, sdl_image (bmp, xpm), curl, zlib and libzip"
	depends on !BR2_INSTALL_LIBSTDCPP || !BR2_PACKAGE_SDL || !BR2_PACKAGE_SDL_IMAGE || !BR2_PACKAGE_SDL_IMAGE_BMP || !BR2_PACKAGE_SDL_IMAGE_XPM || !BR2_PACKAGE_ZLIB || !BR2_PACKAGE_LIBZIP
```

## package/batocera/emulators/lindbergh-loader/Config.in
```kconfig
config BR2_PACKAGE_LINDBERGH_LOADER
    bool "lindbergh-loader"
	depends on BR2_PACKAGE_HAS_LIBGL
	depends on BR2_PACKAGE_XORG7
    depends on BR2_PACKAGE_LIBBSD_ARCH_SUPPORTS
    select BR2_PACKAGE_ALSA_LIB
    select BR2_PACKAGE_ALSA_PLUGINS
    select BR2_PACKAGE_ALSA_UTILS
    select BR2_PACKAGE_FAUDIO
    select BR2_PACKAGE_LIBBSD
    select BR2_PACKAGE_LIBFREEGLUT
    select BR2_PACKAGE_LIBMD
    select BR2_PACKAGE_LIBGLEW
    select BR2_PACKAGE_NCURSES
    select BR2_PACKAGE_OPENAL
    select BR2_PACKAGE_PCSC_LITE
    select BR2_PACKAGE_PIPEWIRE
    select BR2_PACKAGE_SDL2
    select BR2_PACKAGE_UTIL_LINUX_LIBUUID
    select BR2_PACKAGE_XCB_PROTO
	select BR2_PACKAGE_XCB_UTIL
    select BR2_PACKAGE_XCB_UTIL_CURSOR
	select BR2_PACKAGE_XCB_UTIL_IMAGE
    select BR2_PACKAGE_XCB_UTIL_KEYSYMS
	select BR2_PACKAGE_XCB_UTIL_RENDERUTIL
    select BR2_PACKAGE_XCB_UTIL_WM
    select BR2_PACKAGE_XLIB_LIBICE
    select BR2_PACKAGE_XLIB_LIBXSCRNSAVER
    select BR2_PACKAGE_XLIB_LIBSM
    select BR2_PACKAGE_XLIB_LIBX11
    select BR2_PACKAGE_XLIB_LIBXAU
    select BR2_PACKAGE_XLIB_LIBXEXT
    select BR2_PACKAGE_XLIB_LIBXI
    select BR2_PACKAGE_XLIB_LIBXDMCP
    select BR2_PACKAGE_XLIB_LIBXMU
    select BR2_PACKAGE_XLIB_LIBXXF86VM
    help
      A SEGA Lindbergh Emulator for Linux. 

      https://github.com/lindbergh-loader/lindbergh-loader

comment "lindbergh-loader depends on X.org and needs an OpenGL backend"
	depends on !BR2_PACKAGE_XORG7 || !BR2_PACKAGE_HAS_LIBGL
```

## package/batocera/emulators/mame/Config.in
```kconfig
config BR2_PACKAGE_MAME
	bool "mame"
        depends on BR2_INSTALL_LIBSTDCPP
        select BR2_PACKAGE_SDL2
        select BR2_PACKAGE_SDL2_TTF
	select BR2_PACKAGE_ZLIB
        select BR2_PACKAGE_LIBPNG
	select BR2_PACKAGE_JPEG
        select BR2_PACKAGE_SQLITE
	select BR2_PACKAGE_FONTCONFIG
	select BR2_PACKAGE_RAPIDJSON
	select BR2_PACKAGE_EXPAT
	select BR2_PACKAGE_GLM

	help
	  MAME emulator standalone package

	  https://mamedev.org
```
