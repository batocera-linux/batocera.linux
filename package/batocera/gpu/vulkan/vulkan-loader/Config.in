## package/batocera/gpu/vulkan/vulkan-loader/Config.in
```kconfig
config BR2_PACKAGE_VULKAN_LOADER
  bool "vulkan-loader"
  depends on BR2_PACKAGE_WAYLAND || BR2_PACKAGE_XORG7
  select BR2_PACKAGE_VULKAN_HEADERS
  help
    Vulkan Loader from Khronos

    https://github.com/KhronosGroup/Vulkan-Loader
```

## package/batocera/gpu/vulkan/vulkan-samples/Config.in
```kconfig
config BR2_PACKAGE_VULKAN_SAMPLES
  bool "vulkan-loader"
  depends on BR2_PACKAGE_WAYLAND || BR2_PACKAGE_XORG7
  select BR2_PACKAGE_VULKAN_HEADERS
  select BR2_PACKAGE_VULKAN_LOADER

  help
    Vulkan samples from Khronos

    https://github.com/KhronosGroup/Vulkan-Samples
```

## package/batocera/gpu/vulkan/vulkan-tools/Config.in
```kconfig
config BR2_PACKAGE_VULKAN_TOOLS
  bool "vulkan-tools"
  depends on BR2_PACKAGE_WAYLAND || BR2_PACKAGE_XORG7
  select BR2_PACKAGE_VULKAN_HEADERS
  select BR2_PACKAGE_VULKAN_LOADER
  select BR2_PACKAGE_HOST_PYTHON3
  select BR2_PACKAGE_HOST_PYTHON3_SSL
  select BR2_PACKAGE_GLSLANG

  help
    Vulkan tools from Khronos

    https://github.com/KhronosGroup/Vulkan-Tools
```

## package/batocera/gpu/vulkan/vulkan-utility-libraries/Config.in
```kconfig
config BR2_PACKAGE_VULKAN_UTILITY_LIBRARIES
    bool "vulkan-utility-libraries"
    depends on BR2_PACKAGE_WAYLAND || BR2_PACKAGE_XORG7
    select BR2_PACKAGE_VULKAN_HEADERS
    help
      Utility libraries for Vulkan developers.
      
      https://github.com/KhronosGroup/Vulkan-Utility-Libraries
```

## package/batocera/gpu/vulkan/vulkan-validationlayers/Config.in
```kconfig
config BR2_PACKAGE_VULKAN_VALIDATIONLAYERS
    bool "vulkan-validationlayers"
    select BR2_PACKAGE_VULKAN_HEADERS
    select BR2_PACKAGE_VULKAN_UTILITY_LIBRARIES
    help
      Vulkan Validation Layers (VVL)
      
      https://github.com/KhronosGroup/Vulkan-ValidationLayers
```

## package/batocera/gpu/vulkan/vulkan-volk/Config.in
```kconfig
config BR2_PACKAGE_VULKAN_VOLK
  bool "vulkan-volk"
  select BR2_PACKAGE_VULKAN_HEADERS
  help
    Meta loader for Vulkan API

    https://github.com/zeux/volk
```

## package/batocera/gpu/vulkan/vulkaninfo/Config.in
```kconfig
config BR2_PACKAGE_VULKANINFO
  bool "vulkaninfo"
  depends on BR2_PACKAGE_WAYLAND || BR2_PACKAGE_XORG7
  select BR2_PACKAGE_VULKAN_HEADERS
  select BR2_PACKAGE_VULKAN_LOADER
  select BR2_PACKAGE_HOST_PYTHON3
  select BR2_PACKAGE_HOST_PYTHON3_SSL
  select BR2_PACKAGE_GLSLANG
  help
    Small script to get Vulkan Information
```

## package/batocera/guichan/Config.in
```kconfig
config BR2_PACKAGE_GUICHAN
	bool "guichan"
        select BR2_PACKAGE_SDL
	help
	  GUICHAN c++ library

	  http://sourceforge.net/projects/guichan/

comment "guichan"
```

## package/batocera/kodi-resource-language-es_es/Config.in
```kconfig
config BR2_PACKAGE_KODI_RESOURCE_LANGUAGE_ES_ES
    bool "kodi-resource-language-es_es"
    default y
    help
      Kodi es_es language resource

      https://kodi.tv
```

## package/batocera/kodi-resource-language-eu_es/Config.in
```kconfig
config BR2_PACKAGE_KODI_RESOURCE_LANGUAGE_EU_ES
    bool "kodi-resource-language-eu_es"
    default y
    help
      Kodi eu_es language resource

      https://kodi.tv
```

## package/batocera/kodi-resource-language-fr_fr/Config.in
```kconfig
config BR2_PACKAGE_KODI_RESOURCE_LANGUAGE_FR_FR
    bool "kodi-resource-language-fr_fr"
    default y
    help
      Kodi fr_fr language resource

      https://kodi.tv
```

## package/batocera/kodi-resource-language-it_it/Config.in
```kconfig
config BR2_PACKAGE_KODI_RESOURCE_LANGUAGE_IT_IT
    bool "kodi-resource-language-it_it"
    default y
    help
      Kodi it_it language resource

      https://kodi.tv
```

## package/batocera/kodi-resource-language-pt_br/Config.in
```kconfig
config BR2_PACKAGE_KODI_RESOURCE_LANGUAGE_PT_BR
    bool "kodi-resource-language-pt_br"
    default y
    help
      Kodi pt_br language resource

      https://kodi.tv
```

## package/batocera/kodi-resource-language-sv_se/Config.in
```kconfig
config BR2_PACKAGE_KODI_RESOURCE_LANGUAGE_SV_SE
    bool "kodi-resource-language-sv_se"
    default y
    help
      Kodi sv_se language resource

      https://kodi.tv
```

## package/batocera/kodi-resource-language-tr_tr/Config.in
```kconfig
config BR2_PACKAGE_KODI_RESOURCE_LANGUAGE_tr_tr
    bool "kodi-resource-language-tr_tr"
    default y
    help
      Kodi tr_tr language resource

      https://kodi.tv
```

## package/batocera/kodi-resource-language-zh_cn/Config.in
```kconfig
config BR2_PACKAGE_KODI_RESOURCE_LANGUAGE_ZH_CN
    bool "kodi-resource-language-zh_cn"
    default y
    help
      Kodi zh_cn language resource

      https://kodi.tv
```

## package/batocera/kodi/Config.in
```kconfig
source "package/batocera/kodi/kodi-joystick/Config.in"
source "package/batocera/kodi/kodi-plugin-video-filmon/Config.in"
source "package/batocera/kodi/kodi-superrepo-all/Config.in"
source "package/batocera/kodi/kodi-superrepo-repositories/Config.in"
source "package/batocera/kodi/kodi-resource-language-de_de/Config.in"
source "package/batocera/kodi/kodi-resource-language-es_es/Config.in"
source "package/batocera/kodi/kodi-resource-language-eu_es/Config.in"	
source "package/batocera/kodi/kodi-resource-language-fr_fr/Config.in"
source "package/batocera/kodi/kodi-resource-language-it_it/Config.in"
source "package/batocera/kodi/kodi-resource-language-pt_br/Config.in"
source "package/batocera/kodi/kodi-resource-language-sv_se/Config.in"
source "package/batocera/kodi/kodi-resource-language-tr_tr/Config.in"
source "package/batocera/kodi/kodi-resource-language-zh_cn/Config.in"
```

## package/batocera/kodi/kodi-joystick/Config.in
```kconfig
config BR2_PACKAGE_KODI_JOYSTICK
        bool "kodi joystick plugin"
	depends on BR2_PACKAGE_KODI_PLATFORM
        help
          Kodi joystick plugin
```

## package/batocera/kodi/kodi-plugin-video-filmon/Config.in
```kconfig
config BR2_PACKAGE_KODI_PLUGIN_VIDEO_FILMON
    bool "kodi-plugin-video-filmon"
    default y
    select BR2_PACKAGE_KODI_SCRIPT_MODULE_T0MM0_COMMON
    help
      Kodi FilmOn Plugin

      https://kodi.tv
```

## package/batocera/kodi/kodi-superrepo-all/Config.in
```kconfig
config BR2_PACKAGE_KODI_SUPERREPO_ALL
    bool "kodi-superrepo-all"
    help
      Kodi SuperRepo All

      http://srp.nu
```

## package/batocera/kodi/kodi-superrepo-repositories/Config.in
```kconfig
config BR2_PACKAGE_KODI_SUPERREPO_REPOSITORIES
    bool "kodi-superrepo-repositories"
    help
      Kodi SuperRepo Repositories

      http://srp.nu
```

## package/batocera/kodi/kodi18-platform/Config.in
```kconfig
config BR2_PACKAGE_KODI18_PLATFORM
	bool
	select BR2_PACKAGE_LIBPLATFORM
	help
	  Kodi add-on platform support library

	  https://github.com/xbmc/kodi-platform
```

## package/batocera/kodi/kodi18-resource-language-pt_br/Config.in
```kconfig
config BR2_PACKAGE_KODI18_RESOURCE_LANGUAGE_PT_BR
    bool "kodi-resource-language-pt_br"
    help
      Kodi pt_br language resource

      https://kodi.tv
```

## package/batocera/kodi/kodi18-resource-language-sv_se/Config.in
```kconfig
config BR2_PACKAGE_KODI18_RESOURCE_LANGUAGE_SV_SE
    bool "kodi-resource-language-sv_se"
    help
      Kodi sv_se language resource

      https://kodi.tv
```
