## package/batocera/gpu/mali-g52/Config.in
```kconfig
config BR2_PACKAGE_MALI_G52
	bool "mali-g52"
	depends on BR2_arm || BR2_aarch64
	select BR2_PACKAGE_HAS_LIBEGL
	select BR2_PACKAGE_HAS_LIBGLES
	select BR2_PACKAGE_HAS_LIBMALI
	select BR2_PACKAGE_MALI_BIFROST_MODULE
	select BR2_PACKAGE_LIBDRM

if BR2_PACKAGE_MALI_G52

config BR2_PACKAGE_PROVIDES_LIBEGL
	default "mali-g52"

config BR2_PACKAGE_PROVIDES_LIBGLES
	default "mali-g52"

config BR2_PACKAGE_PROVIDES_LIBMALI
        default "mali-g52"

endif

comment "mali-g52"
```

## package/batocera/gpu/mali-hkg52/Config.in
```kconfig
config BR2_PACKAGE_MALI_HKG52
	bool "MALI_HKG52"
	depends on BR2_aarch64 || BR2_arm
	select BR2_PACKAGE_HAS_LIBEGL
	select BR2_PACKAGE_HAS_LIBGLES
	select BR2_PACKAGE_WAYLAND

if BR2_PACKAGE_MALI_HKG52

config BR2_PACKAGE_PROVIDES_LIBEGL
	default "mali-hkg52"

config BR2_PACKAGE_PROVIDES_LIBGLES
	default "mali-hkg52"

endif

comment "mali-hkg52"
```

## package/batocera/gpu/mali-hkg52fbdev/Config.in
```kconfig
config BR2_PACKAGE_MALI_HKG52FBDEV
	bool "MALI_HKG52FBDEV"
	depends on BR2_aarch64 || BR2_arm
	select BR2_PACKAGE_HAS_LIBEGL
	select BR2_PACKAGE_HAS_LIBGLES

if BR2_PACKAGE_MALI_HKG52FBDEV

config BR2_PACKAGE_PROVIDES_LIBEGL
	default "mali-hkg52fbdev"

config BR2_PACKAGE_PROVIDES_LIBGLES
	default "mali-hkg52fbdev"

endif

comment "mali-hkg52fbdev"
```

## package/batocera/gpu/mali-midgard-module/Config.in
```kconfig
config BR2_PACKAGE_MALI_MIDGARD_MODULE
	bool "mali-midgard-module"
	depends on BR2_LINUX_KERNEL
```

## package/batocera/gpu/mali-mp400-gbm/Config.in
```kconfig
config BR2_PACKAGE_MALI_MP400_GBM
	bool "mali-mp400-gbm"
	depends on BR2_arm
	select BR2_PACKAGE_HAS_LIBEGL
	select BR2_PACKAGE_HAS_LIBGLES
	select BR2_PACKAGE_HAS_LIBMALI
	select BR2_PACKAGE_GBM
	
	help
	  Install the binary user-space components for the ARM Mali Utgard
	  MP400 GPU. This package requires a kernel with the ARM Mali Utgard
	  GPU Kernel Drivers enabled.

if BR2_PACKAGE_MALI_MP400_GBM

config BR2_PACKAGE_PROVIDES_LIBEGL
	default "mali-mp400-gbm"

config BR2_PACKAGE_PROVIDES_LIBGLES
	default "mali-mp400-gbm"

config BR2_PACKAGE_PROVIDES_LIBMALI
	default "mali-mp400-gbm"

endif

comment "mali-mp400-gbm"
```

## package/batocera/gpu/mali-mp400-wayland/Config.in
```kconfig
config BR2_PACKAGE_MALI_MP400_WAYLAND
	bool "mali-mp400-wayland"
	depends on BR2_arm
	select BR2_PACKAGE_HAS_LIBEGL
	select BR2_PACKAGE_HAS_LIBGLES
	select BR2_PACKAGE_HAS_LIBMALI
	select BR2_PACKAGE_WAYLAND
	
	help
	  Install the binary user-space components for the ARM Mali Utgard
	  MP400 GPU. This package requires a kernel with the ARM Mali Utgard
	  GPU Kernel Drivers enabled.

if BR2_PACKAGE_MALI_MP400_WAYLAND

config BR2_PACKAGE_PROVIDES_LIBEGL
	default "mali-mp400-wayland"

config BR2_PACKAGE_PROVIDES_LIBGLES
	default "mali-mp400-wayland"

config BR2_PACKAGE_PROVIDES_LIBMALI
	default "mali-mp400-wayland"

endif

comment "mali-mp400-wayland"
```

## package/batocera/gpu/mali-opengles-sdk/Config.in
```kconfig
config BR2_PACKAGE_MALI_OPENGLES_SDK
	bool "mali-opengles-sdk"
	help
	  Install the ARM Mali drivers headers

	  http://malideveloper.arm.com
```

## package/batocera/gpu/mali-rk450/Config.in
```kconfig
config BR2_PACKAGE_MALI_RK450
	bool "MALI_RK450"
	depends on BR2_aarch64 || BR2_arm
	select BR2_PACKAGE_HAS_LIBEGL
	select BR2_PACKAGE_HAS_LIBGLES
	select BR2_PACKAGE_HAS_LIBMALI

if BR2_PACKAGE_MALI_RK450

config BR2_PACKAGE_PROVIDES_LIBEGL
	default "mali-rk450"

config BR2_PACKAGE_PROVIDES_LIBGLES
	default "mali-rk450"

config BR2_PACKAGE_PROVIDES_LIBMALI
	default "mali-rk450"

endif

comment "mali-rk450"
```

## package/batocera/gpu/mali-t620-wayland/Config.in
```kconfig
config BR2_PACKAGE_MALI_T620_WAYLAND
	bool "mali-t620-wayland"
	depends on BR2_arm
	select BR2_PACKAGE_HAS_LIBEGL
	select BR2_PACKAGE_HAS_LIBGLES
	select BR2_PACKAGE_WAYLAND
  select BR2_PACKAGE_MALI_MIDGARD_MODULE
	help
	  Install the binary user-space components for the ARM Mali Midgard
	  T620 GPU. This package requires a kernel with the ARM Mali Midgard
	  GPU Kernel Drivers enabled.

if BR2_PACKAGE_MALI_T620_WAYLAND

config BR2_PACKAGE_PROVIDES_LIBEGL
	default "mali-t620-wayland"

config BR2_PACKAGE_PROVIDES_LIBGLES
	default "mali-t620-wayland"

endif

comment "mali-t620-wayland"
```

## package/batocera/gpu/mali-t62x-wayland/Config.in
```kconfig
config BR2_PACKAGE_MALI_T62X_WAYLAND
	bool "MALI_T62X"
	depends on BR2_arm
	select BR2_PACKAGE_MALI_OPENGLES_SDK
	select BR2_PACKAGE_HAS_LIBEGL
	select BR2_PACKAGE_HAS_LIBGLES
	select BR2_PACKAGE_WAYLAND
	# required for gbm
	select BR2_PACKAGE_MESA3D
	help
	  Install the binary user-space components for the ARM Mali Midgard
	  T62X GPU. This package requires a kernel with the ARM Mali Midgard
	  GPU Kernel Drivers enabled.

if BR2_PACKAGE_MALI_T62X_WAYLAND

config BR2_PACKAGE_PROVIDES_LIBEGL
	default "mali-t62x-wayland"

config BR2_PACKAGE_PROVIDES_LIBGLES
	default "mali-t62x-wayland"

endif

comment "mali-t62x-wayland"
	depends on !BR2_arm || !BR2_PACKAGE_MALI_OPENGLES_SDK
```

## package/batocera/gpu/mesa-panfork/Config.in
```kconfig
menuconfig BR2_PACKAGE_MESA_PANFORK
	bool "mesa-panfork"
	depends on BR2_INSTALL_LIBSTDCPP
	depends on !BR2_STATIC_LIBS
	depends on BR2_TOOLCHAIN_HAS_SYNC_1
	depends on BR2_TOOLCHAIN_HAS_THREADS_NPTL
	depends on !BR2_m68k || BR2_TOOLCHAIN_GCC_AT_LEAST_7 # m68k needs gcc >= 7.x
	select BR2_PACKAGE_EXPAT
	select BR2_PACKAGE_LIBDRM
	select BR2_PACKAGE_WAYLAND_PROTOCOLS if BR2_PACKAGE_WAYLAND
	select BR2_PACKAGE_ZLIB
	help
	  Mesa 3D, an open-source implementation of the OpenGL
	  specification.

	  http://mesa3d.org

if BR2_PACKAGE_MESA_PANFORK

# Some Gallium driver needs libelf when built with LLVM support
config BR2_PACKAGE_MESA_PANFORK_NEEDS_ELFUTILS
	bool

# inform the .mk file of gallium, dri, dri3 or vulkan driver selection
config BR2_PACKAGE_MESA_PANFORK_DRI3
	bool
	select BR2_PACKAGE_XLIB_LIBXSHMFENCE

config BR2_PACKAGE_MESA_PANFORK_GALLIUM_DRIVER
	bool
	select BR2_PACKAGE_MESA_PANFORK_DRIVER

config BR2_PACKAGE_MESA_PANFORK_VULKAN_DRIVER
	bool
	select BR2_PACKAGE_MESA_PANFORK_DRIVER

config BR2_PACKAGE_MESA_PANFORK_DRIVER
	bool

# Gallium xa state tracker.
# Quote from mesa3d meson.build: "XA state tracker requires at least
# one of the following gallium drivers: nouveau, freedreno, i915, svga.
config BR2_PACKAGE_MESA_PANFORK_NEEDS_XA
	bool

config BR2_PACKAGE_MESA_PANFORK_GALLIUM_DRIVER_PANFROST
	bool "Gallium panfrost driver"
	depends on (BR2_TOOLCHAIN_HAS_SYNC_4 && !BR2_RISCV_32) || !BR2_PACKAGE_XORG7 # libxshmfence
	select BR2_PACKAGE_MESA_PANFORK_DRI3 if BR2_PACKAGE_XORG7
	select BR2_PACKAGE_MESA_PANFORK_GALLIUM_DRIVER
	help
	  Mesa driver for ARM Mali Midgard and Bifrost GPUs.

if BR2_PACKAGE_MESA_PANFORK_DRIVER

comment "OpenGL API Support"

config BR2_PACKAGE_MESA_PANFORK_GBM
	bool "gbm"
	depends on BR2_PACKAGE_MESA_PANFORK_GALLIUM_DRIVER && \
		BR2_PACKAGE_MESA_PANFORK_OPENGL_EGL
	select BR2_PACKAGE_HAS_LIBGBM
	select BR2_PACKAGE_LIBGBM_HAS_FEATURE_FORMAT_MODIFIER_PLANE_COUNT
	select BR2_PACKAGE_LIBGBM_HAS_FEATURE_DMA_BUF
	help
	  Enable Generic Buffer Management (gbm)

comment "gbm support needs a gallium driver w/ EGL support."
	depends on !(BR2_PACKAGE_MESA_PANFORK_GALLIUM_DRIVER && BR2_PACKAGE_MESA_PANFORK_OPENGL_EGL)

config BR2_PACKAGE_MESA_PANFORK_OPENGL_EGL
	bool "OpenGL EGL"
	depends on BR2_PACKAGE_MESA_PANFORK_GALLIUM_DRIVER
	select BR2_PACKAGE_HAS_LIBEGL if !BR2_PACKAGE_LIBGLVND
	select BR2_PACKAGE_LIBGLVND_DISPATCH_EGL if BR2_PACKAGE_LIBGLVND
	select BR2_PACKAGE_HAS_LIBEGL_WAYLAND
	select BR2_PACKAGE_MESA_PANFORK_GBM
	help
	  Use the Khronos EGL APIs. EGL is a window manager for OpenGL
	  applications similar to GLX, for X, and WGL, for Windows.

config BR2_PACKAGE_MESA_PANFORK_OPENGL_ES
	bool "OpenGL ES"
	select BR2_PACKAGE_HAS_LIBGLES if !BR2_PACKAGE_LIBGLVND
	select BR2_PACKAGE_LIBGLVND_DISPATCH_GLES if BR2_PACKAGE_LIBGLVND
	help
	  Use the Khronos OpenGL ES APIs. This is commonly used on
	  embedded systems and represents a subset of the OpenGL API.

endif # BR2_PACKAGE_MESA_PANFORK_DRIVER

config BR2_PACKAGE_PROVIDES_LIBGBM
	default "mesa-panfork" if BR2_PACKAGE_MESA_PANFORK_GBM

config BR2_PACKAGE_PROVIDES_LIBGL
	default "mesa-panfork" if BR2_PACKAGE_MESA_PANFORK_OPENGL_GLX && !BR2_PACKAGE_LIBGLVND

config BR2_PACKAGE_PROVIDES_LIBEGL
	default "mesa-panfork" if BR2_PACKAGE_MESA_PANFORK_OPENGL_EGL && !BR2_PACKAGE_LIBGLVND

config BR2_PACKAGE_PROVIDES_LIBGLES
	default "mesa-panfork" if BR2_PACKAGE_MESA_PANFORK_OPENGL_ES && !BR2_PACKAGE_LIBGLVND

config BR2_PACKAGE_PROVIDES_LIBOPENCL
	default "mesa-panfork" if BR2_PACKAGE_MESA_PANFORK_OPENCL

endif # BR2_PACKAGE_MESA_PANFORK

comment "mesa3d needs a toolchain w/ C++, NPTL, dynamic library"
	depends on !BR2_INSTALL_LIBSTDCPP || !BR2_TOOLCHAIN_HAS_THREADS_NPTL || \
		BR2_STATIC_LIBS
	depends on BR2_TOOLCHAIN_HAS_SYNC_1

comment "mesa3d needs a toolchain w/ gcc >= 7"
	depends on BR2_m68k
	depends on !BR2_TOOLCHAIN_GCC_AT_LEAST_7
```

## package/batocera/gpu/nv-codec-headers/Config.in
```kconfig
config BR2_PACKAGE_NV_CODEC_HEADERS
    bool "nv-codec-headers"
    help
      FFmpeg nvidia headers

      https://github.com/FFmpeg/nv-codec-headers
```

## package/batocera/gpu/nvidia340-legacy-driver/Config.in
```kconfig
comment "nvidia340-legacy-driver needs a glibc toolchain"
#batocera nvidia dropped x86 support
	depends on BR2_x86_64
	depends on !BR2_TOOLCHAIN_USES_GLIBC

config BR2_PACKAGE_NVIDIA340_LEGACY_DRIVER
	bool "nvidia340-legacy-driver"
#batocera nvidia dropped x86 support
	depends on BR2_x86_64
	depends on BR2_TOOLCHAIN_USES_GLIBC
	select BR2_PACKAGE_KMOD_TOOLS
	help
	  The binary-only driver blob for NVidia cards.
	  This is the userland part only.

	  http://www.nvidia.com/

if BR2_PACKAGE_NVIDIA340_LEGACY_DRIVER

comment "nvidia340-legacy-driver X.org drivers needs a modular Xorg server"
	depends on !BR2_PACKAGE_XSERVER_XORG_SERVER_MODULAR

config BR2_PACKAGE_NVIDIA340_LEGACY_DRIVER_XORG
	bool "X.org drivers"
	default y
	depends on BR2_PACKAGE_XSERVER_XORG_SERVER_MODULAR
#batocera mesa3d and nvidia340-legacy-driver must coexist
	select BR2_PACKAGE_MESA3D
	select BR2_PACKAGE_XLIB_LIBX11
	select BR2_PACKAGE_XLIB_LIBXEXT
	select BR2_PACKAGE_HAS_LIBGL
	select BR2_PACKAGE_HAS_LIBEGL
	select BR2_PACKAGE_HAS_LIBEGL_WAYLAND
#batocera GLES support is not enable in mesa3d by default
#	select BR2_PACKAGE_HAS_LIBGLES
	select BR2_PACKAGE_LIBGLVND

if BR2_PACKAGE_NVIDIA340_LEGACY_DRIVER_XORG

#batocera let MESA3D set itself as default provider for gl, egl, and gles
#config BR2_PACKAGE_PROVIDES_LIBGL
#	default "nvidia340-legacy-driver"

#config BR2_PACKAGE_PROVIDES_LIBEGL
#	default "nvidia340-legacy-driver"

#config BR2_PACKAGE_PROVIDES_LIBGLES
#	default "nvidia340-legacy-driver"

config BR2_PACKAGE_NVIDIA340_LEGACY_DRIVER_PRIVATE_LIBS
	bool "Install private libraries"
	help
	  Two libraries require special agreement with NVidia to
	  develop code linking to those libraries: libnvidia-ifr.so
	  and libnvidia-fbc.so (to grab and encode an OpenGL buffer or
	  an X framebuffer.)

	  Say 'y' here if you plan on running a program that uses
	  those private libraries.

endif # BR2_PACKAGE_NVIDIA340_LEGACY_DRIVER_XORG

config BR2_PACKAGE_NVIDIA340_LEGACY_DRIVER_CUDA
	bool "CUDA support"

if BR2_PACKAGE_NVIDIA340_LEGACY_DRIVER_CUDA

config BR2_PACKAGE_NVIDIA340_LEGACY_DRIVER_OPENCL
	bool "OpenCL support"
	select BR2_PACKAGE_MESA3D_HEADERS
	select BR2_PACKAGE_HAS_LIBOPENCL

config BR2_PACKAGE_PROVIDES_LIBOPENCL
	default "nvidia340-legacy-driver" if BR2_PACKAGE_NVIDIA340_LEGACY_DRIVER_OPENCL

config BR2_PACKAGE_NVIDIA340_LEGACY_DRIVER_CUDA_PROGS
	bool "CUDA MPS server and control"
	help
	  Say 'y' here if you need to run more than one program
	  doing CUDA at the same time. The MPS server will be
	  launched automatically when needed.

endif # BR2_PACKAGE_NVIDIA340_LEGACY_DRIVER_CUDA

comment "nvidia kernel module needs a kernel to be built"
	depends on !BR2_LINUX_KERNEL

config BR2_PACKAGE_NVIDIA340_LEGACY_DRIVER_MODULE
	bool "nvidia legacy kernel module"
	depends on BR2_LINUX_KERNEL
	select BR2_LINUX_NEEDS_MODULES # not using kernel-module infra
	help
	  Build the nvidia.ko kernel module.

	  If CUDA support (above) is set, and the target is x86_64, then
	  this will also build the nvidia-uvm.ko kernel module, which
	  provides Unified Memory access to the GPU and CPU memories for
	  CUDA programs.

endif # BR2_PACKAGE_NVIDIA340_LEGACY_DRIVER
```

## package/batocera/gpu/rockchip-mpp/Config.in
```kconfig
config BR2_PACKAGE_ROCKCHIP_MPP
    bool "rockchip-mpp"
	select BR2_PACKAGE_LIBDRM
    help
	  Rockchip Media Process Platform (RKMPP).
	  
	  https://github.com/rockchip-linux/mpp
```

## package/batocera/gpu/rockchip-rga/Config.in
```kconfig
config BR2_PACKAGE_ROCKCHIP_RGA
    bool "rockchip-rga"
    select BR2_PACKAGE_LIBDRM
    help
      RGA is a standalone 2D raster graphic acceleration unit.
      It accelerates 2D graphics operations, such as point/line drawing,
      image scaling, rotation, BitBLT, alpha blending and image blur/sharpness.
      
      https://github.com/nyanmisaka/rk-mirrors/tree/jellyfin-rga
```

## package/batocera/gpu/rockchip-rga2/Config.in
```kconfig
config BR2_PACKAGE_ROCKCHIP_RGA2
	bool "rockchip-rga2"
	help
	  Rockchip RGA2 kernel module
	  https://github.com/rtissera/rga2
```

## package/batocera/gpu/rpi-userland-tools/Config.in
```kconfig
config BR2_PACKAGE_RPI_USERLAND_TOOLS
	bool "rpi-userland-tools"
	depends on BR2_arm
	depends on BR2_INSTALL_LIBSTDCPP
	depends on BR2_TOOLCHAIN_HAS_THREADS
	depends on !BR2_STATIC_LIBS
	depends on !BR2_PACKAGE_RPI_USERLAND
	help
	  Raspberry Pi Userland contains the tools to use the VideoCore driver.

	  https://github.com/raspberrypi/userland/

comment "rpi-tools needs a toolchain w/ C++, threads, dynamic library"
	depends on BR2_arm
	depends on !BR2_INSTALL_LIBSTDCPP || !BR2_TOOLCHAIN_HAS_THREADS || \
		BR2_STATIC_LIBS
```

## package/batocera/gpu/vulkan-loader/Config.in
```kconfig
config BR2_PACKAGE_VULKAN_LOADER
	bool "VULKAN_LOADER"
	select BR2_PACKAGE_VULKAN_HEADERS
        select BR2_PACKAGE_WAYLAND if BR2_PACKAGE_XORG7
```

## package/batocera/gpu/vulkan-tools/Config.in
```kconfig
config BR2_PACKAGE_VULKAN_TOOLS
  bool "vulkan-tools"
  depends on BR2_i386 || BR2_x86_64
  depends on BR2_PACKAGE_MESA3D
  depends on BR2_PACKAGE_VULKAN_HEADERS
  depends on BR2_PACKAGE_VULKAN_LOADER
  depends on BR2_PACKAGE_WAYLAND
  help
    Vulkan tools from Khronos

    https://github.com/KhronosGroup/Vulkan-Tools
```

## package/batocera/gpu/vulkan/glslang/Config.in
```kconfig
config BR2_PACKAGE_GLSLANG
  bool "glslang"
  depends on BR2_PACKAGE_WAYLAND || BR2_PACKAGE_XORG7
  select BR2_PACKAGE_VULKAN_HEADERS
  select BR2_PACKAGE_VULKAN_LOADER
  select BR2_PACKAGE_SPIRV_TOOLS
  help
    glslang from Khronos

    https://github.com/KhronosGroup/glslang

config BR2_PACKAGE_HOST_GLSLANG
  bool "host-glslang"
```

## package/batocera/gpu/vulkan/spirv-cross/Config.in
```kconfig
config BR2_PACKAGE_SPIRV_CROSS
  bool "spirv-cross"
  select BR2_PACKAGE_VULKAN_HEADERS
  select BR2_PACKAGE_VULKAN_LOADER
  help
    SPIRV-Cross is a practical tool and library for performing reflection on SPIR-V
    and disassembling SPIR-V back to high level languages.
    
    https://github.com/KhronosGroup/SPIRV-Cross
```

## package/batocera/gpu/vulkan/spirv-headers/Config.in
```kconfig
config BR2_PACKAGE_SPIRV_HEADERS
	bool "spirv-headers"
	help
	  SPIR-V Headers
	  https://github.com/KhronosGroup/SPIRV-Headers
```

## package/batocera/gpu/vulkan/spirv-tools/Config.in
```kconfig
config BR2_PACKAGE_SPIRV_TOOLS
	bool "spirv-tools"
	help
	  The SPIR-V Tools project provides an API and commands for processing SPIR-V modules.
	  
	  https://github.com/KhronosGroup/SPIRV-Tools
```

## package/batocera/gpu/vulkan/vulkan-headers/Config.in
```kconfig
config BR2_PACKAGE_VULKAN_HEADERS
  bool "vulkan-headers"
  select BR2_PACKAGE_VULKAN_LOADER
  help
    Vulkan Headers from Khronos

    https://github.com/KhronosGroup/Vulkan-Headers
```
