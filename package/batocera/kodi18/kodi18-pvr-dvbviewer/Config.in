## package/batocera/kodi18/kodi18-pvr-dvbviewer/Config.in
```kconfig
config BR2_PACKAGE_KODI18_PVR_DVBVIEWER
	bool "kodi-pvr-dvbviewer"
	select BR2_PACKAGE_KODI18_PLATFORM
	help
	  Kodi's DVBViewer client addon

	  https://github.com/kodi-pvr/pvr.dvbviewer
```

## package/batocera/kodi18/kodi18-pvr-filmon/Config.in
```kconfig
config BR2_PACKAGE_KODI18_PVR_FILMON
	bool "kodi-pvr-filmon"
	select BR2_PACKAGE_JSONCPP
	select BR2_PACKAGE_KODI18_PLATFORM
	help
	  Filmon PVR client addon for Kodi

	  https://github.com/kodi-pvr/pvr.filmon
```

## package/batocera/kodi18/kodi18-pvr-hdhomerun/Config.in
```kconfig
config BR2_PACKAGE_KODI18_PVR_HDHOMERUN
	bool "kodi-pvr-hdhomerun"
	select BR2_PACKAGE_JSONCPP
	select BR2_PACKAGE_KODI18_PLATFORM
	select BR2_PACKAGE_LIBHDHOMERUN
	help
	  Kodi's HDHomeRun client addon

	  https://github.com/kodi-pvr/pvr.hdhomerun
```

## package/batocera/kodi18/kodi18-pvr-hts/Config.in
```kconfig
config BR2_PACKAGE_KODI18_PVR_HTS
	bool "kodi-pvr-hts"
	select BR2_PACKAGE_KODI18_PLATFORM
	help
	  Tvheadend HTSP PVR client addon for Kodi

	  https://github.com/kodi-pvr/pvr.hts
```

## package/batocera/kodi18/kodi18-pvr-iptvsimple/Config.in
```kconfig
config BR2_PACKAGE_KODI18_PVR_IPTVSIMPLE
	bool "kodi-pvr-iptvsimple"
	select BR2_PACKAGE_KODI18_PLATFORM
	select BR2_PACKAGE_RAPIDXML
	help
	  IPTV Live TV and Radio PVR client addon for Kodi

	  https://github.com/kodi-pvr/pvr.iptvsimple
```

## package/batocera/kodi18/kodi18-pvr-mythtv/Config.in
```kconfig
config BR2_PACKAGE_KODI18_PVR_MYTHTV
	bool "kodi-pvr-mythtv"
	select BR2_PACKAGE_KODI18_PLATFORM
	help
	  MythTV PVR for Kodi

	  https://github.com/kodi-pvr/pvr.mythtv
```

## package/batocera/kodi18/kodi18-pvr-nextpvr/Config.in
```kconfig
config BR2_PACKAGE_KODI18_PVR_NEXTPVR
	bool "kodi-pvr-nextpvr"
	select BR2_PACKAGE_KODI18_PLATFORM
	help
	  Kodi's NextPVR client addon

	  https://github.com/kodi-pvr/pvr.nextpvr
```

## package/batocera/kodi18/kodi18-pvr-njoy/Config.in
```kconfig
config BR2_PACKAGE_KODI18_PVR_NJOY
	bool "kodi-pvr-njoy"
	select BR2_PACKAGE_KODI18_PLATFORM
	help
	  Kodi's Njoy N7 client addon

	  https://github.com/kodi-pvr/pvr.njoy
```

## package/batocera/kodi18/kodi18-pvr-vbox/Config.in
```kconfig
config BR2_PACKAGE_KODI18_PVR_VBOX
	bool "kodi-pvr-vbox"
	select BR2_PACKAGE_KODI18_PLATFORM
	help
	  Kodi PVR addon for interfacing with VBox Communications XTi TV
	  Gateway

	  https://github.com/kodi-pvr/pvr.vbox
```

## package/batocera/kodi18/kodi18-pvr-vdr-vnsi/Config.in
```kconfig
config BR2_PACKAGE_KODI18_PVR_VDR_VNSI
	bool "kodi-pvr-vdr-vnsi"
	select BR2_PACKAGE_KODI18_PLATFORM
	help
	  Kodi PVR addon VNSI

	  https://github.com/kodi-pvr/pvr.vdr.vnsi
```

## package/batocera/kodi18/kodi18-pvr-vuplus/Config.in
```kconfig
config BR2_PACKAGE_KODI18_PVR_VUPLUS
	bool "kodi-pvr-vuplus"
	select BR2_PACKAGE_JSON_FOR_MODERN_CPP
	select BR2_PACKAGE_KODI18_PLATFORM
	select BR2_PACKAGE_TINYXML
	help
	  VuPlus PVR client addon for Kodi

	  https://github.com/kodi-pvr/pvr.vuplus
```

## package/batocera/kodi18/kodi18-pvr-wmc/Config.in
```kconfig
config BR2_PACKAGE_KODI18_PVR_WMC
	bool "kodi-pvr-wmc"
	select BR2_PACKAGE_KODI18_PLATFORM
	help
	  Kodi's Windows Media Center client addon

	  https://github.com/kodi-pvr/pvr.wmc
```

## package/batocera/kodi18/kodi18-resource-language-de_de/Config.in
```kconfig
config BR2_PACKAGE_KODI18_RESOURCE_LANGUAGE_DE_DE
    bool "kodi-resource-language-de_de"
    help
      Kodi de_de language resource

      https://kodi.tv
```

## package/batocera/kodi18/kodi18-resource-language-es_es/Config.in
```kconfig
config BR2_PACKAGE_KODI18_RESOURCE_LANGUAGE_ES_ES
    bool "kodi-resource-language-es_es"
    help
      Kodi es_es language resource

      https://kodi.tv
```

## package/batocera/kodi18/kodi18-resource-language-fr_fr/Config.in
```kconfig
config BR2_PACKAGE_KODI18_RESOURCE_LANGUAGE_FR_FR
    bool "kodi-resource-language-fr_fr"
    help
      Kodi fr_fr language resource

      https://kodi.tv
```

## package/batocera/kodi18/kodi18-resource-language-it_it/Config.in
```kconfig
config BR2_PACKAGE_KODI18_RESOURCE_LANGUAGE_IT_IT
    bool "kodi-resource-language-it_it"
    help
      Kodi it_it language resource

      https://kodi.tv
```

## package/batocera/kodi18/kodi18-resource-language-tr_tr/Config.in
```kconfig
config BR2_PACKAGE_KODI18_RESOURCE_LANGUAGE_TR_TR
    bool "kodi-resource-language-tr_tr"
    help
      Kodi tr_tr language resource

      https://kodi.tv
```

## package/batocera/kodi18/kodi18-screensaver-pingpong/Config.in
```kconfig
config BR2_PACKAGE_KODI18_SCREENSAVER_PINGPONG
	bool "kodi-screensaver-pingpong"
	depends on BR2_PACKAGE_HAS_LIBGL
	help
	  Ping-pong screensaver for Kodi

	  https://github.com/xbmc/screensaver.pingpong

comment "kodi-screensaver-pingpong needs OpenGL"
	depends on !BR2_PACKAGE_HAS_LIBGL
```

## package/batocera/kodi18/kodi18-screensaver-stars/Config.in
```kconfig
config BR2_PACKAGE_KODI18_SCREENSAVER_STARS
	bool "kodi-screensaver-stars"
	depends on BR2_PACKAGE_HAS_LIBGL
	help
	  Starfield screensaver for Kodi

	  https://github.com/xbmc/screensaver.stars

comment "kodi-screensaver-stars needs OpenGL"
	depends on !BR2_PACKAGE_HAS_LIBGL
```

## package/batocera/kodi18/kodi18-vfs-sftp/Config.in
```kconfig
config BR2_PACKAGE_KODI18_VFS_SFTP
	bool "kodi-vfs-sftp"
	select BR2_PACKAGE_KODI18_PLATFORM
	select BR2_PACKAGE_LIBPLATFORM
	select BR2_PACKAGE_LIBSSH
	help
	  SFTP VFS addon for Kodi

	  https://github.com/xbmc/vfs.sftp
```

## package/batocera/kodi18/kodi18-visualisation-spectrum/Config.in
```kconfig
config BR2_PACKAGE_KODI18_VISUALISATION_SPECTRUM
	bool "kodi-visualisation-spectrum"
	help
	  Spectrum visualiser for Kodi

	  https://github.com/notspiff/visualization.spectrum
```

## package/batocera/kodi18/kodi18-visualisation-waveform/Config.in
```kconfig
config BR2_PACKAGE_KODI18_VISUALISATION_WAVEFORM
	bool "kodi-visualisation-waveform"
	help
	  Waveform visualiser for Kodi

	  https://github.com/notspiff/visualization.waveform
```

## package/batocera/leds/ayaneo-platform/Config.in
```kconfig
comment "ayaneo-platform needs a Linux kernel to be built"
	depends on !BR2_LINUX_KERNEL

config BR2_PACKAGE_AYANEO_PLATFORM
	bool "ayaneo-platform"
	depends on BR2_LINUX_KERNEL
	help
	  Linux drivers for AYANEO x86 handhelds providing RGB control.

	  https://github.com/ShadowBlip/ayaneo-platform
```

## package/batocera/leds/ayn-platform/Config.in
```kconfig
comment "ayn-platform needs a Linux kernel to be built"
	depends on !BR2_LINUX_KERNEL

config BR2_PACKAGE_AYN_PLATFORM
	bool "ayn-platform"
	depends on BR2_LINUX_KERNEL
	help
	  Linux drivers for AYN x86 handhelds providing a hwmon interface for
	  pwm fan control and temperature sensors, as well as RGB control.

	  https://github.com/ShadowBlip/ayn-platform
```

## package/batocera/leds/keros-leds/Config.in
```kconfig
comment "keros-leds needs a Linux kernel to be built"
	depends on !BR2_LINUX_KERNEL

config BR2_PACKAGE_KEROS_LEDS
	bool "keros-leds"
	depends on BR2_LINUX_KERNEL
	help
	  Linux driver for R36 Ultra handhelds providing RGB control.

	  https://github.com/imanolbarba/keros-leds
```
