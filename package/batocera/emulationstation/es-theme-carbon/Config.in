## package/batocera/emulationstation/es-theme-carbon/Config.in
```kconfig
config BR2_PACKAGE_ES_THEME_CARBON
	bool "es-theme-carbon"
	help
	  EmulationStation theme Carbon (Batocera version).

	  https://github.com/fabricecaruso/es-theme-carbon
```

## package/batocera/emulationstation/es-theme-minijawn/Config.in
```kconfig
config BR2_PACKAGE_ES_THEME_MINIJAWN
	bool "EmulationStation theme MiniJawn"
	help
	  https://github.com/pacdude/es-theme-minijawn
```

## package/batocera/emulationstation/pegasus-theme-gameos/Config.in
```kconfig
config BR2_PACKAGE_PEGASUS_THEME_GAMEOS
        bool "Pegasus gameOS theme"
        help
          gameOS theme for Pegasus.

	  https://github.com/PlayingKarrde/gameOS
```

## package/batocera/emulationstation/pegasus/Config.in
```kconfig
config BR2_PACKAGE_PEGASUS
        bool "pegasus"
        select BR2_PACKAGE_QT5
        select BR2_PACKAGE_QT5_VERSION_LATEST
        select BR2_PACKAGE_QT5BASE
        select BR2_PACKAGE_QT5BASE_JPEG
        select BR2_PACKAGE_QT5BASE_PNG
        select BR2_PACKAGE_QT5BASE_FONTCONFIG
        select BR2_PACKAGE_QT5BASE_SQLITE_SYSTEM
        select BR2_PACKAGE_QT5BASE_XCB
        select BR2_PACKAGE_QT5MULTIMEDIA
        select BR2_PACKAGE_QT5DECLARATIVE
        select BR2_PACKAGE_QT5QUICKCONTROLS2
        select BR2_PACKAGE_QT5GRAPHICALEFFECTS
        select BR2_PACKAGE_QT5TOOLS
        select BR2_PACKAGE_QT5TOOLS_LINGUIST_TOOLS
        select BR2_PACKAGE_QT5IMAGEFORMATS
        select BR2_PACKAGE_QT5SVG
        select BR2_PACKAGE_QT5GAMEPAD
        select BR2_PACKAGE_GSTREAMER1
        select BR2_PACKAGE_GST1_PLUGINS_GOOD
        select BR2_PACKAGE_GST1_LIBAV
        select BR2_PACKAGE_GST1_PLUGINS_BASE_PLUGIN_ALSA
        select BR2_PACKAGE_GST1_PLUGINS_BASE_PLUGIN_AUDIOCONVERT # runtime
      	select BR2_PACKAGE_GST1_PLUGINS_BASE_PLUGIN_AUDIOMIXER # runtime
      	select BR2_PACKAGE_GST1_PLUGINS_BASE_PLUGIN_AUDIORESAMPLE # runtime
      	select BR2_PACKAGE_GST1_PLUGINS_BASE_PLUGIN_VIDEOCONVERT # runtime
      	select BR2_PACKAGE_GST1_PLUGINS_BASE_PLUGIN_VIDEOSCALE # runtime
      	select BR2_PACKAGE_GST1_PLUGINS_BASE_PLUGIN_VOLUME # runtime
      	select BR2_PACKAGE_GST1_PLUGINS_GOOD_PLUGIN_IMAGEFREEZE # runtime
        
        help
            A multi emulator frontend.
            https://github.com/mmatyas/pegasus-frontend
```

## package/batocera/emulationstation/sselph-scraper/Config.in
```kconfig
config BR2_PACKAGE_SSELPH_SCRAPER
    bool "sselph-scraper"
    depends on BR2_PACKAGE_HOST_GO_TARGET_ARCH_SUPPORTS=y
    depends on BR2_PACKAGE_HOST_GO_TARGET_CGO_LINKING_SUPPORTS=y

    depends on BR2_TOOLCHAIN_HAS_THREADS
    help
      sselph-scraper scraper

comment "sselph-scraper needs a toolchain w/ threads"
	depends on BR2_PACKAGE_HOST_GO_TARGET_ARCH_SUPPORTS && BR2_PACKAGE_HOST_GO_TARGET_CGO_LINKING_SUPPORTS
	depends on !BR2_TOOLCHAIN_HAS_THREADS
```

## package/batocera/emulators/Config.in
```kconfig
source "package/batocera/emulators/advancemame/Config.in"
source "package/batocera/emulators/amiberry/Config.in"
source "package/batocera/emulators/dolphin-emu/Config.in"
source "package/batocera/emulators/dosbox/Config.in"
source "package/batocera/emulators/fsuae/Config.in"
source "package/batocera/emulators/fsuae-capsimg-plugin/Config.in"
source "package/batocera/emulators/gpsp/Config.in"
source "package/batocera/emulators/linapple-pie/Config.in"
source "package/batocera/emulators/moonlight-embedded/Config.in"
source "package/batocera/emulators/mupen64plus/Config.in"
source "package/batocera/emulators/pcsx2/Config.in"
source "package/batocera/emulators/pifba/Config.in"
source "package/batocera/emulators/ppsspp/Config.in"
source "package/batocera/emulators/reicast/Config.in"
source "package/batocera/emulators/retroarch/Config.in"        
source "package/batocera/emulators/scummvm/Config.in"
source "package/batocera/emulators/vice/Config.in"
```

## package/batocera/emulators/amiberry/Config.in
```kconfig
config BR2_PACKAGE_AMIBERRY
    bool "amiberry"
    select BR2_PACKAGE_SDL2
    select BR2_PACKAGE_SDL2_IMAGE
    select BR2_PACKAGE_SDL2_TTF
    select BR2_PACKAGE_MPG123
    select BR2_PACKAGE_LIBXML2
    select BR2_PACKAGE_LIBMPEG2
    select BR2_PACKAGE_FLAC
    select BR2_PACKAGE_LIBPNG
    select BR2_PACKAGE_LIBSERIALPORT
    select BR2_PACKAGE_LIBPORTMIDI
    select BR2_PACKAGE_ZLIB
    select BR2_PACKAGE_LIBGLEW if BR2_PACKAGE_XORG7 && BR2_PACKAGE_HAS_LIBGL
    select BR2_PACKAGE_LIBGLU  if BR2_PACKAGE_XORG7 && BR2_PACKAGE_HAS_LIBGL
    select BR2_PACKAGE_LIBENET
    help
    	An optimised Amiga emulator for Linux
```

## package/batocera/emulators/applewin/Config.in
```kconfig
config BR2_PACKAGE_APPLEWIN
	bool "applewin"
	select BR2_PACKAGE_SDL2
	select BR2_PACKAGE_SDL2_IMAGE
	select BR2_PACKAGE_BOOST
	select BR2_PACKAGE_BOOST_PROGRAM_OPTIONS
	select BR2_PACKAGE_MINIZIP_ZLIB
	select BR2_PACKAGE_SLIRP
	select BR2_PACKAGE_LIBPCAP
	help
		AppleWin linux / libretro port

		https://github.com/audetto/AppleWin
```

## package/batocera/emulators/azahar/Config.in
```kconfig
config BR2_PACKAGE_AZAHAR
    bool "azahar"            
    select BR2_PACKAGE_BOOST
    select BR2_PACKAGE_BOOST_SERIALIZATION
    select BR2_PACKAGE_BOOST_IOSTREAMS
    select BR2_PACKAGE_BOOST_REGEX
    select BR2_PACKAGE_BOOST_LOCALE
    select BR2_PACKAGE_BOOST_MATH
    select BR2_PACKAGE_BOOST_CONTAINER
    select BR2_PACKAGE_FDK_AAC
    select BR2_PACKAGE_FFMPEG  
    select BR2_PACKAGE_FMT
    select BR2_PACKAGE_OPENAL
    select BR2_PACKAGE_SDL2
    help
      Azahar is a Citra fork and emulator for the Nintendo 3DS.
      
      https://github.com/azahar-emu/azahar
```

## package/batocera/emulators/bigpemu/Config.in
```kconfig
config BR2_PACKAGE_BIGPEMU
    bool "bigpemu"
    help
      BigPEmu is the first Atari Jaguar emulator to feature 
      compatibility with the entire retail cartridge library.

      https://www.richwhitehouse.com/jaguar/index.php
```

## package/batocera/emulators/cannonball/Config.in
```kconfig
config BR2_PACKAGE_CANNONBALL
	bool "cannonball"
	depends on BR2_INSTALL_LIBSTDCPP
	select BR2_PACKAGE_SDL2
	select BR2_PACKAGE_BOOST
	help
	  Cannonball - OutRun Engine

	  https://github.com/djyt/cannonball

comment "Cannonball needs a toolchain w/ C++, and following libraries : sdl2, boost"
	depends on !BR2_INSTALL_LIBSTDCPP || !BR2_PACKAGE_SDL2 || !BR2_PACKAGE_BOOST
```

## package/batocera/emulators/cemu-android/Config.in
```kconfig
config BR2_PACKAGE_CEMU_ANDROID
    bool "cemu-android"
    select BR2_PACKAGE_BLUEZ5_UTILS
    select BR2_PACKAGE_BOOST
    select BR2_PACKAGE_BOOST_FILESYSTEM
    select BR2_PACKAGE_BOOST_NOWIDE
    select BR2_PACKAGE_BOOST_PROGRAM_OPTIONS
    select BR2_PACKAGE_GLM
    select BR2_PACKAGE_GLSLANG
    select BR2_PACKAGE_HIDAPI
    select BR2_PACKAGE_LIBCURL
    select BR2_PACKAGE_LIBGTK3
    select BR2_PACKAGE_LIBOPENSSL
    select BR2_PACKAGE_LIBPNG
    select BR2_PACKAGE_LIBZLIB
    select BR2_PACKAGE_LIBZIP
    select BR2_PACKAGE_PUGIXML
    select BR2_PACKAGE_PULSEAUDIO
    select BR2_PACKAGE_RAPIDJSON
    select BR2_PACKAGE_SDL2
    select BR2_PACKAGE_SPEEXDSP
    select BR2_PACKAGE_WXWIDGETS
    select BR2_PACKAGE_ZSTD
    help
      Cemu is a Wii U emulator that now runs natively on Linux.
      This Andorid version better supports Arm devices.

      https://cemu.info/
      https://github.com/SSimco/Cemu
```

## package/batocera/emulators/cemu/Config.in
```kconfig
config BR2_PACKAGE_CEMU
    bool "cemu"
    depends on BR2_x86_64
    select BR2_PACKAGE_SDL2
    select BR2_PACKAGE_LIBCURL
    select BR2_PACKAGE_PUGIXML
    select BR2_PACKAGE_RAPIDJSON
    select BR2_PACKAGE_BOOST
    select BR2_PACKAGE_BOOST_PROGRAM_OPTIONS
    select BR2_PACKAGE_BOOST_FILESYSTEM
    select BR2_PACKAGE_BOOST_NOWIDE
    select BR2_PACKAGE_LIBZIP
    select BR2_PACKAGE_GLSLANG
    select BR2_PACKAGE_ZLIB
    select BR2_PACKAGE_ZSTD
    select BR2_PACKAGE_GLM
    select BR2_PACKAGE_LIBPNG
    select BR2_PACKAGE_WXWIDGETS
    select BR2_PACKAGE_HIDAPI
    help
      Cemu is a Wii U emulator that now runs natively on Linux.

      https://cemu.info/
```

## package/batocera/emulators/cemu/cemu-hook/Config.in
```kconfig
config BR2_PACKAGE_CEMU_HOOK
    bool "cemu-hook"
    depends on BR2_PACKAGE_CEMU
```

## package/batocera/emulators/cemu/cemu/Config.in
```kconfig
config BR2_PACKAGE_CEMU
    bool "cemu"
    depends on BR2_x86_64
    depends on BR2_PACKAGE_WINE_LUTRIS
    select BR2_PACKAGE_CEMUTIL
    select BR2_PACKAGE_CEMU_HOOK

    help
      Cemu precompiled for x86_64 running through Wine

      https://cemu.info/
```

## package/batocera/emulators/cemu/cemutil/Config.in
```kconfig
config BR2_PACKAGE_CEMUTIL
    bool "cemutil"
    depends on BR2_PACKAGE_CEMU
    depends on BR2_PACKAGE_CEMU_HOOK
```

## package/batocera/emulators/cgenius/Config.in
```kconfig
config BR2_PACKAGE_CGENIUS
	bool "cgenius"
	select BR2_PACKAGE_SDL2
	select BR2_PACKAGE_SDL2_IMAGE
	select BR2_PACKAGE_SDL2_TTF
	select BR2_PACKAGE_SDL2_MIXER
	select BR2_PACKAGE_BOOST
	help
	  Commander Genius - Commander Keen Engine
	  
	  https://github.com/gerstrong/Commander-Genius
```

## package/batocera/emulators/citra-android/Config.in
```kconfig
config BR2_PACKAGE_CITRA_ANDROID
    bool "citra-android"
    select BR2_PACKAGE_FMT
    select BR2_PACKAGE_BOOST
    select BR2_PACKAGE_FFMPEG
    select BR2_PACKAGE_SDL2
    help
      A Emulator Citra core for Nintendo 3DS.

	    https://citra-emu.org/
```

## package/batocera/emulators/citra/Config.in
```kconfig
config BR2_PACKAGE_CITRA
    bool "citra"
    select BR2_PACKAGE_BATOCERA_QT6               
    select BR2_PACKAGE_FMT
    select BR2_PACKAGE_BOOST
    select BR2_PACKAGE_BOOST_SERIALIZATION
    select BR2_PACKAGE_BOOST_IOSTREAMS
    select BR2_PACKAGE_BOOST_REGEX
    select BR2_PACKAGE_BOOST_LOCALE
    select BR2_PACKAGE_BOOST_CONTAINER
    select BR2_PACKAGE_FFMPEG  
    select BR2_PACKAGE_SDL2
    select BR2_PACKAGE_FDK_AAC
    help
      Citra is an open-source emulator for the Nintendo 3DS.
      
      https://github.com/PabloMK7/citra
```

## package/batocera/emulators/clk/Config.in
```kconfig
config BR2_PACKAGE_CLK
    bool "clk"
    select BR2_PACKAGE_SDL2
    depends on BR2_PACKAGE_HAS_LIBGL
    help
      CLK is a latency-hating emulator of: the Acorn Electron and Archimedes,
      Amstrad CPC, Apple II/II+/IIe and early Macintosh, Atari 2600 and ST,
      ColecoVision, Enterprise 64/128, Commodore Vic-20 and Amiga, MSX 1/2,
      Oric 1/Atmos, early PC compatibles, Sega Master System, Sinclair ZX80/81
      and ZX Spectrum.

      https://github.com/TomHarte/CLK

comment "clk needs an OpenGL backend"
	depends on !BR2_PACKAGE_HAS_LIBGL
```

## package/batocera/emulators/daphne/Config.in
```kconfig
config BR2_PACKAGE_DAPHNE
    bool "daphne"
    depends on BR2_PACKAGE_SDL2
    select BR2_PACKAGE_SDL2_IMAGE
    select BR2_PACKAGE_SDL2_TTF
    select BR2_PACKAGE_ZLIB
    select BR2_PACKAGE_LIBOGG
    select BR2_PACKAGE_LIBVORBIS	  
    select BR2_PACKAGE_LIBMPEG2
  
    help
      Hypseus is a fork of Daphne. A program that 
      "lets one play the original versions of many 
      laserdisc arcade games on one's PC."

      https://github.com/btolab/hypseus
```

## package/batocera/emulators/demul/Config.in
```kconfig
config BR2_PACKAGE_DEMUL
    bool "demul"
    depends on BR2_x86_64
    select BR2_PACKAGE_WINE_PROTON
    select BR2_PACKAGE_XDOTOOL
    help
      Demul is Sega's multi-system game console and automaton emulator.
      
      http://demul.emulation64.com
```

## package/batocera/emulators/devilutionx/Config.in
```kconfig
config BR2_PACKAGE_DEVILUTIONX
	bool "DevilutionX"
	select BR2_PACKAGE_SDL2
	select BR2_PACKAGE_SDL2_IMAGE
	select BR2_PACKAGE_SDL2_TTF
	select BR2_PACKAGE_SDL2_MIXER
	select BR2_PACKAGE_LIBSODIUM
	help
	  Diablo 1.

	  https://github.com/diasurgical/devilutionX/
```

## package/batocera/emulators/dolphin-emu/Config.in
```kconfig
config BR2_PACKAGE_DOLPHIN_EMU
	bool "dolphin-emu"

	depends on BR2_x86_64 || BR2_aarch64
	select BR2_PACKAGE_XORG7		        if BR2_PACKAGE_BATOCERA_TARGET_X86_64_ANY
	select BR2_PACKAGE_LIBEVDEV
	select BR2_PACKAGE_FFMPEG
	select BR2_PACKAGE_ZLIB
	select BR2_PACKAGE_XZ
	select BR2_PACKAGE_LIBPNG
	select BR2_PACKAGE_LZO
	select BR2_PACKAGE_LIBUSB
	select BR2_PACKAGE_LIBCURL
	select BR2_PACKAGE_BLUEZ5_UTILS
	select BR2_PACKAGE_HIDAPI
	select BR2_PACKAGE_BATOCERA_QT6                  

	help
	  Gamecube/Wii emulator

        comment "DOLPHIN_EMU needs a toolchain w/ C++, OpenGL"
        depends on !BR2_INSTALL_LIBSTDCPP || !BR2_PACKAGE_HAS_LIBGL
```
