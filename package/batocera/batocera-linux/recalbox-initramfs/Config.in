## package/batocera/batocera-linux/recalbox-initramfs/Config.in
```kconfig
config BR2_PACKAGE_RECALBOX_INITRAMFS
	bool "Recalbox initramfs"
	default n
	help
	  A simple initramfs based on busybox.

	  http://busybox.net/
```

## package/batocera/boot/batocera-initramfs/Config.in
```kconfig
config BR2_PACKAGE_BATOCERA_INITRAMFS
	bool "Batocera initramfs"
	select BR2_PACKAGE_HOST_UBOOT_TOOLS
	select BR2_PACKAGE_HOST_LZ4  if !BR2_PACKAGE_BATOCERA_TARGET_X86_64_ANY && \
					!BR2_PACKAGE_BATOCERA_TARGET_A3GEN2     && \
					!BR2_PACKAGE_BATOCERA_TARGET_S9GEN4

	default n
	help
	  A simple initramfs based on busybox.

	  http://busybox.net/
```

## package/batocera/boot/batocera-shim-signed-efi-helpers-ia32/Config.in
```kconfig
config BR2_PACKAGE_BATOCERA_SHIM_SIGNED_EFI_HELPERS_IA32
    bool "batocera-shim-signed-efi-helpers-ia32"
    help
      Signed EFI shim helper binaries

      https://packages.debian.org/bookworm/i386/shim-helpers-i386-signed
```

## package/batocera/boot/batocera-shim-signed-efi-ia32/Config.in
```kconfig
config BR2_PACKAGE_BATOCERA_SHIM_SIGNED_EFI_IA32
    bool "batocera-shim-signed-efi-ia32"
    help
      Signed EFI shim binaries

      https://packages.debian.org/bookworm/i386/shim-signed
```

## package/batocera/boot/batocera-shim-signed-efi-x64/Config.in
```kconfig
config BR2_PACKAGE_BATOCERA_SHIM_SIGNED_EFI_X64
    bool "batocera-shim-signed-efi-x64"
    help
      Signed EFI shim binaries

      https://launchpad.net/ubuntu/+source/shim-signed
```

## package/batocera/boot/batocera-syslinux-efi/Config.in
```kconfig
config BR2_PACKAGE_BATOCERA_SYSLINUX_EFI
    bool "batocera-syslinux-efi"
    help
      Precompiled syslinux EFI binaries from Archlinux

      https://www.archlinux.org/packages/core/x86_64/syslinux/
```

## package/batocera/boot/batocera-x86_64_efi/Config.in
```kconfig
config BR2_PACKAGE_BATOCERA_X86_64_EFI
    bool "batocera-x86_64_efi"
    help
      EFI 64 bit precompiled

      https://github.com/batocera-linux/batocera-x86_64_efi
```

## package/batocera/boot/rk3128-blobs/Config.in
```kconfig
config BR2_PACKAGE_RK3128_BLOBS
        bool "rk3128-blobs"
        help
          Rockchip RK3128 binary blobs
```

## package/batocera/boot/rocknix-abl/Config.in
```kconfig
config BR2_PACKAGE_ROCKNIX_ABL
	bool "rocknix-abl"
	select BR2_PACKAGE_PV
	help
	  Custom Android Bootloader (ABL) for various Qualcomm boards.
	  Installs signed ABL ELF and checksum for bootloader updates.

	  https://github.com/ROCKNIX/abl
```

## package/batocera/boot/uboot-amlogic/Config.in
```kconfig
config BR2_PACKAGE_UBOOT_AMLOGIC
	bool "uboot-amlogic"
	depends on BR2_TARGET_UBOOT
	help
	  U-Boot files for Amlogic Board (Khadas VIM3 and Odroid N2)
	  based on https://github.com/LibreELEC/LibreELEC.tv/blob/9f00cd296d3988995551a1f765d06f67c02eda88/projects/Amlogic/bootloader/install
```

## package/batocera/boot/uboot-anbernic-h700/anbernic_rg35xx_h700_lpddr3_defconfig
```kconfig
CONFIG_ARM=y
CONFIG_ARCH_SUNXI=y
CONFIG_DEFAULT_DEVICE_TREE="allwinner/sun50i-h700-anbernic-rg35xx-2024"
CONFIG_SPL=y
CONFIG_DRAM_SUNXI_DX_ODT=0x06060606
CONFIG_DRAM_SUNXI_DX_DRI=0x0d0d0d0d
CONFIG_DRAM_SUNXI_CA_DRI=0x1919
CONFIG_DRAM_SUNXI_ODT_EN=0x9988eeee
CONFIG_DRAM_SUNXI_TPR2=0x1
CONFIG_DRAM_SUNXI_TPR6=0x2fb08080
CONFIG_DRAM_SUNXI_TPR10=0x402f4489
CONFIG_DRAM_SUNXI_TPR11=0x10121013
CONFIG_DRAM_SUNXI_TPR12=0x0d0e0d0e
CONFIG_DRAM_SUNXI_PHY_ADDR_MAP_1=y
CONFIG_MACH_SUN50I_H616=y
CONFIG_SUNXI_DRAM_H616_LPDDR3=y
CONFIG_DRAM_CLK=672
CONFIG_R_I2C_ENABLE=y
CONFIG_SPL_I2C=y
CONFIG_SPL_SYS_I2C_LEGACY=y
CONFIG_SYS_I2C_MVTWSI=y
CONFIG_SYS_I2C_SLAVE=0x7f
CONFIG_SYS_I2C_SPEED=400000
CONFIG_REGULATOR_AXP=y
CONFIG_AXP717_POWER=y
CONFIG_AXP_DCDC2_VOLT=940
CONFIG_AXP_DCDC3_VOLT=1200
CONFIG_EFI_LOADER=n
CONFIG_BOOTDELAY=0
CONFIG_LED_STATUS=y
CONFIG_LED_STATUS_GPIO=y
CONFIG_LED_STATUS0=y
CONFIG_LED_STATUS_BIT=267
CONFIG_LED_STATUS_STATE=2
```

## package/batocera/boot/uboot-anbernic-rg351/Config.in
```kconfig
config BR2_PACKAGE_UBOOT_ANBERNIC_RG351
        bool "uboot files for anbernic-rg351"
	select BR2_TOOLCHAIN_OPTIONAL_LINARO_AARCH64
        help
          uboot files for anbernic-rg351
```

## package/batocera/boot/uboot-anbernic-rgxx3/Config.in
```kconfig
config BR2_PACKAGE_UBOOT_ANBERNIC_RGXX3
    bool "uboot-anbernic-rgxx3"
    help
      U-Boot for the Anbernic RGxx3 devices & Powkiddy clones.

      https://u-boot.org/
```

## package/batocera/boot/uboot-bananapi-m7/Config.in
```kconfig
config BR2_PACKAGE_UBOOT_BANANAPI_M7
    bool "uboot-bananapi-m7"
    help
      U-Boot files for the Bbanana Pi M7.
```

## package/batocera/boot/uboot-common/Config.in
```kconfig
config BR2_PACKAGE_UBOOT_COMMON
  bool "uboot common package"
  select BR2_PACKAGE_UBOOT_RK3288 \
    if BR2_PACKAGE_BATOCERA_TARGET_RK3288
  select BR2_PACKAGE_UBOOT_RK3399 \
    if BR2_PACKAGE_BATOCERA_TARGET_RK3399
  help
    uboot common package selects correct uboots to build
    based on BR2_PACKAGE_BATOCERA_TARGET_XXX variables.

config BR2_PACKAGE_UBOOT_COMMON_VERSION
  string "u-boot version"
  default "2022.10"
  help
    Default U-Boot version to use (can be overridden in sub-configs)

source "$BR2_EXTERNAL_BATOCERA_PATH/package/batocera/boot/uboot-common/uboot-rk3399/Config.in"
source "$BR2_EXTERNAL_BATOCERA_PATH/package/batocera/boot/uboot-common/uboot-rk3288/Config.in"
```

## package/batocera/boot/uboot-common/uboot-rk3288/Config.in
```kconfig
if BR2_PACKAGE_BATOCERA_TARGET_RK3288

config BR2_PACKAGE_UBOOT_RK3288
  bool "rk3288 u-boot"
  select BR2_PACKAGE_UBOOT_MIQI
  select BR2_PACKAGE_UBOOT_TINKERBOARD
  select BR2_TARGET_ARM_TRUSTED_FIRMWARE
  select BR2_TARGET_ARM_TRUSTED_FIRMWARE_LATEST_VERSION
  select BR2_TARGET_ARM_TRUSTED_FIRMWARE_BL32
  help
    U-Boot for rk3288 boards

config BR2_PACKAGE_UBOOT_RK3288_VERSION
  string "rk3288 u-boot version"
  default BR2_PACKAGE_UBOOT_COMMON_VERSION
  help
    Default U-Boot version to use for rk3288 boards (can be overridden in sub-configs)

endif # BR2_PACKAGE_BATOCERA_TARGET_RK3288

source "$BR2_EXTERNAL_BATOCERA_PATH/package/batocera/boot/uboot-common/uboot-rk3288/uboot-miqi/Config.in"
source "$BR2_EXTERNAL_BATOCERA_PATH/package/batocera/boot/uboot-common/uboot-rk3288/uboot-tinkerboard/Config.in"
```

## package/batocera/boot/uboot-common/uboot-rk3288/uboot-miqi/Config.in
```kconfig
config BR2_PACKAGE_UBOOT_MIQI
  bool "rk3288/miqi u-boot"
  help
    U-Boot for rk3288/miqi board

config BR2_PACKAGE_UBOOT_MIQI_VERSION
  string "rk3288/miqi u-boot version"
  default BR2_PACKAGE_UBOOT_RK3288_VERSION
  help
    U-Boot version to use for rk3288/miqi board
```

## package/batocera/boot/uboot-common/uboot-rk3288/uboot-tinkerboard/Config.in
```kconfig
config BR2_PACKAGE_UBOOT_TINKERBOARD
  bool "rk3288/tinkerboard u-boot"
  help
    U-Boot for rk3288/tinkerboard board

config BR2_PACKAGE_UBOOT_TINKERBOARD_VERSION
  string "rk3288/tinkerboard u-boot version"
  default BR2_PACKAGE_UBOOT_RK3288_VERSION
  help
    U-Boot version to use for rk3288/tinkerboard board
```

## package/batocera/boot/uboot-common/uboot-rk3399/Config.in
```kconfig
if BR2_PACKAGE_BATOCERA_TARGET_RK3399

config BR2_PACKAGE_UBOOT_RK3399
  bool "rk3399 u-boot"
  select BR2_PACKAGE_UBOOT_ORANGEPI
  select BR2_PACKAGE_UBOOT_ROCK_PI_4
  select BR2_PACKAGE_UBOOT_ROCK960
  select BR2_PACKAGE_UBOOT_ROCKPRO64
  select BR2_TARGET_ARM_TRUSTED_FIRMWARE
  select BR2_TARGET_ARM_TRUSTED_FIRMWARE_LATEST_VERSION
  select BR2_TARGET_ARM_TRUSTED_FIRMWARE_BL31
  select BR2_TARGET_ARM_TRUSTED_FIRMWARE_NEEDS_ARM32_TOOLCHAIN
  help
    U-Boot for rk3399 boards

config BR2_PACKAGE_UBOOT_RK3399_VERSION
  string "rk3399 u-boot version"
  default BR2_PACKAGE_UBOOT_COMMON_VERSION
  help
    Default U-Boot version to use for rk3399 boards (can be overridden in sub-configs)

endif # BR2_PACKAGE_BATOCERA_TARGET_RK3399

source "$BR2_EXTERNAL_BATOCERA_PATH/package/batocera/boot/uboot-common/uboot-rk3399/uboot-orangepi/Config.in"
source "$BR2_EXTERNAL_BATOCERA_PATH/package/batocera/boot/uboot-common/uboot-rk3399/uboot-rock-pi-4/Config.in"
source "$BR2_EXTERNAL_BATOCERA_PATH/package/batocera/boot/uboot-common/uboot-rk3399/uboot-rock960/Config.in"
source "$BR2_EXTERNAL_BATOCERA_PATH/package/batocera/boot/uboot-common/uboot-rk3399/uboot-rockpro64/Config.in"
```

## package/batocera/boot/uboot-common/uboot-rk3399/uboot-orangepi/Config.in
```kconfig
config BR2_PACKAGE_UBOOT_ORANGEPI
  bool "rk3399/orangepi u-boot"
  help
    U-Boot for rk3399/orangepi board

config BR2_PACKAGE_UBOOT_ORANGEPI_VERSION
  string "rk3399/orangepi u-boot version"
  default BR2_PACKAGE_UBOOT_RK3399_VERSION
  help
    U-Boot version to use for rk3399/orangepi board
```
