## package/xboxdrv/Config.in
```kconfig
config BR2_PACKAGE_XBOXDRV
        bool "xbox and ps3 support"
	depends on BR2_PACKAGE_RETROARCH
	depends on BR2_INSTALL_LIBSTDCPP
        help
	  Xbox and ps3 controller support
	  http://www.libretro.com

comment "XBOXDRV needs a toolchain w/ C++"
	depends on !BR2_INSTALL_LIBSTDCPP
```

## python-src/python-batocera-common/Config.in.host
```kconfig
config BR2_PACKAGE_HOST_PYTHON_BATOCERA_COMMON
	bool "host batocera-common"
	help
	  Common python functionality for Batocera for the host
```
