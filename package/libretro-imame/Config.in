## package/libretro-imame/Config.in
```kconfig
config BR2_PACKAGE_LIBRETRO_IMAME
        bool "libretro-imame"
	depends on BR2_PACKAGE_RETROARCH
	depends on BR2_INSTALL_LIBSTDCPP
        help
          A libretro imame4all core for ARM.

	  http://www.libretro.com

comment "LIBRETRO_IMAME needs a toolchain w/ C++"
	depends on !BR2_INSTALL_LIBSTDCPP
```

## package/libretro-mame2003/Config.in
```kconfig
config BR2_PACKAGE_LIBRETRO_MAME2003
        bool "libretro-MAME2003"
	depends on BR2_PACKAGE_RETROARCH
	depends on BR2_INSTALL_LIBSTDCPP
        help
          A libretro MAME2003 core for ARM.

	  http://www.libretro.com

comment "LIBRETRO_MAME2003 needs a toolchain w/ C++"
	depends on !BR2_INSTALL_LIBSTDCPP
```

## package/libretro-mupen64/Config.in
```kconfig
config BR2_PACKAGE_LIBRETRO_MUPEN64
        bool "libretro-mupen64"
	depends on BR2_PACKAGE_RETROARCH
	depends on BR2_INSTALL_LIBSTDCPP
        help
          A libretro N64 emulator core for ARM.

	  http://www.libretro.com

comment "LIBRETRO_MUPEN64 needs a toolchain w/ C++"
	depends on !BR2_INSTALL_LIBSTDCPP
```

## package/libretro-nxengine/Config.in
```kconfig
config BR2_PACKAGE_LIBRETRO_NXENGINE
        bool "libretro-nxengine"
	depends on BR2_PACKAGE_RETROARCH
	depends on BR2_INSTALL_LIBSTDCPP
        help
          NXEngine is a Cave Story game engine clone.

	  http://www.libretro.com

comment "LIBRETRO_NXENGINE needs a toolchain w/ C++"
	depends on !BR2_INSTALL_LIBSTDCPP
```

## package/libretro-pocketsnes/Config.in
```kconfig
config BR2_PACKAGE_LIBRETRO_POCKETSNES
        bool "libretro-pocketsnes"
	depends on BR2_PACKAGE_RETROARCH
	depends on BR2_INSTALL_LIBSTDCPP
        help
          A libretro SNES emulator core for ARM.

	  http://www.libretro.com

comment "LIBRETRO_POCKETSNES needs a toolchain w/ C++"
	depends on !BR2_INSTALL_LIBSTDCPP
```

## package/libretro-quicknes/Config.in
```kconfig
config BR2_PACKAGE_LIBRETRO_QUICKNES
        bool "libretro-quicknes"
	depends on BR2_PACKAGE_RETROARCH
	depends on BR2_INSTALL_LIBSTDCPP
        help
          A libretro NES emulator core for ARM.

	  http://www.libretro.com

comment "LIBRETRO_QUICKNES needs a toolchain w/ C++"
	depends on !BR2_INSTALL_LIBSTDCPP
```

## package/libretro-reicast/Config.in
```kconfig
config BR2_PACKAGE_LIBRETRO_REICAST
        bool "libretro-reicast"
	depends on BR2_PACKAGE_RETROARCH
	depends on BR2_INSTALL_LIBSTDCPP
        help
          A libretro dreamcast emulator core.

	  http://www.libretro.com

comment "LIBRETRO_REICAST needs a toolchain w/ C++"
	depends on !BR2_INSTALL_LIBSTDCPP
```

## package/libretro-tgbdual/Config.in
```kconfig
config BR2_PACKAGE_LIBRETRO_TGBDUAL
        bool "libretro-tgbdual"
	depends on BR2_PACKAGE_RETROARCH
	depends on BR2_INSTALL_LIBSTDCPP
        help
          A libretro GB/C emulator core for ARM.

	  http://www.libretro.com

comment "LIBRETRO_TGBDUAL needs a toolchain w/ C++"
	depends on !BR2_INSTALL_LIBSTDCPP
```

## package/libretro-uae/Config.in
```kconfig
config BR2_PACKAGE_LIBRETRO_UAE
        bool "libretro-uae"
	depends on BR2_PACKAGE_RETROARCH
	depends on BR2_INSTALL_LIBSTDCPP
        help
          A libretro AMIGA emulator core for ARM.

	  http://www.libretro.com

comment "LIBRETRO_UAE needs a toolchain w/ C++"
	depends on !BR2_INSTALL_LIBSTDCPP
```

## package/libretro-yabause/Config.in
```kconfig
config BR2_PACKAGE_LIBRETRO_YABAUSE
        bool "libretro-yabause"
	depends on BR2_PACKAGE_RETROARCH
	depends on BR2_INSTALL_LIBSTDCPP
        help
          A libretro YABAUSE emulator core.

	  http://www.libretro.com

comment "LIBRETRO_YABAUSE needs a toolchain w/ C++"
	depends on !BR2_INSTALL_LIBSTDCPP
```

## package/libxkbcommon/Config.in
```kconfig
config BR2_PACKAGE_LIBXKBCOMMON
	bool "libxkbcommon"
	select BR2_PACKAGE_LIBXCB if BR2_PACKAGE_XORG7
	# batocera - requirement for xkb to work, xkb is used by kodi, even without x for the keyboard
	select BR2_PACKAGE_XKEYBOARD_CONFIG
	help
	  xkbcommon is a keymap compiler and support library which
	  processes a reduced subset of keymaps as defined by the XKB
	  specification.

	  http://xkbcommon.org/
```

## package/lzop/Config.in.host
```kconfig
# batocera
config BR2_PACKAGE_HOST_LZOP
       select BR2_PACKAGE_HOST_LZO
       bool "host lzop"
       help
         lzop
```

## package/megatools/Config.in
```kconfig
config BR2_PACKAGE_MEGATOOLS
        bool "megatools"
	select BR2_PACKAGE_OPENSSL
        help
          A command line client for Mega.nz

          https://github.com/megous/megatools
```

## package/moonlight-embedded/Config.in
```kconfig
config BR2_PACKAGE_MOONLIGHT_EMBEDDED
    bool "moonlight-embedded"
    select BR2_PACKAGE_OPUS
    select BR2_PACKAGE_OPUS_FIXED_POINT
    select BR2_PACKAGE_EXPAT
    select BR2_PACKAGE_LIBEVDEV
    select BR2_PACKAGE_AVAHI
    select BR2_PACKAGE_ALSA_LIB
    select BR2_PACKAGE_HAS_UDEV
    select BR2_PACKAGE_LIBCURL
    select BR2_PACKAGE_LIBCEC
    select BR2_PACKAGE_FFMPEG
    select BR2_PACKAGE_SDL2
    help
		Gamestream client for embedded systems.

		https://github.com/irtimmer/moonlight-embedded/wiki
```

## package/mupen64plus-gles2rice/Config.in
```kconfig
config BR2_PACKAGE_MUPEN64PLUS_GLES2RICE
        bool "mupen 64 plus gles2rice plugin"
	depends on BR2_INSTALL_LIBSTDCPP
	depends on BR2_PACKAGE_SDL2
	depends on BR2_PACKAGE_RPI_USERLAND
	depends on BR2_PACKAGE_ALSA_LIB
        help
          mupen 64 plus glesrice plugin
	  https://github.com/mupen64plus/

comment "MUPEN64PLUS GLES2RICE needs a toolchain w/ C++, ALSA and SDL2"
	depends on !BR2_INSTALL_LIBSTDCPP || !BR2_PACKAGE_SDL2 || !BR2_PACKAGE_ALSA_LIB
```

## package/mupen64plus-gliden64/Config.in
```kconfig
config BR2_PACKAGE_MUPEN64PLUS_GLIDEN64
        bool "mupen 64 plus GLideN64 plugin"
	select BR2_INSTALL_LIBSTDCPP
	select BR2_PACKAGE_SDL2
	select BR2_PACKAGE_ALSA_LIB
	select BR2_PACKAGE_RPI_USERLAND
        help
          mupen 64 plus GLideN64 plugin
	  https://github.com/gonetz/GLideN64

comment "MUPEN64PLUS GLIDEN64 needs a toolchain w/ C++, ALSA and SDL2"
	depends on !BR2_INSTALL_LIBSTDCPP || !BR2_PACKAGE_SDL2 || !BR2_PACKAGE_ALSA_LIB
```

## package/mupen64plus-input-sdl/Config.in
```kconfig
config BR2_PACKAGE_MUPEN64PLUS_INPUT_SDL
        bool "mupen 64 plus input sdl"
	depends on BR2_INSTALL_LIBSTDCPP
	depends on BR2_PACKAGE_SDL2
	depends on BR2_PACKAGE_ALSA_LIB
        help
          mupen 64 plus inputsdl plugin
	  https://github.com/mupen64plus/

comment "MUPEN64PLUS INPUT SLD needs a toolchain w/ C++, ALSA and SDL2"
	depends on !BR2_INSTALL_LIBSTDCPP || !BR2_PACKAGE_SDL2 || !BR2_PACKAGE_ALSA_LIB
```

## package/mupen64plus-rsphle/Config.in
```kconfig
config BR2_PACKAGE_MUPEN64PLUS_RSPHLE
        bool "mupen 64 plus rsp-hle"
	depends on BR2_INSTALL_LIBSTDCPP
	depends on BR2_PACKAGE_SDL2
	depends on BR2_PACKAGE_ALSA_LIB
        help
          mupen 64 plus rsp-hle module
	  https://github.com/mupen64plus/

comment "MUPEN64PLUS RSP-HLE needs a toolchain w/ C++, ALSA and SDL2"
	depends on !BR2_INSTALL_LIBSTDCPP || !BR2_PACKAGE_SDL2 || !BR2_PACKAGE_ALSA_LIB
```

## package/omxplayer/Config.in
```kconfig
config BR2_PACKAGE_OMXPLAYER
	bool "omxplayer"
	depends on BR2_PACKAGE_RPI_USERLAND
	depends on BR2_PACKAGE_BOOST
	depends on BR2_PACKAGE_PCRE
	depends on BR2_PACKAGE_FREETYPE
	depends on BR2_PACKAGE_FFMPEG
	depends on BR2_PACKAGE_FFMPEG_GPL
	depends on BR2_PACKAGE_FFMPEG_SWSCALE
	depends on BR2_PACKAGE_FFMPEG_POSTPROC
	help
	  Omxplayer is a video player specifically made for the Raspberry Pi's 
	  GPU made by Edgar (gimli) Hucek from the XBMC/Kodi project. 
	  It relies on the OpenMAX hardware acceleration API, which is the 
	  Broadcom's VideoCore officially supported API for GPU video/audio 
	  processing.

comment "Omxplayer needs a toolchain C, and following libraries : rpi-userland, boost, pcre, freetype, ffmpeg (gpl, swscale, postproc)"
	depends on !BR2_PACKAGE_RPI_USERLAND || !BR2_PACKAGE_BOOST || !BR2_PACKAGE_PCRE || !BR2_PACKAGE_FREETYPE || \
		!BR2_PACKAGE_FFMPEG || !BR2_PACKAGE_FFMPEG_GPL || !BR2_PACKAGE_FFMPEG_SWSCALE || !BR2_PACKAGE_FFMPEG_POSTPROC
```

## package/p7zip/Config.in
```kconfig
config BR2_PACKAGE_P7ZIP
        bool "p7zip"
        help
          A command line tool to handle 7z and more.

          https://sourceforge.net/projects/p7zip/
```

## package/ppsspp/Config.in
```kconfig
config BR2_PACKAGE_PPSSPP
        bool "ppsspp"
	depends on BR2_PACKAGE_SDL2
	depends on BR2_PACKAGE_ZLIB
	depends on BR2_PACKAGE_FFMPEG_SWSCALE
        help
          A  PSP emulator
```

## package/python-rpigpio/Config.in
```kconfig
config BR2_PACKAGE_PYTHON_RPIGPIO
	bool "python-rpigpio"
	select BR2_PACKAGE_PYTHON_UNICODEDATA if BR2_PACKAGE_PYTHON
	select BR2_PACKAGE_PYTHON_PYEXPAT if BR2_PACKAGE_PYTHON
	select BR2_PACKAGE_PYTHON3_UNICODEDATA if BR2_PACKAGE_PYTHON3
	select BR2_PACKAGE_PYTHON3_PYEXPAT if BR2_PACKAGE_PYTHON3
	help
	 https://pypi.python.org/pypi/RPi.GPIO
```

## package/qtsixa-shanwan/Config.in
```kconfig
config BR2_PACKAGE_QTSIXA_SHANWAN
	depends on BR2_PACKAGE_BLUEZ_UTILS
	select BR2_PACKAGE_QTSIXA
	depends on BR2_PACKAGE_LIBUSB
        bool "qtsixashanwan"
        help
          Support for ps3 controllers.


comment "qtsixashanwan depends on bluez-utils bluez-compat bluez-hcidump checkinstall libusb-dev libbluetooth-dev joystick"
	depends on !BR2_PACKAGE_SDL || !BR2_PACKAGE_BLUEZ_UTILS || !BR2_PACKAGE_LIBUSB
```

## package/qtsixa/Config.in
```kconfig
config BR2_PACKAGE_QTSIXA
	depends on BR2_PACKAGE_BLUEZ5_UTILS
	depends on BR2_PACKAGE_LIBUSB
        bool "qtsixa"
        help
          Support for ps3 controllers.


comment "qtsixa depends on bluez5 checkinstall libusb-dev libbluetooth-dev joystick"
	depends on !BR2_PACKAGE_BLUEZ5_UTILS || !BR2_PACKAGE_LIBUSB
```

## package/recalbox-api/Config.in
```kconfig
config BR2_PACKAGE_RECALBOX_API
        bool "recalbox-api"
	depends on BR2_BR2_PACKAGE_NODEJS_0_12_X
        help
          Neolao's api project

	  https://github.com/neolao/recalbox-api
```
