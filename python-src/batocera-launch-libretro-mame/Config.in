## python-src/batocera-launch-libretro-mame/Config.in
```kconfig
config BR2_PACKAGE_BATOCERA_LAUNCH_LIBRETRO_MAME
	bool
	depends on BR2_PACKAGE_PYTHON_BATOCERA_COMMON
	depends on BR2_PACKAGE_BATOCERA_LAUNCH
	depends on BR2_PACKAGE_BATOCERA_LAUNCH_LIBRETRO
	select BR2_PACKAGE_BATOCERA_LAUNCH_MAME_COMMON
```

## python-src/batocera-launch-libretro/Config.in
```kconfig
config BR2_PACKAGE_BATOCERA_LAUNCH_LIBRETRO
	bool
	depends on BR2_PACKAGE_PYTHON_BATOCERA_COMMON
	depends on BR2_PACKAGE_BATOCERA_LAUNCH
```

## python-src/batocera-launch-linuxloader/Config.in
```kconfig
config BR2_PACKAGE_BATOCERA_LAUNCH_LINUXLOADER
	bool
	depends on BR2_PACKAGE_PYTHON_BATOCERA_COMMON
	depends on BR2_PACKAGE_BATOCERA_LAUNCH
	select BR2_PACKAGE_PYTHON_EVDEV
```

## python-src/batocera-launch-mame-common/Config.in
```kconfig
config BR2_PACKAGE_BATOCERA_LAUNCH_MAME_COMMON
	bool
	depends on BR2_PACKAGE_PYTHON_BATOCERA_COMMON
	depends on BR2_PACKAGE_BATOCERA_LAUNCH
```

## python-src/batocera-launch-mame/Config.in
```kconfig
config BR2_PACKAGE_BATOCERA_LAUNCH_MAME
	bool
	depends on BR2_PACKAGE_PYTHON_BATOCERA_COMMON
	depends on BR2_PACKAGE_BATOCERA_LAUNCH
	select BR2_PACKAGE_BATOCERA_LAUNCH_MAME_COMMON
```

## python-src/batocera-launch-mupen64plus/Config.in
```kconfig
config BR2_PACKAGE_BATOCERA_LAUNCH_MUPEN64PLUS
	bool
	depends on BR2_PACKAGE_PYTHON_BATOCERA_COMMON
	depends on BR2_PACKAGE_BATOCERA_LAUNCH
```

## python-src/batocera-launch-openjkdf2/Config.in
```kconfig
config BR2_PACKAGE_BATOCERA_LAUNCH_OPENJKDF2
	bool
	depends on BR2_PACKAGE_PYTHON_BATOCERA_COMMON
	depends on BR2_PACKAGE_BATOCERA_LAUNCH
```

## python-src/batocera-launch-openmohaa/Config.in
```kconfig
config BR2_PACKAGE_BATOCERA_LAUNCH_OPENMOHAA
	bool
	depends on BR2_PACKAGE_PYTHON_BATOCERA_COMMON
	depends on BR2_PACKAGE_BATOCERA_LAUNCH
```

## python-src/batocera-launch-pcsx2/Config.in
```kconfig
config BR2_PACKAGE_BATOCERA_LAUNCH_PCSX2
	bool
	depends on BR2_PACKAGE_PYTHON_BATOCERA_COMMON
	depends on BR2_PACKAGE_BATOCERA_LAUNCH
```

## python-src/batocera-launch-rpcs3/Config.in
```kconfig
config BR2_PACKAGE_BATOCERA_LAUNCH_RPCS3
	bool
	select BR2_PACKAGE_PYTHON_AIOHTTP
	depends on BR2_PACKAGE_PYTHON_BATOCERA_COMMON
	depends on BR2_PACKAGE_BATOCERA_LAUNCH
```

## python-src/batocera-launch-xemu-chihiro/Config.in
```kconfig
config BR2_PACKAGE_BATOCERA_LAUNCH_XEMU_CHIHIRO
	bool
	depends on BR2_PACKAGE_PYTHON_BATOCERA_COMMON
	depends on BR2_PACKAGE_BATOCERA_LAUNCH
```

## python-src/python-batocera-common/Config.in
```kconfig
config BR2_PACKAGE_PYTHON_BATOCERA_COMMON
	bool "batocera python common"
	select BR2_PACKAGE_PYTHON3
	select BR2_PACKAGE_PYTHON_PYYAML
	select BR2_PACKAGE_PYTHON_RUAMEL_YAML
	select BR2_PACKAGE_PYTHON_TYPING_EXTENSIONS
	select BR2_PACKAGE_PYTHON_AIOHTTP
	select BR2_PACKAGE_PYTHON_AIODNS # part of the "speedups" optional dependencies for aiohttp
	select BR2_PACKAGE_PYTHON_BROTLI # part of the "speedups" optional dependencies for aiohttp
	select BR2_PACKAGE_SDL3
	help
	  Common python functionality for Batocera
```
