## configs/batocera-nanopi_defconfig
```kconfig
# Architecture
BR2_arm=y
BR2_cortex_a7=y
BR2_ARM_FPU_VFPV4=y

# Linux headers same as kernel, a 4.11 series
BR2_PACKAGE_HOST_LINUX_HEADERS_CUSTOM_4_11=y

# System configuration
BR2_TARGET_GENERIC_HOSTNAME="nanopi-m1-plus"
BR2_TARGET_GENERIC_ISSUE="Welcome to Buildroot for the NanoPi M1 Plus"

# Bootloaders
BR2_TARGET_UBOOT=y
BR2_TARGET_UBOOT_BUILD_SYSTEM_KCONFIG=y
BR2_TARGET_UBOOT_CUSTOM_VERSION=y
BR2_TARGET_UBOOT_CUSTOM_VERSION_VALUE="2017.07"
BR2_TARGET_UBOOT_BOARD_DEFCONFIG="nanopi_m1_plus"
BR2_TARGET_UBOOT_NEEDS_DTC=y
BR2_TARGET_UBOOT_NEEDS_PYLIBFDT=y
BR2_TARGET_UBOOT_FORMAT_CUSTOM=y
BR2_TARGET_UBOOT_FORMAT_CUSTOM_NAME="u-boot-sunxi-with-spl.bin"

# Kernel
BR2_LINUX_KERNEL=y
BR2_LINUX_KERNEL_CUSTOM_VERSION=y
BR2_LINUX_KERNEL_CUSTOM_VERSION_VALUE="4.11.5"
BR2_GLOBAL_PATCH_DIR="board/friendlyarm/nanopi-m1-plus/patches/"
BR2_LINUX_KERNEL_DEFCONFIG="sunxi"
BR2_LINUX_KERNEL_DTS_SUPPORT=y
BR2_LINUX_KERNEL_INTREE_DTS_NAME="sun8i-h3-nanopi-m1-plus"

# Filesystem
BR2_TARGET_ROOTFS_EXT2=y
BR2_TARGET_ROOTFS_EXT2_4=y
BR2_TARGET_UBOOT_BOOT_SCRIPT=y
BR2_TARGET_UBOOT_BOOT_SCRIPT_SOURCE="board/friendlyarm/nanopi-m1-plus/boot.cmd"
BR2_ROOTFS_POST_IMAGE_SCRIPT="support/scripts/genimage.sh"
BR2_ROOTFS_POST_SCRIPT_ARGS="-c board/friendlyarm/nanopi-m1-plus/genimage.cfg"
# BR2_TARGET_ROOTFS_TAR is not set

# Additional tools
BR2_PACKAGE_HOST_DOSFSTOOLS=y
BR2_PACKAGE_HOST_GENIMAGE=y
BR2_PACKAGE_HOST_MTOOLS=y

# Batocera 
BR2_PACKAGE_BUSYBOX_CONFIG_FRAGMENT_FILES="board/batocera/busybox.custom.config"
BR2_PACKAGE_BATOCERA_ALL_SYSTEMS=y
BR2_PACKAGE_BATOCERA_TOOLS=y
BR2_PACKAGE_BATOCERA_EXTRAS=y
BR2_PACKAGE_BATOCERA_KODI=n
BR2_PACKAGE_BATOCERA_LINUX_FIRMWARES=y
BR2_PACKAGE_BATOCERA_SYSTEM=y
BR2_PACKAGE_BATOCERA_TARGET_nanopi=y
BR2_PACKAGE_XARCADE2JSTICK=y
BR2_PACKAGE_FBDUMP=y
BR2_PACKAGE_FBGRAB=y
BR2_PACKAGE_FBV=y
BR2_PACKAGE_SDL2_MIXER=y
BR2_PACKAGE_SDL_IMAGE_XPM=y
BR2_PACKAGE_SDL_MIXER=y
BR2_PACKAGE_SDL_NET=y
BR2_PACKAGE_EUDEV_RULES_GEN=y
BR2_PACKAGE_I2C_TOOLS=y
BR2_PACKAGE_KBD=y
BR2_PACKAGE_MALI_420=y
BR2_PACKAGE_PYTHON_PY_PYC=y
BR2_PACKAGE_PYTHON_GOBJECT=y
BR2_PACKAGE_LIBZIP=y
BR2_PACKAGE_BOOST_ATOMIC=y
# BR2_PACKAGE_AVAHI_AUTOIPD is not set
BR2_PACKAGE_GESFTPSERVER=y
# BR2_TARGET_ROOTFS_TAR is not set
BR2_PACKAGE_LIBCAPSIMAGE=y
BR2_PACKAGE_UTIL_LINUX_LIBSMARTCOLS=y
BR2_PACKAGE_UTIL_LINUX_SETTERM=y
BR2_PACKAGE_PYTHON_HASHLIB=y
BR2_PACKAGE_BOOST=y
BR2_PACKAGE_PYTHON_PSUTIL=y
BR2_PACKAGE_LIBAMCODEC=y
BR2_PACKAGE_OPENVPN=y
```

## configs/batocera-odroidc2_defconfig
```kconfig
BR2_aarch64=y
BR2_cortex_a53=y
BR2_OPTIMIZE_3=y
BR2_SHARED_STATIC_LIBS=y
BR2_GLOBAL_PATCH_DIR="board/recalbox/patches board/recalbox/c2/patches"
BR2_KERNEL_HEADERS_3_12=y
BR2_TOOLCHAIN_BUILDROOT_GLIBC=y
# required for utf-8
BR2_TOOLCHAIN_GLIBC_GCONV_LIBS_COPY=y
BR2_TOOLCHAIN_BUILDROOT_CXX=y
BR2_GCC_VERSION_7_X=y
BR2_ENABLE_LOCALE_WHITELIST="C ar ca de el es eu_ES fr hu it ja_JP ko nb_NO nl nn_NO pl pt_PT pt_BR ru_RU sv_SE tr zh_CN zh_TW"
BR2_GENERATE_LOCALE="en_US.UTF-8 ar_YE.UTF-8 ca_ES.UTF-8 de_DE.UTF-8 el_GR.UTF-8 es_ES.UTF-8 eu_ES.UTF-8 fr_FR.UTF-8 hu_HU.UTF-8 it_IT.UTF-8 ja_JP.UTF-8 ko_KR.UTF-8 nb_NO.UTF-8 nl_NL.UTF-8 nn_NO.UTF-8 pl_PL.UTF-8 pt_BR.UTF-8 pt_PT.UTF-8 ru_RU.UTF-8 sv_SE.UTF-8 tr_TR.UTF-8 zh_CN.UTF-8 zh_TW.UTF-8"
BR2_TARGET_OPTIMIZATION="-pipe -fsigned-char"
BR2_TARGET_GENERIC_HOSTNAME="batocera"
BR2_TARGET_GENERIC_ISSUE="PLAY AGAIN"
BR2_INIT_SYSV=y
BR2_ROOTFS_DEVICE_CREATION_DYNAMIC_EUDEV=y
BR2_TARGET_GENERIC_ROOT_PASSWD="linux"
BR2_SYSTEM_BIN_SH_BASH=y
BR2_TARGET_GENERIC_GETTY_PORT="tty1"
BR2_TARGET_GENERIC_GETTY_BAUDRATE_115200=y
# BR2_TARGET_GENERIC_REMOUNT_ROOTFS_RW is not set
BR2_TARGET_TZ_INFO=y
BR2_TARGET_LOCALTIME="Europe/Paris"
BR2_ROOTFS_OVERLAY="board/recalbox/fsoverlay board/recalbox/c2/fsoverlay"
BR2_ROOTFS_POST_BUILD_SCRIPT="board/recalbox/recalbox-patch-target.sh"
BR2_ROOTFS_POST_IMAGE_SCRIPT="board/recalbox/copy-recalbox-archives.sh"
BR2_LINUX_KERNEL=y
BR2_LINUX_KERNEL_CUSTOM_GIT=y
BR2_LINUX_KERNEL_CUSTOM_REPO_URL="https://github.com/hardkernel/linux.git"
BR2_LINUX_KERNEL_CUSTOM_REPO_VERSION="80d67c8f1fd15da32f21a3be6a76424a466358c1"
BR2_LINUX_KERNEL_PATCH="board/recalbox/c2/kernel_patches"
BR2_LINUX_KERNEL_DEFCONFIG="odroidc2"
BR2_LINUX_KERNEL_CONFIG_FRAGMENT_FILES="board/recalbox/c2/kernel-odroidc2-3.14-defconfig-fragment.config"
BR2_LINUX_KERNEL_DTS_SUPPORT=y
BR2_LINUX_KERNEL_INTREE_DTS_NAME="meson64_odroidc2"
BR2_PACKAGE_BUSYBOX_CONFIG_FRAGMENT_FILES="board/recalbox/busybox.custom.config"
BR2_PACKAGE_ALSA_UTILS=y
BR2_PACKAGE_ALSA_UTILS_AMIXER=y
BR2_PACKAGE_RECALBOX_ALL_SYSTEMS=y
BR2_PACKAGE_RECALBOX_TOOLS=y
BR2_PACKAGE_RECALBOX_EXTRAS=y
BR2_PACKAGE_RECALBOX_KODI=y
BR2_PACKAGE_UNZIP=y
BR2_PACKAGE_XZ=y
BR2_PACKAGE_ZIP=y
BR2_PACKAGE_P7ZIP=y
BR2_PACKAGE_RECALBOX_SYSTEM=y
BR2_PACKAGE_RECALBOX_TARGET_C2=y
BR2_PACKAGE_RECALBOX_THEMES=y
BR2_PACKAGE_PYTHON_ES_SCRAPER=y
BR2_PACKAGE_QTSIXA_SHANWAN=y
BR2_PACKAGE_XARCADE2JSTICK=y
BR2_PACKAGE_RECALBOX_RETROGAME=y
BR2_PACKAGE_MEGATOOLS=y
BR2_PACKAGE_FBDUMP=y
BR2_PACKAGE_FBGRAB=y
BR2_PACKAGE_FBV=y
BR2_PACKAGE_SDL2_MIXER=y
BR2_PACKAGE_SDL_IMAGE_XPM=y
BR2_PACKAGE_SDL_MIXER=y
BR2_PACKAGE_SDL_NET=y
BR2_PACKAGE_B43_FIRMWARE=y
BR2_PACKAGE_LINUX_FIRMWARE=y
BR2_PACKAGE_LINUX_FIRMWARE_INTEL_SST_DSP=y
BR2_PACKAGE_LINUX_FIRMWARE_ATHEROS_6002=y
BR2_PACKAGE_LINUX_FIRMWARE_ATHEROS_6003=y
BR2_PACKAGE_LINUX_FIRMWARE_ATHEROS_6004=y
BR2_PACKAGE_LINUX_FIRMWARE_ATHEROS_7010=y
BR2_PACKAGE_LINUX_FIRMWARE_ATHEROS_9170=y
BR2_PACKAGE_LINUX_FIRMWARE_ATHEROS_9271=y
BR2_PACKAGE_LINUX_FIRMWARE_ATHEROS_10K_QCA998X=y
BR2_PACKAGE_LINUX_FIRMWARE_ATHEROS_10K_QCA6174=y
BR2_PACKAGE_LINUX_FIRMWARE_BRCM_BCM43XX=y
BR2_PACKAGE_LINUX_FIRMWARE_BRCM_BCM43XXX=y
BR2_PACKAGE_LINUX_FIRMWARE_IWLWIFI_3160=y
BR2_PACKAGE_LINUX_FIRMWARE_IWLWIFI_3168=y
BR2_PACKAGE_LINUX_FIRMWARE_IWLWIFI_5000=y
BR2_PACKAGE_LINUX_FIRMWARE_IWLWIFI_6000G2A=y
BR2_PACKAGE_LINUX_FIRMWARE_IWLWIFI_6000G2B=y
BR2_PACKAGE_LINUX_FIRMWARE_IWLWIFI_7260=y
BR2_PACKAGE_LINUX_FIRMWARE_IWLWIFI_7265D=y
BR2_PACKAGE_LINUX_FIRMWARE_IWLWIFI_8000C=y
BR2_PACKAGE_LINUX_FIRMWARE_IWLWIFI_8265=y
BR2_PACKAGE_LINUX_FIRMWARE_IWLWIFI_9XXX=y
BR2_PACKAGE_LINUX_FIRMWARE_LIBERTAS_SD8686_V8=y
BR2_PACKAGE_LINUX_FIRMWARE_LIBERTAS_SD8686_V9=y
BR2_PACKAGE_LINUX_FIRMWARE_LIBERTAS_SD8688=y
BR2_PACKAGE_LINUX_FIRMWARE_MWIFIEX_SD8787=y
BR2_PACKAGE_LINUX_FIRMWARE_MWIFIEX_SD8797=y
BR2_PACKAGE_LINUX_FIRMWARE_MWIFIEX_USB8797=y
BR2_PACKAGE_LINUX_FIRMWARE_MWIFIEX_SD8887=y
BR2_PACKAGE_LINUX_FIRMWARE_MWIFIEX_SD8897=y
BR2_PACKAGE_LINUX_FIRMWARE_MWIFIEX_USB8897=y
BR2_PACKAGE_LINUX_FIRMWARE_MWIFIEX_PCIE8897=y
BR2_PACKAGE_LINUX_FIRMWARE_MEDIATEK_MT7601U=y
BR2_PACKAGE_LINUX_FIRMWARE_RALINK_RT61=y
BR2_PACKAGE_LINUX_FIRMWARE_RALINK_RT73=y
BR2_PACKAGE_LINUX_FIRMWARE_RALINK_RT2XX=y
BR2_PACKAGE_LINUX_FIRMWARE_RTL_81XX=y
BR2_PACKAGE_LINUX_FIRMWARE_RTL_87XX=y
BR2_PACKAGE_LINUX_FIRMWARE_RTL_88XX=y
BR2_PACKAGE_LINUX_FIRMWARE_TI_WL127X=y
BR2_PACKAGE_LINUX_FIRMWARE_TI_WL128X=y
BR2_PACKAGE_LINUX_FIRMWARE_TI_WL18XX=y
BR2_PACKAGE_UX500_FIRMWARE=y
BR2_PACKAGE_WILC1000_FIRMWARE=y
BR2_PACKAGE_ZD1211_FIRMWARE=y
BR2_PACKAGE_EUDEV_RULES_GEN=y
BR2_PACKAGE_I2C_TOOLS=y
BR2_PACKAGE_KBD=y
BR2_PACKAGE_MALI_450=y
BR2_PACKAGE_NODEJS=y
BR2_PACKAGE_NODEJS_MODULES_ADDITIONAL="request"
BR2_PACKAGE_PYTHON_PY_PYC=y
BR2_PACKAGE_PYTHON_PYGAME=y
BR2_PACKAGE_PYTHON_PYGAME_IMAGE=y
BR2_PACKAGE_PYTHON_PYGAME_FONT=y
BR2_PACKAGE_PYTHON_GOBJECT=y
BR2_PACKAGE_LIBZIP=y
BR2_PACKAGE_LIBOPENSSL_BIN=y
BR2_PACKAGE_MYSQL=y
BR2_PACKAGE_BOOST_ATOMIC=y
# BR2_PACKAGE_AVAHI_AUTOIPD is not set
BR2_PACKAGE_GESFTPSERVER=y
BR2_PACKAGE_NTP=y
BR2_PACKAGE_RSYNC=y
# BR2_TARGET_ROOTFS_TAR is not set
BR2_PACKAGE_LIBCAPSIMAGE=y
BR2_PACKAGE_SAMBA4=y
BR2_PACKAGE_UTIL_LINUX_LIBSMARTCOLS=y
BR2_PACKAGE_UTIL_LINUX_SETTERM=y
BR2_PACKAGE_SSELPH_SCRAPER=y
BR2_PACKAGE_PYTHON_HASHLIB=y
BR2_PACKAGE_BOOST=y
BR2_PACKAGE_PYTHON_PSUTIL=y
BR2_PACKAGE_LIBAMCODEC=y
BR2_PACKAGE_UBOOT_ODROID_C2=y
BR2_PACKAGE_OPENVPN=y
```

## configs/batocera-odroidc4_defconfig
```kconfig
BR2_aarch64=y
BR2_cortex_a55=y
BR2_ARM_FPU_NEON_FP_ARMV8=y
BR2_GCC_VERSION_9_X=y
BR2_OPTIMIZE_3=y
BR2_GCC_ENABLE_LTO=y
BR2_SHARED_STATIC_LIBS=y
BR2_GLOBAL_PATCH_DIR="$(BR2_EXTERNAL_BATOCERA_PATH)/board/batocera/patches $(BR2_EXTERNAL_BATOCERA_PATH)/board/batocera/amlogic/patches $(BR2_EXTERNAL_BATOCERA_PATH)/board/batocera/amlogic/odroidc4/patches"
BR2_TOOLCHAIN_BUILDROOT_GLIBC=y
# required for utf-8
BR2_TOOLCHAIN_GLIBC_GCONV_LIBS_COPY=y
BR2_TOOLCHAIN_BUILDROOT_CXX=y
BR2_ENABLE_LOCALE_WHITELIST="C ar ca de el es es_MX eu_ES fr hu it ja_JP ko nb_NO nl nn_NO oc_FR.UTF-8 pl pt_PT pt_BR ru_RU uk_UA sv_SE tr zh_CN zh_TW"
BR2_GENERATE_LOCALE="en_US.UTF-8 ar_YE.UTF-8 ca_ES.UTF-8 de_DE.UTF-8 el_GR.UTF-8 es_ES.UTF-8 es_MX.UTF-8 eu_ES.UTF-8 fr_FR.UTF-8 hu_HU.UTF-8 it_IT.UTF-8 ja_JP.UTF-8 ko_KR.UTF-8 nb_NO.UTF-8 nl_NL.UTF-8 nn_NO.UTF-8 oc_FR.UTF-8 pl_PL.UTF-8 pt_BR.UTF-8 pt_PT.UTF-8 ru_RU.UTF-8 uk_UA.UTF-8 sv_SE.UTF-8 tr_TR.UTF-8 zh_CN.UTF-8 zh_TW.UTF-8"
BR2_TARGET_OPTIMIZATION="-pipe -fsigned-char"
BR2_TARGET_GENERIC_HOSTNAME="batocera"
BR2_TARGET_GENERIC_ISSUE="PLAY AGAIN"
BR2_INIT_SYSV=y
BR2_ROOTFS_DEVICE_CREATION_DYNAMIC_EUDEV=y
BR2_TARGET_GENERIC_ROOT_PASSWD="linux"
BR2_SYSTEM_BIN_SH_BASH=y
#BR2_TARGET_GENERIC_GETTY_PORT="tty1"
BR2_TARGET_GENERIC_GETTY_BAUDRATE_115200=y
# BR2_TARGET_GENERIC_REMOUNT_ROOTFS_RW is not set
BR2_TARGET_TZ_INFO=y
BR2_TARGET_LOCALTIME="Europe/Paris"
BR2_ROOTFS_OVERLAY="$(BR2_EXTERNAL_BATOCERA_PATH)/board/batocera/fsoverlay $(BR2_EXTERNAL_BATOCERA_PATH)/board/batocera/amlogic/fsoverlay $(BR2_EXTERNAL_BATOCERA_PATH)/board/batocera/amlogic/odroidc4/fsoverlay"
BR2_ROOTFS_POST_BUILD_SCRIPT="$(BR2_EXTERNAL_BATOCERA_PATH)/board/batocera/scripts/post-build-script.sh"
BR2_ROOTFS_POST_IMAGE_SCRIPT="$(BR2_EXTERNAL_BATOCERA_PATH)/board/batocera/scripts/post-image-script.sh"

# Kernel
BR2_LINUX_KERNEL=y
# Force 5.8.x series because of Mali drivers
BR2_PACKAGE_HOST_LINUX_HEADERS_CUSTOM_5_8=y
BR2_LINUX_KERNEL_CUSTOM_VERSION=y
BR2_LINUX_KERNEL_CUSTOM_VERSION_VALUE="5.8.18"
BR2_LINUX_KERNEL_PATCH="$(BR2_EXTERNAL_BATOCERA_PATH)/board/batocera/amlogic/odroidc4/linux_patches"
BR2_LINUX_KERNEL_USE_CUSTOM_CONFIG=y
BR2_LINUX_KERNEL_CUSTOM_CONFIG_FILE="$(BR2_EXTERNAL_BATOCERA_PATH)/board/batocera/amlogic/linux-meson64-current.config"
BR2_LINUX_KERNEL_CONFIG_FRAGMENT_FILES="$(BR2_EXTERNAL_BATOCERA_PATH)/board/batocera/amlogic/odroidc4/linux-defconfig-fragment.config"
BR2_LINUX_KERNEL_DTS_SUPPORT=y
BR2_LINUX_KERNEL_INTREE_DTS_NAME="amlogic/meson-sm1-odroid-c4 amlogic/meson-sm1-khadas-vim3l"
BR2_LINUX_KERNEL_NEEDS_HOST_OPENSSL=y

# System
BR2_PACKAGE_BUSYBOX_CONFIG_FRAGMENT_FILES="$(BR2_EXTERNAL_BATOCERA_PATH)/board/batocera/busybox.custom.config"
BR2_PACKAGE_BATOCERA_ALL_SYSTEMS=y
BR2_PACKAGE_BATOCERA_TOOLS=y
BR2_PACKAGE_BATOCERA_EXTRAS=y
BR2_PACKAGE_BATOCERA_KODI18=y
BR2_PACKAGE_BATOCERA_LINUX_FIRMWARES=y
BR2_PACKAGE_BATOCERA_SYSTEM=y
BR2_PACKAGE_BATOCERA_TARGET_ODROIDC4=y
BR2_PACKAGE_BATOCERA_RETROGAME=y
BR2_PACKAGE_FBDUMP=y
BR2_PACKAGE_FBGRAB=y
BR2_PACKAGE_FBV=y
BR2_PACKAGE_EUDEV_RULES_GEN=y
BR2_PACKAGE_PYTHON_PY_PYC=y
BR2_PACKAGE_PYTHON_GOBJECT=y
BR2_PACKAGE_BOOST_ATOMIC=y
# BR2_PACKAGE_AVAHI_AUTOIPD is not set
# BR2_TARGET_ROOTFS_TAR is not set
BR2_TARGET_ROOTFS_SQUASHFS4_ZSTD=y
BR2_PACKAGE_LIBCAPSIMAGE=y
BR2_PACKAGE_UTIL_LINUX_LIBSMARTCOLS=y
BR2_PACKAGE_UTIL_LINUX_SETTERM=y
BR2_PACKAGE_PYTHON_HASHLIB=y
BR2_PACKAGE_PYTHON_PSUTIL=y

# Hack
BR2_PACKAGE_BATOCERA_TARGET_RPI_ANY=n

# GPU
BR2_PACKAGE_MALI_G31=y

# Firmware
BR2_PACKAGE_UBOOT_AMLOGIC=y

# Bootloader
BR2_TARGET_UBOOT=y
BR2_TARGET_UBOOT_BUILD_SYSTEM_KCONFIG=y
BR2_TARGET_UBOOT_CUSTOM_VERSION=y
BR2_TARGET_UBOOT_CUSTOM_VERSION_VALUE="2020.10"
BR2_TARGET_UBOOT_BOARD_DEFCONFIG="odroid-c4"
BR2_TARGET_UBOOT_NEEDS_DTC=y

# Required tools to create the SD image
BR2_PACKAGE_HOST_DOSFSTOOLS=y
BR2_PACKAGE_HOST_GENIMAGE=y
BR2_PACKAGE_HOST_MESON_TOOLS=y
BR2_PACKAGE_HOST_MTOOLS=y
BR2_PACKAGE_HOST_UBOOT_TOOLS=y

# choices can be put in _defconfig files only
BR2_PACKAGE_BATOCERA_SPLASH_MPV=y

# Enables ccache, strace and gdb
#BR2_PACKAGE_BATOCERA_DEV=y

# Enable experimental packages
#BR2_PACKAGE_BATOCERA_CORES_EXPERIMENTAL=y
```

## configs/batocera-odroidn2_defconfig
```kconfig
BR2_arm=y
BR2_cortex_a73_a53=y
BR2_ARM_FPU_NEON_FP_ARMV8=y
BR2_ARM_INSTRUCTIONS_ARM=y
BR2_ARM_EABIHF=y
BR2_OPTIMIZE_3=y
BR2_SHARED_STATIC_LIBS=y
BR2_GLOBAL_PATCH_DIR="$(BR2_EXTERNAL_BATOCERA_PATH)/board/batocera/patches $(BR2_EXTERNAL_BATOCERA_PATH)/board/batocera/odroidn2/patches"
BR2_LINUX_AARCH64_KERNEL_IN_ARM_USER=y
BR2_TOOLCHAIN_BUILDROOT_GLIBC=y
# required for utf-8
BR2_TOOLCHAIN_GLIBC_GCONV_LIBS_COPY=y
BR2_TOOLCHAIN_BUILDROOT_CXX=y
BR2_ENABLE_LOCALE_WHITELIST="C ar ca de el es eu_ES fr hu it ja_JP ko nb_NO nl nn_NO pl pt_PT pt_BR ru_RU sv_SE tr zh_CN zh_TW"
BR2_GENERATE_LOCALE="en_US.UTF-8 ar_YE.UTF-8 ca_ES.UTF-8 de_DE.UTF-8 el_GR.UTF-8 es_ES.UTF-8 eu_ES.UTF-8 fr_FR.UTF-8 hu_HU.UTF-8 it_IT.UTF-8 ja_JP.UTF-8 ko_KR.UTF-8 nb_NO.UTF-8 nl_NL.UTF-8 nn_NO.UTF-8 pl_PL.UTF-8 pt_BR.UTF-8 pt_PT.UTF-8 ru_RU.UTF-8 sv_SE.UTF-8 tr_TR.UTF-8 zh_CN.UTF-8 zh_TW.UTF-8"
BR2_TARGET_OPTIMIZATION="-pipe -fsigned-char"
BR2_TARGET_GENERIC_HOSTNAME="batocera"
BR2_TARGET_GENERIC_ISSUE="PLAY AGAIN"
BR2_INIT_SYSV=y
BR2_ROOTFS_DEVICE_CREATION_DYNAMIC_EUDEV=y
BR2_TARGET_GENERIC_ROOT_PASSWD="linux"
BR2_SYSTEM_BIN_SH_BASH=y
BR2_TARGET_GENERIC_GETTY_PORT="tty1"
BR2_TARGET_GENERIC_GETTY_BAUDRATE_115200=y
# BR2_TARGET_GENERIC_REMOUNT_ROOTFS_RW is not set
BR2_TARGET_TZ_INFO=y
BR2_TARGET_LOCALTIME="Europe/Paris"
BR2_ROOTFS_OVERLAY="$(BR2_EXTERNAL_BATOCERA_PATH)/board/batocera/fsoverlay $(BR2_EXTERNAL_BATOCERA_PATH)/board/batocera/odroidn2/fsoverlay"
BR2_ROOTFS_POST_BUILD_SCRIPT="$(BR2_EXTERNAL_BATOCERA_PATH)/board/batocera/post-build-script.sh"
BR2_ROOTFS_POST_IMAGE_SCRIPT="$(BR2_EXTERNAL_BATOCERA_PATH)/board/batocera/post-image-script.sh"
BR2_LINUX_KERNEL=y
BR2_LINUX_KERNEL_CUSTOM_GIT=y
BR2_LINUX_KERNEL_CUSTOM_REPO_URL="https://github.com/hardkernel/linux.git"
BR2_LINUX_KERNEL_CUSTOM_REPO_VERSION="3b4dc50c68233a472c5785c7738a969070e8e1f9"
BR2_LINUX_KERNEL_PATCH="$(BR2_EXTERNAL_BATOCERA_PATH)/board/batocera/odroidn2/linux_patches"
BR2_LINUX_KERNEL_USE_CUSTOM_CONFIG=y
BR2_LINUX_KERNEL_CUSTOM_CONFIG_FILE="$(BR2_EXTERNAL_BATOCERA_PATH)/board/batocera/odroidn2/linux_odroidn2-defconfig.config"
BR2_LINUX_KERNEL_CONFIG_FRAGMENT_FILES="$(BR2_EXTERNAL_BATOCERA_PATH)/board/batocera/odroidn2/linux-defconfig-fragment.config"
BR2_LINUX_KERNEL_DTS_SUPPORT=y
BR2_LINUX_KERNEL_INTREE_DTS_NAME="amlogic/meson-g12b-odroid-n2"
BR2_LINUX_KERNEL_IMAGE_TARGET_CUSTOM=y
BR2_LINUX_KERNEL_IMAGE_TARGET_NAME="Image"
BR2_PACKAGE_HOST_LINUX_HEADERS_CUSTOM_5_4=y
BR2_PACKAGE_BUSYBOX_CONFIG_FRAGMENT_FILES="$(BR2_EXTERNAL_BATOCERA_PATH)/board/batocera/busybox.custom.config"
BR2_PACKAGE_BATOCERA_ALL_SYSTEMS=y
BR2_PACKAGE_BATOCERA_TOOLS=y
BR2_PACKAGE_BATOCERA_EXTRAS=y
BR2_PACKAGE_BATOCERA_KODI18=y
BR2_PACKAGE_BATOCERA_LINUX_FIRMWARES=y
BR2_PACKAGE_BATOCERA_SYSTEM=y
BR2_PACKAGE_BATOCERA_TARGET_ODROIDN2=y
BR2_PACKAGE_BATOCERA_RETROGAME=y
BR2_PACKAGE_FBDUMP=y
BR2_PACKAGE_FBGRAB=y
BR2_PACKAGE_FBV=y
BR2_PACKAGE_SDL2_KMSDRM=y
BR2_PACKAGE_LIBDRM=y
BR2_PACKAGE_EUDEV_RULES_GEN=y
BR2_PACKAGE_MALI_G52=y
BR2_PACKAGE_PYTHON_PY_PYC=y
BR2_PACKAGE_PYTHON_GOBJECT=y
BR2_PACKAGE_BOOST_ATOMIC=y
# BR2_PACKAGE_AVAHI_AUTOIPD is not set
# BR2_TARGET_ROOTFS_TAR is not set
BR2_PACKAGE_LIBCAPSIMAGE=y
BR2_PACKAGE_UTIL_LINUX_LIBSMARTCOLS=y
BR2_PACKAGE_UTIL_LINUX_SETTERM=y
BR2_PACKAGE_PYTHON_HASHLIB=y
BR2_PACKAGE_PYTHON_PSUTIL=y
BR2_PACKAGE_UBOOT_ODROID_N2=y
BR2_PACKAGE_HOST_UBOOT_TOOLS=y

# choices can be put in _defconfig files only
# BR2_PACKAGE_BATOCERA_SPLASH_FFPLAY : splash must not be running while es is trying to start otherwise graphics won't initialize

# Enables ccache, strace and gdb
#BR2_PACKAGE_BATOCERA_DEV=y

# Enable experimental packages
#BR2_PACKAGE_BATOCERA_CORES_EXPERIMENTAL=y
```
