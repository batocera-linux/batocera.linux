## configs/batocera-odroidxu4_defconfig
```kconfig
# Target definition
BR2_arm=y
BR2_cortex_a15=y
BR2_ARM_FPU_NEON_VFPV4=y
BR2_PACKAGE_BATOCERA_TARGET_XU4=y
BR2_ROOTFS_USERS_TABLES="$(BR2_EXTERNAL_BATOCERA_PATH)/board/batocera/users.txt"

# Toolchain definition
BR2_GCC_VERSION_10_X=y
BR2_GCC_ENABLE_GRAPHITE=y
BR2_GCC_ENABLE_LTO=y
BR2_OPTIMIZE_3=y
BR2_SHARED_STATIC_LIBS=y
BR2_TOOLCHAIN_BUILDROOT_GLIBC=y
# required for utf-8
BR2_TOOLCHAIN_GLIBC_GCONV_LIBS_COPY=y
BR2_TOOLCHAIN_BUILDROOT_CXX=y
BR2_ENABLE_LOCALE_WHITELIST="C ar ca cy_GB de el es es_MX eu_ES fr hu it ja_JP ko nb_NO nl nn_NO oc_FR.UTF-8 pl pt_PT pt_BR ru_RU uk_UA sv_SE tr zh_CN zh_TW"
BR2_GENERATE_LOCALE="en_US.UTF-8 ar_YE.UTF-8 ca_ES.UTF-8 cy_GB.UTF-8 de_DE.UTF-8 el_GR.UTF-8 es_ES.UTF-8 es_MX.UTF-8 eu_ES.UTF-8 fr_FR.UTF-8 hu_HU.UTF-8 it_IT.UTF-8 ja_JP.UTF-8 ko_KR.UTF-8 nb_NO.UTF-8 nl_NL.UTF-8 nn_NO.UTF-8 oc_FR.UTF-8 pl_PL.UTF-8 pt_BR.UTF-8 pt_PT.UTF-8 ru_RU.UTF-8 uk_UA.UTF-8 sv_SE.UTF-8 tr_TR.UTF-8 zh_CN.UTF-8 zh_TW.UTF-8"
BR2_TARGET_OPTIMIZATION="-pipe -fsigned-char"
BR2_TARGET_GENERIC_HOSTNAME="batocera"
BR2_TARGET_GENERIC_ISSUE="PLAY AGAIN"
BR2_INIT_SYSV=y
BR2_ROOTFS_DEVICE_CREATION_DYNAMIC_EUDEV=y
BR2_TARGET_GENERIC_ROOT_PASSWD="linux"
#BR2_TARGET_GENERIC_GETTY_PORT="tty1"
BR2_TARGET_GENERIC_GETTY_BAUDRATE_115200=y
# BR2_TARGET_GENERIC_REMOUNT_ROOTFS_RW is not set
BR2_TARGET_TZ_INFO=y
BR2_TARGET_LOCALTIME="Europe/Paris"
BR2_GLOBAL_PATCH_DIR="$(BR2_EXTERNAL_BATOCERA_PATH)/board/batocera/patches $(BR2_EXTERNAL_BATOCERA_PATH)/board/batocera/odroidxu4/patches"
BR2_ROOTFS_OVERLAY="$(BR2_EXTERNAL_BATOCERA_PATH)/board/batocera/fsoverlay $(BR2_EXTERNAL_BATOCERA_PATH)/board/batocera/odroidxu4/fsoverlay"
BR2_ROOTFS_POST_BUILD_SCRIPT="$(BR2_EXTERNAL_BATOCERA_PATH)/board/batocera/scripts/post-build-script.sh"
BR2_ROOTFS_POST_IMAGE_SCRIPT="$(BR2_EXTERNAL_BATOCERA_PATH)/board/batocera/scripts/post-image-script.sh"

# Kernel
BR2_LINUX_KERNEL=y
# Force 5.8.x series because of Mali drivers
BR2_PACKAGE_HOST_LINUX_HEADERS_CUSTOM_5_8=y
BR2_LINUX_KERNEL_CUSTOM_VERSION=y
BR2_LINUX_KERNEL_CUSTOM_VERSION_VALUE="5.8.18"
BR2_LINUX_KERNEL_PATCH="$(BR2_EXTERNAL_BATOCERA_PATH)/board/batocera/odroidxu4/linux_patches"
BR2_LINUX_KERNEL_USE_CUSTOM_CONFIG=y
BR2_LINUX_KERNEL_CUSTOM_CONFIG_FILE="$(BR2_EXTERNAL_BATOCERA_PATH)/board/batocera/odroidxu4/linux-defconfig.config"
BR2_LINUX_KERNEL_CONFIG_FRAGMENT_FILES="$(BR2_EXTERNAL_BATOCERA_PATH)/board/batocera/odroidxu4/linux-defconfig-fragment.config"
BR2_LINUX_KERNEL_DTS_SUPPORT=y
BR2_LINUX_KERNEL_INTREE_DTS_NAME="exynos5422-odroidxu4"
BR2_LINUX_KERNEL_NEEDS_HOST_OPENSSL=y

# System
BR2_PACKAGE_BUSYBOX_CONFIG_FRAGMENT_FILES="$(BR2_EXTERNAL_BATOCERA_PATH)/board/batocera/busybox.custom.config"
BR2_SYSTEM_BIN_SH_DASH=y # /bin/sh implementation; set here because a `choice` cannot be `select`ed, e.g. from batocera-system/Config.in
BR2_PACKAGE_BATOCERA_ALL_SYSTEMS=y
BR2_PACKAGE_BATOCERA_TOOLS=y
BR2_PACKAGE_BATOCERA_EXTRAS=y
BR2_PACKAGE_BATOCERA_KODI19=y
BR2_PACKAGE_BATOCERA_LINUX_FIRMWARES=y
BR2_PACKAGE_BATOCERA_SYSTEM=y
BR2_PACKAGE_FBDUMP=y
BR2_PACKAGE_FBGRAB=y
BR2_PACKAGE_FBV=y
BR2_PACKAGE_EUDEV_RULES_GEN=y
BR2_PACKAGE_BOOST_ATOMIC=y
# BR2_PACKAGE_AVAHI_AUTOIPD is not set
# BR2_TARGET_ROOTFS_TAR is not set
BR2_TARGET_ROOTFS_SQUASHFS4_ZSTD=y
BR2_PACKAGE_UTIL_LINUX_LIBSMARTCOLS=y
BR2_PACKAGE_UTIL_LINUX_SETTERM=y

# Python and LUA choices
BR2_PACKAGE_PYTHON3_PY_PYC=y
BR2_PACKAGE_PYTHON_HASHLIB=y
BR2_PACKAGE_LUA_5_1=y

# GPU
BR2_PACKAGE_MALI_T620_WAYLAND=y
BR2_PACKAGE_LIBCEC_EXYNOS_API=y

# Firmware
BR2_PACKAGE_UBOOT_ODROID_XU4=y

# Bootloader
BR2_TARGET_UBOOT=y
BR2_TARGET_UBOOT_BUILD_SYSTEM_KCONFIG=y
BR2_TARGET_UBOOT_CUSTOM_VERSION=y
BR2_TARGET_UBOOT_CUSTOM_VERSION_VALUE="2020.10"
BR2_TARGET_UBOOT_BOARD_DEFCONFIG="odroid-xu4"
BR2_TARGET_UBOOT_NEEDS_DTC=y

# Required tools to create the SD image
BR2_PACKAGE_HOST_DOSFSTOOLS=y
BR2_PACKAGE_HOST_GENIMAGE=y
BR2_PACKAGE_HOST_MTOOLS=y
BR2_PACKAGE_HOST_UBOOT_TOOLS=y

# Batocera
#BR2_PACKAGE_BATOCERA_DEV=y
#BR2_PACKAGE_BATOCERA_DEBUG=y
#BR2_PACKAGE_BATOCERA_CORES_EXPERIMENTAL=y

# Enables ccache
BR2_CCACHE=y
```

## configs/batocera-orangepi-zero2_defconfig
```kconfig
# Target definition
BR2_aarch64=y
BR2_cortex_a53=y
BR2_ARM_FPU_NEON_FP_ARMV8=y
BR2_PACKAGE_BATOCERA_TARGET_ORANGEPI_ZERO2=y
BR2_ROOTFS_USERS_TABLES="$(BR2_EXTERNAL_BATOCERA_PATH)/board/batocera/users.txt"

# Toolchain definition
BR2_GCC_VERSION_11_X=y
BR2_GCC_ENABLE_GRAPHITE=y
BR2_GCC_ENABLE_LTO=y
BR2_OPTIMIZE_3=y
BR2_SHARED_STATIC_LIBS=y
BR2_TOOLCHAIN_BUILDROOT_GLIBC=y
# required for utf-8
BR2_TOOLCHAIN_GLIBC_GCONV_LIBS_COPY=y
BR2_TOOLCHAIN_BUILDROOT_CXX=y
BR2_TARGET_OPTIMIZATION="-pipe -fsigned-char"
BR2_TARGET_GENERIC_HOSTNAME="batocera"
BR2_TARGET_GENERIC_ISSUE="READY TO RETRO"
BR2_INIT_SYSV=y
BR2_ROOTFS_DEVICE_CREATION_DYNAMIC_EUDEV=y
BR2_TARGET_GENERIC_ROOT_PASSWD="linux"
#BR2_TARGET_GENERIC_GETTY_PORT="tty1"
BR2_TARGET_GENERIC_GETTY_BAUDRATE_115200=y
# BR2_TARGET_GENERIC_REMOUNT_ROOTFS_RW is not set
BR2_ENABLE_LOCALE_WHITELIST="C ar ca cs_CZ cy cy_GB cy de en el es es_MX eu eu_ES fr fr_FR he hu it ja ja_JP ja ko nb nb_NO nl nn nn_NO oc oc_FR pl pt pt_PT pt_BR ru ru_RU uk uk_UA sv sv_SE tr zh zh_CN zh_TW"
BR2_GENERATE_LOCALE="en_US.UTF-8 ar_YE.UTF-8 ca_ES.UTF-8 cs_CZ.UTF-8 cy_GB.UTF-8 de_DE.UTF-8 el_GR.UTF-8 en_GB.UTF-8 es_ES.UTF-8 es_MX.UTF-8 eu_ES.UTF-8 fr_FR.UTF-8 he_IL.UTF-8 hu_HU.UTF-8 it_IT.UTF-8 ja_JP.UTF-8 ko_KR.UTF-8 nb_NO.UTF-8 nl_NL.UTF-8 nn_NO.UTF-8 oc_FR.UTF-8 pl_PL.UTF-8 pt_BR.UTF-8 pt_PT.UTF-8 ru_RU.UTF-8 uk_UA.UTF-8 sv_SE.UTF-8 tr_TR.UTF-8 zh_CN.UTF-8 zh_TW.UTF-8"
BR2_TARGET_TZ_INFO=y
BR2_TARGET_LOCALTIME="Europe/Paris"
BR2_GLOBAL_PATCH_DIR="$(BR2_EXTERNAL_BATOCERA_PATH)/board/batocera/patches $(BR2_EXTERNAL_BATOCERA_PATH)/board/batocera/orangepi-zero2/patches"
BR2_ROOTFS_OVERLAY="$(BR2_EXTERNAL_BATOCERA_PATH)/board/batocera/fsoverlay $(BR2_EXTERNAL_BATOCERA_PATH)/board/batocera/orangepi-zero2/fsoverlay"
BR2_ROOTFS_POST_BUILD_SCRIPT="$(BR2_EXTERNAL_BATOCERA_PATH)/board/batocera/scripts/post-build-script.sh"
BR2_ROOTFS_POST_IMAGE_SCRIPT="$(BR2_EXTERNAL_BATOCERA_PATH)/board/batocera/scripts/post-image-script.sh"
BR2_TARGET_ROOTFS_SQUASHFS4_ZSTD=y

# Arm Trusted Firmware
BR2_TARGET_ARM_TRUSTED_FIRMWARE=y
BR2_TARGET_ARM_TRUSTED_FIRMWARE_CUSTOM_VERSION=y
BR2_TARGET_ARM_TRUSTED_FIRMWARE_CUSTOM_VERSION_VALUE="v2.5"
BR2_TARGET_ARM_TRUSTED_FIRMWARE_PLATFORM="sun50i_h616"
BR2_TARGET_ARM_TRUSTED_FIRMWARE_BL31=y
BR2_TARGET_ARM_TRUSTED_FIRMWARE_BL31_UBOOT=y
BR2_TARGET_ARM_TRUSTED_FIRMWARE_SSP=n
BR2_TARGET_ARM_TRUSTED_FIRMWARE_SSP_LEVEL="none"

# Bootloader
BR2_TARGET_UBOOT=y
BR2_TARGET_UBOOT_BUILD_SYSTEM_KCONFIG=y
BR2_TARGET_UBOOT_CUSTOM_VERSION=y
BR2_TARGET_UBOOT_CUSTOM_VERSION_VALUE="2022.01"
BR2_TARGET_UBOOT_BOARD_DEFCONFIG="orangepi_zero2"
BR2_TARGET_UBOOT_NEEDS_DTC=y
BR2_TARGET_UBOOT_NEEDS_PYLIBFDT=y
BR2_TARGET_UBOOT_NEEDS_ATF_BL31=y
BR2_TARGET_UBOOT_SPL=y
BR2_TARGET_UBOOT_SPL_NAME="u-boot-sunxi-with-spl.bin"

# Linux headers same as kernel, a 5.16 series
BR2_PACKAGE_HOST_LINUX_HEADERS_CUSTOM_5_16=y

# Kernel
BR2_LINUX_KERNEL=y
BR2_LINUX_KERNEL_CUSTOM_GIT=y
BR2_LINUX_KERNEL_CUSTOM_REPO_URL="https://github.com/orangepi-xunlong/linux-orangepi"
BR2_LINUX_KERNEL_CUSTOM_REPO_VERSION="b8d7374fd401d0d0de9647922f5288fdc99103b3"
BR2_LINUX_KERNEL_USE_CUSTOM_CONFIG=y
BR2_LINUX_KERNEL_CUSTOM_CONFIG_FILE="$(BR2_EXTERNAL_BATOCERA_PATH)/board/batocera/orangepi-zero2/linux-defconfig.config"
BR2_LINUX_KERNEL_DTS_SUPPORT=y
BR2_LINUX_KERNEL_INTREE_DTS_NAME="allwinner/sun50i-h616-orangepi-zero2"
BR2_LINUX_KERNEL_NEEDS_HOST_OPENSSL=y
BR2_LINUX_KERNEL_PATCH="$(BR2_EXTERNAL_BATOCERA_PATH)/board/batocera/orangepi-zero2/linux_patches"
BR2_LINUX_KERNEL_CONFIG_FRAGMENT_FILES="$(BR2_EXTERNAL_BATOCERA_PATH)/board/batocera/orangepi-zero2/linux-defconfig-fragment.config"

BR2_PACKAGE_BATOCERA_SYSTEM=y
BR2_PACKAGE_BATOCERA_EXTRAS=y
BR2_PACKAGE_BATOCERA_TOOLS=y
BR2_PACKAGE_BATOCERA_ALL_SYSTEMS=y
BR2_PACKAGE_BATOCERA_KODI19=n
BR2_PACKAGE_BATOCERA_LINUX_FIRMWARES=y
BR2_PACKAGE_LIBENET=y
BR2_PACKAGE_BUSYBOX_CONFIG_FRAGMENT_FILES="$(BR2_EXTERNAL_BATOCERA_PATH)/board/batocera/busybox.custom.config"
BR2_SYSTEM_BIN_SH_DASH=y # /bin/sh implementation; set here because a `choice` cannot be `select`ed, e.g. from batocera-system/Config.in

BR2_PACKAGE_ESPEAK=y
BR2_PACKAGE_ESPEAK_AUDIO_BACKEND_ALSA=y

# Python and LUA choices
BR2_PACKAGE_PYTHON3_PY_PYC=y
BR2_PACKAGE_PYTHON_HASHLIB=y
BR2_PACKAGE_LUA_5_1=y

# GPU
BR2_PACKAGE_BATOCERA_PANFROST_MESA3D=y

# Filesystem
BR2_PACKAGE_HOST_DOSFSTOOLS=y
BR2_PACKAGE_HOST_GENIMAGE=y
BR2_PACKAGE_HOST_MTOOLS=y

# wireless tools
BR2_PACKAGE_IW=y
BR2_PACKAGE_WPA_SUPPLICANT=y
BR2_PACKAGE_WPA_SUPPLICANT_NL80211=y
BR2_PACKAGE_WPA_SUPPLICANT_AP_SUPPORT=y
BR2_PACKAGE_WPA_SUPPLICANT_PASSPHRASE=y

# spi flash support
BR2_PACKAGE_MTD=y

BR2_CCACHE=y
```

## configs/batocera-rk3326_defconfig
```kconfig
# Target definition
BR2_aarch64=y
BR2_cortex_a35=y
BR2_ARM_FPU_NEON_FP_ARMV8=y
BR2_PACKAGE_BATOCERA_TARGET_RK3326=y
BR2_ROOTFS_USERS_TABLES="$(BR2_EXTERNAL_BATOCERA_PATH)/board/batocera/users.txt"

# Toolchain definition
BR2_GCC_VERSION_10_X=y
BR2_GCC_ENABLE_GRAPHITE=y
BR2_GCC_ENABLE_LTO=y
BR2_OPTIMIZE_3=y
BR2_SHARED_STATIC_LIBS=y
BR2_TOOLCHAIN_BUILDROOT_GLIBC=y

# required for utf-8
BR2_TOOLCHAIN_GLIBC_GCONV_LIBS_COPY=y
BR2_TOOLCHAIN_BUILDROOT_CXX=y
BR2_ENABLE_LOCALE_WHITELIST="C ar ca cs_CZ cy cy_GB cy de en el es es_MX eu eu_ES fr fr_FR he hu it ja ja_JP ja ko nb nb_NO nl nn nn_NO oc oc_FR pl pt pt_PT pt_BR ru ru_RU uk uk_UA sv sv_SE tr zh zh_CN zh_TW"
BR2_GENERATE_LOCALE="en_US.UTF-8 ar_YE.UTF-8 ca_ES.UTF-8 cs_CZ.UTF-8 cy_GB.UTF-8 de_DE.UTF-8 el_GR.UTF-8 en_GB.UTF-8 es_ES.UTF-8 es_MX.UTF-8 eu_ES.UTF-8 fr_FR.UTF-8 he_IL.UTF-8 hu_HU.UTF-8 it_IT.UTF-8 ja_JP.UTF-8 ko_KR.UTF-8 nb_NO.UTF-8 nl_NL.UTF-8 nn_NO.UTF-8 oc_FR.UTF-8 pl_PL.UTF-8 pt_BR.UTF-8 pt_PT.UTF-8 ru_RU.UTF-8 uk_UA.UTF-8 sv_SE.UTF-8 tr_TR.UTF-8 zh_CN.UTF-8 zh_TW.UTF-8"
BR2_TARGET_OPTIMIZATION="-pipe -fsigned-char -mcpu=cortex-a35 -mtune=cortex-a35"
BR2_TARGET_GENERIC_HOSTNAME="batocera"
BR2_TARGET_GENERIC_ISSUE="READY TO RETRO"
BR2_INIT_SYSV=y
BR2_ROOTFS_DEVICE_CREATION_DYNAMIC_EUDEV=y
BR2_TARGET_GENERIC_ROOT_PASSWD="linux"
BR2_TARGET_GENERIC_GETTY_BAUDRATE_115200=y
BR2_TARGET_TZ_INFO=y
BR2_TARGET_LOCALTIME="Europe/Paris"
BR2_GLOBAL_PATCH_DIR="$(BR2_EXTERNAL_BATOCERA_PATH)/board/batocera/patches $(BR2_EXTERNAL_BATOCERA_PATH)/board/batocera/rockchip/patches $(BR2_EXTERNAL_BATOCERA_PATH)/board/batocera/rockchip/rk3326/patches"
BR2_ROOTFS_OVERLAY="$(BR2_EXTERNAL_BATOCERA_PATH)/board/batocera/fsoverlay $(BR2_EXTERNAL_BATOCERA_PATH)/board/batocera/rockchip/fsoverlay $(BR2_EXTERNAL_BATOCERA_PATH)/board/batocera/rockchip/rk3326/fsoverlay"
BR2_ROOTFS_POST_BUILD_SCRIPT="$(BR2_EXTERNAL_BATOCERA_PATH)/board/batocera/scripts/post-build-script.sh"
BR2_ROOTFS_POST_IMAGE_SCRIPT="$(BR2_EXTERNAL_BATOCERA_PATH)/board/batocera/scripts/post-image-script.sh"

# Linux headers same as kernel, a 4.4 series
BR2_PACKAGE_HOST_LINUX_HEADERS_CUSTOM_4_4=y

# Kernel
BR2_LINUX_KERNEL=y
BR2_LINUX_KERNEL_CUSTOM_TARBALL=y
BR2_LINUX_KERNEL_CUSTOM_TARBALL_LOCATION="$(call github,shantigilbert,hardkernel-linux,d167de7358c9c53d5e6592978f7cdde7674c420b)/d167de7358c9c53d5e6592978f7cdde7674c420b.tar.gz"
BR2_LINUX_KERNEL_PATCH="$(BR2_EXTERNAL_BATOCERA_PATH)/board/batocera/rockchip/rk3326/linux_patches"
BR2_LINUX_KERNEL_USE_CUSTOM_CONFIG=y
BR2_LINUX_KERNEL_CUSTOM_CONFIG_FILE="$(BR2_EXTERNAL_BATOCERA_PATH)/board/batocera/rockchip/rk3326/linux-defconfig.config"
BR2_LINUX_KERNEL_CONFIG_FRAGMENT_FILES="$(BR2_EXTERNAL_BATOCERA_PATH)/board/batocera/rockchip/rk3326/linux-defconfig-fragment.config"
BR2_LINUX_KERNEL_NEEDS_HOST_OPENSSL=y

# Build the DTB from the kernel sources
BR2_LINUX_KERNEL_DTS_SUPPORT=y
BR2_LINUX_KERNEL_INTREE_DTS_NAME="rockchip/rk3326-gameforce-linux rockchip/rk3326-odroidgo2-linux rockchip/rk3326-odroidgo2-linux-v11 rockchip/rk3326-odroidgo3-linux"
BR2_LINUX_KERNEL_CUSTOM_DTS_PATH="$(BR2_EXTERNAL_BATOCERA_PATH)/board/batocera/rockchip/rk3326/dts/rk3326-rg351p-linux.dts"

# System
BR2_PACKAGE_BUSYBOX_CONFIG_FRAGMENT_FILES="$(BR2_EXTERNAL_BATOCERA_PATH)/board/batocera/busybox.custom.config"
BR2_SYSTEM_BIN_SH_DASH=y # /bin/sh implementation; set here because a `choice` cannot be `select`ed, e.g. from batocera-system/Config.in

# Batocera System
BR2_PACKAGE_BATOCERA_ALL_SYSTEMS=y
BR2_PACKAGE_BATOCERA_TOOLS=y
BR2_PACKAGE_BATOCERA_EXTRAS=y
BR2_PACKAGE_BATOCERA_KODI19=n
BR2_PACKAGE_BATOCERA_LINUX_FIRMWARES=y
BR2_PACKAGE_BATOCERA_SYSTEM=y

# gpu
BR2_PACKAGE_MALI_G31_GBM=y

BR2_PACKAGE_ESPEAK=y
BR2_PACKAGE_ESPEAK_AUDIO_BACKEND_ALSA=y

# Python and LUA choices
BR2_PACKAGE_PYTHON3_PY_PYC=y
BR2_PACKAGE_PYTHON_HASHLIB=y
BR2_PACKAGE_LUA_5_1=y

# Bootloader
BR2_PACKAGE_UBOOT_ODROID_GOA=y
BR2_PACKAGE_UBOOT_GAMEFORCE=y

# batocera splash screen
BR2_PACKAGE_BATOCERA_SPLASH_MPV=y

# Controller
BR2_PACKAGE_XBOXDRV=y
BR2_PACKAGE_UINPUT_JOYSTICK=y

# Batocera
#BR2_PACKAGE_BATOCERA_DEV=y
#BR2_PACKAGE_BATOCERA_DEBUG=y
#BR2_PACKAGE_BATOCERA_CORES_EXPERIMENTAL=y

# Enables ccache
BR2_CCACHE=y
```
