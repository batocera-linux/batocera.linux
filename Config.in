## configs/batocera-s912_defconfig
```kconfig
BR2_aarch64=y
BR2_cortex_a53=y
BR2_OPTIMIZE_3=y
BR2_GCC_ENABLE_LTO=y
BR2_SHARED_STATIC_LIBS=y
BR2_GLOBAL_PATCH_DIR="$(BR2_EXTERNAL_BATOCERA_PATH)/board/batocera/patches $(BR2_EXTERNAL_BATOCERA_PATH)/board/batocera/s912/patches"
BR2_TOOLCHAIN_BUILDROOT_GLIBC=y
BR2_PACKAGE_HOST_LINUX_HEADERS_CUSTOM_3_14=y
BR2_TOOLCHAIN_BUILDROOT_CXX=y
BR2_ENABLE_LOCALE_WHITELIST="C ar ca de el es es_MX eu_ES fr hu it ja_JP ko nb_NO nl nn_NO oc_FR.UTF-8 pl pt_PT pt_BR ru_RU uk_UA sv_SE tr zh_CN zh_TW"
BR2_GENERATE_LOCALE="en_US.UTF-8 ar_YE.UTF-8 ca_ES.UTF-8 de_DE.UTF-8 el_GR.UTF-8 es_ES.UTF-8 es_MX.UTF-8 eu_ES.UTF-8 fr_FR.UTF-8 hu_HU.UTF-8 it_IT.UTF-8 ja_JP.UTF-8 ko_KR.UTF-8 nb_NO.UTF-8 nl_NL.UTF-8 nn_NO.UTF-8 oc_FR.UTF-8 pl_PL.UTF-8 pt_BR.UTF-8 pt_PT.UTF-8 ru_RU.UTF-8 uk_UA.UTF-8 sv_SE.UTF-8 tr_TR.UTF-8 zh_CN.UTF-8 zh_TW.UTF-8"
BR2_TARGET_OPTIMIZATION="-pipe -fsigned-char"
BR2_TARGET_GENERIC_HOSTNAME="batocera"
BR2_TARGET_GENERIC_ISSUE="PLAY AGAIN"
BR2_INIT_SYSV=y
BR2_ROOTFS_DEVICE_CREATION_DYNAMIC_EUDEV=y
BR2_TARGET_GENERIC_ROOT_PASSWD="linux"
BR2_SYSTEM_BIN_SH_BASH=y
BR2_TARGET_GENERIC_GETTY_PORT="tty1"
BR2_TARGET_GENERIC_GETTY_BAUDRATE_115200=y
# BR2_TARGET_GENERIC_REMOUNT_ROOTFS_RW is not set
BR2_TARGET_TZ_INFO=y
BR2_TARGET_LOCALTIME="Europe/Paris"
BR2_ROOTFS_OVERLAY="$(BR2_EXTERNAL_BATOCERA_PATH)/board/batocera/fsoverlay $(BR2_EXTERNAL_BATOCERA_PATH)/board/batocera/s912/fsoverlay"
BR2_ROOTFS_POST_BUILD_SCRIPT="$(BR2_EXTERNAL_BATOCERA_PATH)/board/batocera/post-build-script.sh"
BR2_ROOTFS_POST_IMAGE_SCRIPT="$(BR2_EXTERNAL_BATOCERA_PATH)/board/batocera/post-image-script.sh"
BR2_LINUX_KERNEL=y
BR2_LINUX_KERNEL_CUSTOM_TARBALL=y
BR2_LINUX_KERNEL_CUSTOM_TARBALL_LOCATION="https://github.com/kszaq/linux-amlogic-le/archive/79b5701.tar.gz"
BR2_LINUX_KERNEL_VERSION="custom"
BR2_LINUX_KERNEL_PATCH="$(BR2_EXTERNAL_BATOCERA_PATH)/board/batocera/s912/linux_patches"
BR2_LINUX_KERNEL_USE_CUSTOM_CONFIG=y
BR2_LINUX_KERNEL_CUSTOM_CONFIG_FILE="$(BR2_EXTERNAL_BATOCERA_PATH)/board/batocera/s912/linux-defconfig.config"
BR2_LINUX_KERNEL_CONFIG_FRAGMENT_FILES="$(BR2_EXTERNAL_BATOCERA_PATH)/board/batocera/s912/linux-defconfig-fragment.config"
BR2_LINUX_KERNEL_DTS_SUPPORT=y
BR2_LINUX_KERNEL_INTREE_DTS_NAME="amlogic/gxm_q200_2g amlogic/gxm_q201_1g amlogic/gxm_q201_2g amlogic/gxm_q20xrmii_2g"
BR2_LINUX_KERNEL_INSTALL_TARGET=y
BR2_PACKAGE_BUSYBOX_CONFIG_FRAGMENT_FILES="$(BR2_EXTERNAL_BATOCERA_PATH)/board/batocera/busybox.custom.config"
BR2_PACKAGE_BATOCERA_ALL_SYSTEMS=y
BR2_PACKAGE_BATOCERA_TOOLS=y
BR2_PACKAGE_BATOCERA_EXTRAS=y
BR2_PACKAGE_BATOCERA_LINUX_FIRMWARES=y
BR2_PACKAGE_BATOCERA_SYSTEM=y
BR2_PACKAGE_BATOCERA_TARGET_S912=y
BR2_PACKAGE_ANDROID_HEADERS=y
BR2_PACKAGE_LIBHYBRIS=y
BR2_PACKAGE_OPENGL_MESON_T82X=y
BR2_PACKAGE_GPU_AML_T8XX=y
BR2_PACKAGE_FBDUMP=y
BR2_PACKAGE_FBGRAB=y
BR2_PACKAGE_FBV=y
BR2_PACKAGE_EUDEV_RULES_GEN=y
BR2_PACKAGE_PYTHON_PY_PYC=y
BR2_PACKAGE_PYTHON_GOBJECT=y
BR2_PACKAGE_BOOST_ATOMIC=y
# BR2_PACKAGE_AVAHI_AUTOIPD is not set
BR2_PACKAGE_HOST_UBOOT_TOOLS=y
BR2_PACKAGE_HOST_AML_DTBTOOLS=y
BR2_PACKAGE_HOST_PYTHON_MKBOOTIMG=y
# BR2_TARGET_ROOTFS_TAR is not set
BR2_PACKAGE_LIBCAPSIMAGE=y
BR2_PACKAGE_UTIL_LINUX_LIBSMARTCOLS=y
BR2_PACKAGE_UTIL_LINUX_SETTERM=y
BR2_PACKAGE_PYTHON_HASHLIB=y
BR2_PACKAGE_PYTHON_PSUTIL=y

# device trees
BR2_PACKAGE_DEVICE_TREES_AML_S9XX=y
BR2_PACKAGE_DEVICE_TREES_AML_S9XX_GXM_KVIM2=y
BR2_PACKAGE_DEVICE_TREES_AML_S9XX_GXM_Q20X=y

# Enables ccache, strace and gdb
#BR2_PACKAGE_BATOCERA_DEV=y

# Enable experimental packages
#BR2_PACKAGE_BATOCERA_CORES_EXPERIMENTAL=y
```

## configs/batocera-s922x_defconfig
```kconfig
# Target definition
BR2_aarch64=y
BR2_cortex_a73_a53=y
BR2_ARM_FPU_NEON_FP_ARMV8=y
BR2_PACKAGE_BATOCERA_TARGET_S922X=y
BR2_ROOTFS_USERS_TABLES="$(BR2_EXTERNAL_BATOCERA_PATH)/board/batocera/users.txt"

# Toolchain definition
BR2_GCC_VERSION_11_X=y
BR2_GCC_ENABLE_GRAPHITE=y
BR2_GCC_ENABLE_LTO=y
BR2_OPTIMIZE_3=y
BR2_SHARED_STATIC_LIBS=y
BR2_TOOLCHAIN_BUILDROOT_GLIBC=y
# required for utf-8
BR2_TOOLCHAIN_GLIBC_GCONV_LIBS_COPY=y
BR2_TOOLCHAIN_BUILDROOT_CXX=y
BR2_ENABLE_LOCALE_WHITELIST="C ar ca cs_CZ cy cy_GB cy de en el es es_MX eu eu_ES fr fr_FR he hu it ja ja_JP ja ko nb nb_NO nl nn nn_NO oc oc_FR pl pt pt_PT pt_BR ru ru_RU uk uk_UA sv sv_SE tr zh zh_CN zh_TW"
BR2_GENERATE_LOCALE="en_US.UTF-8 ar_YE.UTF-8 ca_ES.UTF-8 cs_CZ.UTF-8 cy_GB.UTF-8 de_DE.UTF-8 el_GR.UTF-8 en_GB.UTF-8 es_ES.UTF-8 es_MX.UTF-8 eu_ES.UTF-8 fr_FR.UTF-8 he_IL.UTF-8 hu_HU.UTF-8 it_IT.UTF-8 ja_JP.UTF-8 ko_KR.UTF-8 nb_NO.UTF-8 nl_NL.UTF-8 nn_NO.UTF-8 oc_FR.UTF-8 pl_PL.UTF-8 pt_BR.UTF-8 pt_PT.UTF-8 ru_RU.UTF-8 uk_UA.UTF-8 sv_SE.UTF-8 tr_TR.UTF-8 zh_CN.UTF-8 zh_TW.UTF-8"
BR2_TARGET_OPTIMIZATION="-pipe -fsigned-char"
BR2_TARGET_GENERIC_HOSTNAME="batocera"
BR2_TARGET_GENERIC_ISSUE="READY TO RETRO"
BR2_INIT_SYSV=y
BR2_ROOTFS_DEVICE_CREATION_DYNAMIC_EUDEV=y
BR2_TARGET_GENERIC_ROOT_PASSWD="linux"
BR2_TARGET_GENERIC_GETTY_PORT="ttyAML0"
BR2_TARGET_GENERIC_GETTY_BAUDRATE_115200=y
# BR2_TARGET_GENERIC_REMOUNT_ROOTFS_RW is not set
BR2_TARGET_TZ_INFO=y
BR2_TARGET_LOCALTIME="Europe/Paris"
BR2_GLOBAL_PATCH_DIR="$(BR2_EXTERNAL_BATOCERA_PATH)/board/batocera/patches $(BR2_EXTERNAL_BATOCERA_PATH)/board/batocera/amlogic/patches $(BR2_EXTERNAL_BATOCERA_PATH)/board/batocera/amlogic/s922x/patches"
BR2_ROOTFS_OVERLAY="$(BR2_EXTERNAL_BATOCERA_PATH)/board/batocera/fsoverlay $(BR2_EXTERNAL_BATOCERA_PATH)/board/batocera/amlogic/fsoverlay $(BR2_EXTERNAL_BATOCERA_PATH)/board/batocera/amlogic/s922x/fsoverlay"
BR2_ROOTFS_POST_BUILD_SCRIPT="$(BR2_EXTERNAL_BATOCERA_PATH)/board/batocera/scripts/post-build-script.sh"
BR2_ROOTFS_POST_IMAGE_SCRIPT="$(BR2_EXTERNAL_BATOCERA_PATH)/board/batocera/scripts/post-image-script.sh"

# Kernel
BR2_LINUX_KERNEL=y
BR2_LINUX_KERNEL_CUSTOM_VERSION=y
BR2_LINUX_KERNEL_CUSTOM_VERSION_VALUE="5.10.90"
BR2_KERNEL_HEADERS_AS_KERNEL=y
BR2_PACKAGE_HOST_LINUX_HEADERS_CUSTOM_5_10=y
BR2_LINUX_KERNEL_PATCH="$(BR2_EXTERNAL_BATOCERA_PATH)/board/batocera/amlogic/linux_patches"
BR2_LINUX_KERNEL_USE_CUSTOM_CONFIG=y
BR2_LINUX_KERNEL_CUSTOM_CONFIG_FILE="$(BR2_EXTERNAL_BATOCERA_PATH)/board/batocera/amlogic/linux-meson64-current.config"
BR2_LINUX_KERNEL_CONFIG_FRAGMENT_FILES="$(BR2_EXTERNAL_BATOCERA_PATH)/board/batocera/amlogic/s922x/linux-defconfig-fragment.config"
BR2_LINUX_KERNEL_DTS_SUPPORT=y
BR2_LINUX_KERNEL_INTREE_DTS_NAME="amlogic/meson-g12b-odroid-n2 amlogic/meson-g12b-odroid-n2-plus amlogic/meson-g12b-a311d-khadas-vim3 amlogic/meson-g12b-gtking amlogic/meson-g12b-gtking-pro"
BR2_LINUX_KERNEL_NEEDS_HOST_OPENSSL=y

# System
BR2_PACKAGE_BUSYBOX_CONFIG_FRAGMENT_FILES="$(BR2_EXTERNAL_BATOCERA_PATH)/board/batocera/busybox.custom.config"
BR2_SYSTEM_BIN_SH_DASH=y # /bin/sh implementation; set here because a `choice` cannot be `select`ed, e.g. from batocera-system/Config.in
BR2_PACKAGE_BATOCERA_ALL_SYSTEMS=y
BR2_PACKAGE_BATOCERA_TOOLS=y
BR2_PACKAGE_BATOCERA_EXTRAS=y
BR2_PACKAGE_BATOCERA_KODI19=y
BR2_PACKAGE_BATOCERA_LINUX_FIRMWARES=y
BR2_PACKAGE_BATOCERA_SYSTEM=y
BR2_TARGET_ROOTFS_SQUASHFS4_ZSTD=y

BR2_PACKAGE_ESPEAK=y
BR2_PACKAGE_ESPEAK_AUDIO_BACKEND_ALSA=y

# Python and LUA choices
BR2_PACKAGE_PYTHON3_PY_PYC=y
BR2_PACKAGE_PYTHON_HASHLIB=y
BR2_PACKAGE_LUA_5_1=y

# GPU
BR2_PACKAGE_BATOCERA_PANFROST_MESA3D=y

# Bootloader for vim3
BR2_TARGET_UBOOT=y
BR2_TARGET_UBOOT_BUILD_SYSTEM_KCONFIG=y
BR2_TARGET_UBOOT_CUSTOM_VERSION=y
BR2_TARGET_UBOOT_CUSTOM_VERSION_VALUE="2021.10"
BR2_TARGET_UBOOT_BOARD_DEFCONFIG="khadas-vim3"
BR2_PACKAGE_UBOOT_AMLOGIC=y
BR2_PACKAGE_UBOOT_ODROID_N2=y

# Required tools to create the SD image
BR2_PACKAGE_HOST_DOSFSTOOLS=y
BR2_PACKAGE_HOST_GENIMAGE=y
BR2_PACKAGE_HOST_MESON_TOOLS=y
BR2_PACKAGE_HOST_MTOOLS=y
BR2_PACKAGE_HOST_UBOOT_TOOLS=y

# choices can be put in _defconfig files only
BR2_PACKAGE_BATOCERA_SPLASH_MPV=y

# Batocera
#BR2_PACKAGE_BATOCERA_DEV=y
#BR2_PACKAGE_BATOCERA_DEBUG=y
#BR2_PACKAGE_BATOCERA_CORES_EXPERIMENTAL=y

# Enables ccache
BR2_CCACHE=y
```

## configs/batocera-uboot-rockpro64_defconfig
```kconfig
# Target definition
BR2_aarch64=y
BR2_cortex_a72_a53=y
BR2_ARM_FPU_NEON_FP_ARMV8=y

# Toolchain definition
BR2_GCC_VERSION_10_X=y
BR2_GCC_ENABLE_GRAPHITE=y
BR2_GCC_ENABLE_LTO=y
BR2_OPTIMIZE_3=y
BR2_SHARED_STATIC_LIBS=y
BR2_TOOLCHAIN_BUILDROOT_GLIBC=y
# required for utf-8
BR2_TOOLCHAIN_GLIBC_GCONV_LIBS_COPY=y
BR2_TOOLCHAIN_BUILDROOT_CXX=y

# BR2_TARGET_ROOTFS_TAR is not set

# Bootloader
BR2_TARGET_UBOOT=y
BR2_TARGET_UBOOT_BUILD_SYSTEM_KCONFIG=y
BR2_TARGET_UBOOT_CUSTOM_VERSION=y
BR2_TARGET_UBOOT_CUSTOM_VERSION_VALUE="2021.01"
BR2_TARGET_UBOOT_BOARD_DEFCONFIG="rockpro64-rk3399"
BR2_TARGET_UBOOT_NEEDS_DTC=y
BR2_TARGET_UBOOT_NEEDS_PYTHON3=y
BR2_TARGET_UBOOT_NEEDS_ATF_BL31=y
BR2_TARGET_UBOOT_NEEDS_ATF_BL31_ELF=y
BR2_TARGET_UBOOT_FORMAT_CUSTOM=y
BR2_TARGET_UBOOT_FORMAT_CUSTOM_NAME="u-boot.itb"
BR2_TARGET_UBOOT_SPL=y
BR2_TARGET_UBOOT_SPL_NAME="idbloader.img"
```

## configs/batocera-uboot-tinker_defconfig
```kconfig
# Target definition
BR2_arm=y
BR2_cortex_a17=y
BR2_ARM_FPU_NEON_VFPV4=y

# Toolchain definition
BR2_GCC_VERSION_11_X=y
BR2_GCC_ENABLE_GRAPHITE=y
BR2_GCC_ENABLE_LTO=y
BR2_OPTIMIZE_3=y
BR2_SHARED_STATIC_LIBS=y
BR2_TOOLCHAIN_BUILDROOT_GLIBC=y
# required for utf-8
BR2_TOOLCHAIN_GLIBC_GCONV_LIBS_COPY=y
BR2_TOOLCHAIN_BUILDROOT_CXX=y

BR2_GLOBAL_PATCH_DIR="$(BR2_EXTERNAL_BATOCERA_PATH)/board/batocera/rockchip/rk3288/patches"

# Bootloader
BR2_TARGET_UBOOT=y
BR2_TARGET_UBOOT_BUILD_SYSTEM_KCONFIG=y
BR2_TARGET_UBOOT_CUSTOM_VERSION=y
BR2_TARGET_UBOOT_CUSTOM_VERSION_VALUE="2019.01"
BR2_TARGET_UBOOT_BOARD_DEFCONFIG="tinker-rk3288"
BR2_TARGET_UBOOT_NEEDS_DTC=y
BR2_TARGET_UBOOT_NEEDS_OPENSSL=y
BR2_TARGET_UBOOT_FORMAT_DTB_IMG=y
BR2_TARGET_UBOOT_FORMAT_DTB_BIN=y
BR2_TARGET_UBOOT_SPL=y
BR2_TARGET_UBOOT_SPL_NAME="spl/u-boot-spl-dtb.bin"
```

## configs/batocera-x86_64_defconfig
```kconfig
BR2_x86_64=y
BR2_OPTIMIZE_3=y
BR2_SHARED_STATIC_LIBS=y
BR2_GLOBAL_PATCH_DIR="board/batocera/patches board/batocera/x86/patches"
BR2_TOOLCHAIN_BUILDROOT_GLIBC=y
# required for utf-8
BR2_TOOLCHAIN_GLIBC_GCONV_LIBS_COPY=y
BR2_TOOLCHAIN_BUILDROOT_CXX=y
BR2_GCC_VERSION_7_X=y
BR2_TARGET_OPTIMIZATION="-pipe -fsigned-char"
BR2_TARGET_GENERIC_HOSTNAME="batocera"
BR2_TARGET_GENERIC_ISSUE="PLAY AGAIN"
BR2_INIT_SYSV=y
BR2_ROOTFS_DEVICE_CREATION_DYNAMIC_EUDEV=y
BR2_TARGET_GENERIC_ROOT_PASSWD="linux"
BR2_SYSTEM_BIN_SH_BASH=y
BR2_TARGET_GENERIC_GETTY_PORT="tty1"
BR2_TARGET_GENERIC_GETTY_BAUDRATE_115200=y
# BR2_TARGET_GENERIC_REMOUNT_ROOTFS_RW is not set
BR2_ENABLE_LOCALE_WHITELIST="C ar ca de el es eu_ES fr hu it ja_JP ko nb_NO nl nn_NO pl pt_PT pt_BR ru_RU sv_SE tr zh_CN zh_TW"
BR2_GENERATE_LOCALE="en_US.UTF-8 ar_YE.UTF-8 ca_ES.UTF-8 de_DE.UTF-8 el_GR.UTF-8 es_ES.UTF-8 eu_ES.UTF-8 fr_FR.UTF-8 hu_HU.UTF-8 it_IT.UTF-8 ja_JP.UTF-8 ko_KR.UTF-8 nb_NO.UTF-8 nl_NL.UTF-8 nn_NO.UTF-8 pl_PL.UTF-8 pt_BR.UTF-8 pt_PT.UTF-8 ru_RU.UTF-8 sv_SE.UTF-8 tr_TR.UTF-8 zh_CN.UTF-8 zh_TW.UTF-8"
BR2_TARGET_TZ_INFO=y
BR2_TARGET_LOCALTIME="Europe/Paris"
BR2_ROOTFS_OVERLAY="board/batocera/fsoverlay board/batocera/x86/fsoverlay"
BR2_ROOTFS_POST_BUILD_SCRIPT="board/batocera/batocera-patch-target.sh"
BR2_ROOTFS_POST_IMAGE_SCRIPT="board/batocera/copy-batocera-archives.sh"
BR2_LINUX_KERNEL=y
BR2_LINUX_KERNEL_LATEST_VERSION=y
BR2_LINUX_KERNEL_PATCH="board/batocera/x86/kernel_patches_4.17"
BR2_LINUX_KERNEL_USE_CUSTOM_CONFIG=y
BR2_LINUX_KERNEL_CUSTOM_CONFIG_FILE="board/batocera/x86/kernel-x86_64-4.17-defconfig.config"
BR2_PACKAGE_BUSYBOX_CONFIG_FRAGMENT_FILES="board/batocera/busybox.custom.config"
BR2_PACKAGE_ALSA_UTILS=y
BR2_PACKAGE_ALSA_UTILS_AMIXER=y
BR2_PACKAGE_ALSA_UTILS_APLAY=y
BR2_PACKAGE_BATOCERA_ALL_SYSTEMS=y
BR2_PACKAGE_BATOCERA_TOOLS=y
BR2_PACKAGE_BATOCERA_EXTRAS=y
BR2_PACKAGE_BATOCERA_KODI=y
BR2_PACKAGE_BATOCERA_LINUX_FIRMWARES=y
BR2_PACKAGE_BINUTILS=y
BR2_PACKAGE_BATOCERA_SYSTEM=y
BR2_PACKAGE_BATOCERA_TARGET_X86_64=y
BR2_PACKAGE_RECALBOX_THEMES=y
BR2_PACKAGE_BATOCERA_X86_64_EFI=y
BR2_PACKAGE_PYTHON_ES_SCRAPER=y
BR2_PACKAGE_SSELPH_SCRAPER=y
BR2_PACKAGE_QTSIXA_SHANWAN=y
BR2_PACKAGE_XARCADE2JSTICK=y
BR2_PACKAGE_BATOCERA_RETROGAME=y
BR2_PACKAGE_MEGATOOLS=y
BR2_PACKAGE_SDL2_MIXER=y
BR2_PACKAGE_ADWAITA_ICON_THEME=y
BR2_PACKAGE_MESA3D_DEMOS=y
BR2_PACKAGE_FBDUMP=y
BR2_PACKAGE_FBGRAB=y
BR2_PACKAGE_FBV=y
BR2_PACKAGE_MESA3D=y
BR2_PACKAGE_MESA3D_GALLIUM_DRIVER_NOUVEAU=y
BR2_PACKAGE_MESA3D_GALLIUM_DRIVER_R600=y
BR2_PACKAGE_MESA3D_GALLIUM_DRIVER_RADEONSI=y
BR2_PACKAGE_MESA3D_GALLIUM_DRIVER_SWRAST=y
BR2_PACKAGE_MESA3D_DRI_DRIVER_SWRAST=y
BR2_PACKAGE_MESA3D_DRI_DRIVER_I915=y
BR2_PACKAGE_MESA3D_DRI_DRIVER_I965=y
BR2_PACKAGE_MESA3D_OPENGL_EGL=y
BR2_PACKAGE_MESA3D_OPENGL_TEXTURE_FLOAT=y
BR2_PACKAGE_SDL_IMAGE_XPM=y
BR2_PACKAGE_SDL_MIXER=y
BR2_PACKAGE_SDL_NET=y
BR2_PACKAGE_SDL2_OPENGL=y
BR2_PACKAGE_XORG7=y
BR2_PACKAGE_XSERVER_XORG_SERVER=y
BR2_PACKAGE_XAPP_SETXKBMAP=y
BR2_PACKAGE_XAPP_XEV=y
BR2_PACKAGE_XAPP_XINIT=y
BR2_PACKAGE_XAPP_XINPUT=y
BR2_PACKAGE_XAPP_XRANDR=y
# X11 Xset command
BR2_PACKAGE_XAPP_XSET=y
BR2_PACKAGE_XDRIVER_XF86_INPUT_EVDEV=y
BR2_PACKAGE_XDRIVER_XF86_INPUT_KEYBOARD=y
BR2_PACKAGE_XDRIVER_XF86_INPUT_LIBINPUT=y
BR2_PACKAGE_XDRIVER_XF86_VIDEO_ARK=y
BR2_PACKAGE_XDRIVER_XF86_VIDEO_AST=y
BR2_PACKAGE_XDRIVER_XF86_VIDEO_ATI=y
BR2_PACKAGE_XDRIVER_XF86_VIDEO_CIRRUS=y
BR2_PACKAGE_XDRIVER_XF86_VIDEO_FBDEV=y
BR2_PACKAGE_XDRIVER_XF86_VIDEO_GEODE=y
BR2_PACKAGE_XDRIVER_XF86_VIDEO_GLINT=y
BR2_PACKAGE_XDRIVER_XF86_VIDEO_I128=y
BR2_PACKAGE_XDRIVER_XF86_VIDEO_INTEL=y
BR2_PACKAGE_XDRIVER_XF86_VIDEO_MACH64=y
BR2_PACKAGE_XDRIVER_XF86_VIDEO_MGA=y
BR2_PACKAGE_XDRIVER_XF86_VIDEO_NEOMAGIC=y
BR2_PACKAGE_XDRIVER_XF86_VIDEO_NOUVEAU=y
BR2_PACKAGE_XDRIVER_XF86_VIDEO_NV=y
BR2_PACKAGE_XDRIVER_XF86_VIDEO_OPENCHROME=y
BR2_PACKAGE_XDRIVER_XF86_VIDEO_QXL=y
BR2_PACKAGE_XDRIVER_XF86_VIDEO_R128=y
BR2_PACKAGE_XDRIVER_XF86_VIDEO_SAVAGE=y
BR2_PACKAGE_XDRIVER_XF86_VIDEO_SILICONMOTION=y
BR2_PACKAGE_XDRIVER_XF86_VIDEO_SIS=y
BR2_PACKAGE_XDRIVER_XF86_VIDEO_TDFX=y
BR2_PACKAGE_XDRIVER_XF86_VIDEO_TGA=y
BR2_PACKAGE_XDRIVER_XF86_VIDEO_TRIDENT=y
BR2_PACKAGE_XDRIVER_XF86_VIDEO_VESA=y
BR2_PACKAGE_XDRIVER_XF86_VIDEO_VOODOO=y
BR2_PACKAGE_XPROTO_DRI3PROTO=y
BR2_PACKAGE_EUDEV_RULES_GEN=y
BR2_PACKAGE_I2C_TOOLS=y
BR2_PACKAGE_KBD=y
BR2_PACKAGE_PYTHON_PY_PYC=y
BR2_PACKAGE_PYTHON_HASHLIB=y
BR2_PACKAGE_PYTHON_GOBJECT=y
BR2_PACKAGE_LIBZIP=y
BR2_PACKAGE_LIBOPENSSL_BIN=y
# required to enable xorg glamor
BR2_PACKAGE_LIBEPOXY=y
BR2_PACKAGE_LIBSVG_CAIRO=y
BR2_PACKAGE_TSLIB=y
BR2_PACKAGE_BOOST_ATOMIC=y
# BR2_PACKAGE_AVAHI_AUTOIPD is not set
BR2_PACKAGE_GESFTPSERVER=y
BR2_PACKAGE_NTP=y
BR2_PACKAGE_RSYNC=y
BR2_PACKAGE_SAMBA4=y
BR2_PACKAGE_UTIL_LINUX_LIBSMARTCOLS=y
# BR2_TARGET_ROOTFS_TAR is not set
BR2_TARGET_GRUB2=y
BR2_PACKAGE_BOOST=y
BR2_PACKAGE_SDL_X11=y
BR2_PACKAGE_PYTHON_PSUTIL=y
BR2_PACKAGE_OPENVPN=y
BR2_LINUX_KERNEL_NEEDS_HOST_LIBELF=y
# QT5 Package
BR2_PACKAGE_QT5=y
BR2_PACKAGE_QT5_VERSION_LATEST=y
BR2_PACKAGE_QT5BASE=y
BR2_PACKAGE_QT5BASE_GUI=y
BR2_PACKAGE_QT5BASE_WIDGETS=y
```
