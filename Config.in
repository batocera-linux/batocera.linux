## configs/batocera-rk3399_defconfig
```kconfig
# Target definition
BR2_aarch64=y
BR2_cortex_a72_a53=y
BR2_ARM_FPU_NEON_FP_ARMV8=y
BR2_PACKAGE_BATOCERA_TARGET_RK3399=y
BR2_ROOTFS_USERS_TABLES="$(BR2_EXTERNAL_BATOCERA_PATH)/board/batocera/users.txt"

# Toolchain definition
BR2_GCC_VERSION_10_X=y
BR2_GCC_ENABLE_GRAPHITE=y
BR2_GCC_ENABLE_LTO=y
BR2_OPTIMIZE_3=y
BR2_SHARED_STATIC_LIBS=y
BR2_TOOLCHAIN_BUILDROOT_GLIBC=y
# required for utf-8
BR2_TOOLCHAIN_GLIBC_GCONV_LIBS_COPY=y
BR2_TOOLCHAIN_BUILDROOT_CXX=y
BR2_ENABLE_LOCALE_WHITELIST="C ar ca cy_GB de el es es_MX eu_ES fr hu it ja_JP ko nb_NO nl nn_NO oc_FR.UTF-8 pl pt_PT pt_BR ru_RU uk_UA sv_SE tr zh_CN zh_TW"
BR2_GENERATE_LOCALE="en_US.UTF-8 ar_YE.UTF-8 ca_ES.UTF-8 cy_GB.UTF-8 de_DE.UTF-8 el_GR.UTF-8 es_ES.UTF-8 es_MX.UTF-8 eu_ES.UTF-8 fr_FR.UTF-8 hu_HU.UTF-8 it_IT.UTF-8 ja_JP.UTF-8 ko_KR.UTF-8 nb_NO.UTF-8 nl_NL.UTF-8 nn_NO.UTF-8 oc_FR.UTF-8 pl_PL.UTF-8 pt_BR.UTF-8 pt_PT.UTF-8 ru_RU.UTF-8 uk_UA.UTF-8 sv_SE.UTF-8 tr_TR.UTF-8 zh_CN.UTF-8 zh_TW.UTF-8"
BR2_TARGET_OPTIMIZATION="-pipe -fsigned-char"
BR2_TARGET_GENERIC_HOSTNAME="batocera"
BR2_TARGET_GENERIC_ISSUE="PLAY AGAIN"
BR2_INIT_SYSV=y
BR2_ROOTFS_DEVICE_CREATION_DYNAMIC_EUDEV=y
BR2_TARGET_GENERIC_ROOT_PASSWD="linux"
#BR2_TARGET_GENERIC_GETTY_PORT="tty1"
BR2_TARGET_GENERIC_GETTY_BAUDRATE_115200=y
# BR2_TARGET_GENERIC_REMOUNT_ROOTFS_RW is not set
BR2_TARGET_TZ_INFO=y
BR2_TARGET_LOCALTIME="Europe/Paris"
BR2_GLOBAL_PATCH_DIR="$(BR2_EXTERNAL_BATOCERA_PATH)/board/batocera/patches $(BR2_EXTERNAL_BATOCERA_PATH)/board/batocera/rockchip/patches $(BR2_EXTERNAL_BATOCERA_PATH)/board/batocera/rockchip/rk3399/patches"
BR2_ROOTFS_OVERLAY="$(BR2_EXTERNAL_BATOCERA_PATH)/board/batocera/fsoverlay $(BR2_EXTERNAL_BATOCERA_PATH)/board/batocera/rockchip/fsoverlay $(BR2_EXTERNAL_BATOCERA_PATH)/board/batocera/rockchip/rk3399/fsoverlay"
BR2_ROOTFS_POST_BUILD_SCRIPT="$(BR2_EXTERNAL_BATOCERA_PATH)/board/batocera/scripts/post-build-script.sh"
BR2_ROOTFS_POST_IMAGE_SCRIPT="$(BR2_EXTERNAL_BATOCERA_PATH)/board/batocera/scripts/post-image-script.sh"

# Kernel
BR2_PACKAGE_HOST_LINUX_HEADERS_CUSTOM_4_4=y
BR2_LINUX_KERNEL=y
BR2_LINUX_KERNEL_CUSTOM_GIT=y
BR2_LINUX_KERNEL_CUSTOM_REPO_URL="https://github.com/mrfixit2001/rockchip-kernel.git"
BR2_LINUX_KERNEL_CUSTOM_REPO_VERSION="c6bae7eccdb07bd5d92cf8734ce3766da0ce2e49"
BR2_LINUX_KERNEL_PATCH="$(BR2_EXTERNAL_BATOCERA_PATH)/board/batocera/rockchip/rk3399/linux_patches"
BR2_LINUX_KERNEL_USE_DEFCONFIG=y
BR2_LINUX_KERNEL_DEFCONFIG="rk3399_linux"
BR2_LINUX_KERNEL_CONFIG_FRAGMENT_FILES="$(BR2_EXTERNAL_BATOCERA_PATH)/board/batocera/rockchip/rk3399/linux-defconfig-fragment.config"
BR2_LINUX_KERNEL_DTS_SUPPORT=y
BR2_LINUX_KERNEL_INTREE_DTS_NAME="rockchip/rk3399-rockpro64 rockchip/rk3399-rock960-ab"
BR2_LINUX_KERNEL_IMAGE_TARGET_CUSTOM=y
BR2_LINUX_KERNEL_IMAGE_TARGET_NAME="Image"

# Firmware
BR2_TARGET_ARM_TRUSTED_FIRMWARE=y
BR2_TARGET_ARM_TRUSTED_FIRMWARE_CUSTOM_VERSION=y
BR2_TARGET_ARM_TRUSTED_FIRMWARE_CUSTOM_VERSION_VALUE="v2.4"
BR2_TARGET_ARM_TRUSTED_FIRMWARE_PLATFORM="rk3399"
BR2_TARGET_ARM_TRUSTED_FIRMWARE_BL31=y
BR2_TARGET_ARM_TRUSTED_FIRMWARE_NEEDS_ARM32_TOOLCHAIN=y
BR2_TARGET_ARM_TRUSTED_FIRMWARE_IMAGES=""

# Bootloader
#BR2_PACKAGE_UBOOT_ROCKPRO64=y
#BR2_PACKAGE_UBOOT_ROCK960=y
BR2_PACKAGE_ROCKPRO64_BLOBS=y
BR2_PACKAGE_ROCK960_BLOBS=y

# System
BR2_PACKAGE_BUSYBOX_CONFIG_FRAGMENT_FILES="$(BR2_EXTERNAL_BATOCERA_PATH)/board/batocera/busybox.custom.config"
BR2_SYSTEM_BIN_SH_DASH=y # set here because it doesn't work if set from batocera-system/Config.in
BR2_PACKAGE_BATOCERA_ALL_SYSTEMS=y
BR2_PACKAGE_BATOCERA_TOOLS=y
BR2_PACKAGE_BATOCERA_EXTRAS=y
BR2_PACKAGE_BATOCERA_KODI19=n
BR2_PACKAGE_BATOCERA_LINUX_FIRMWARES=y
BR2_PACKAGE_BATOCERA_SYSTEM=y
BR2_PACKAGE_FBDUMP=y
BR2_PACKAGE_FBGRAB=y
BR2_PACKAGE_FBV=y
BR2_PACKAGE_EUDEV_RULES_GEN=y
BR2_PACKAGE_MALI_T860=y
BR2_PACKAGE_BOOST_ATOMIC=y
# BR2_PACKAGE_AVAHI_AUTOIPD is not set
# BR2_TARGET_ROOTFS_TAR is not set
#BR2_TARGET_ROOTFS_SQUASHFS4_ZSTD=y
BR2_PACKAGE_UTIL_LINUX_LIBSMARTCOLS=y
BR2_PACKAGE_UTIL_LINUX_SETTERM=y

# Python and LUA choices
BR2_PACKAGE_PYTHON3_PY_PYC=y
BR2_PACKAGE_PYTHON_HASHLIB=y
BR2_PACKAGE_LUA_5_1=y

BR2_PACKAGE_FIRMWARE_ROCKPRO64=y

# choices can be put in _defconfig files only
BR2_PACKAGE_BATOCERA_SPLASH_MPV=y

# Batocera
#BR2_PACKAGE_BATOCERA_DEV=y
#BR2_PACKAGE_BATOCERA_DEBUG=y
#BR2_PACKAGE_BATOCERA_CORES_EXPERIMENTAL=y

# Enables ccache
BR2_CCACHE=y
```

## configs/batocera-rpi1_defconfig
```kconfig
BR2_arm=y
BR2_arm1176jzf_s=y
BR2_OPTIMIZE_3=y
BR2_SHARED_STATIC_LIBS=y
BR2_GLOBAL_PATCH_DIR="$(BR2_EXTERNAL_BATOCERA_PATH)/board/batocera/patches $(BR2_EXTERNAL_BATOCERA_PATH)/board/batocera/rpi/patches"
BR2_TOOLCHAIN_BUILDROOT_GLIBC=y
# required for utf-8
BR2_TOOLCHAIN_GLIBC_GCONV_LIBS_COPY=y
BR2_PACKAGE_HOST_LINUX_HEADERS_CUSTOM_4_19=y
BR2_TOOLCHAIN_BUILDROOT_CXX=y
BR2_TARGET_OPTIMIZATION="-pipe -fsigned-char"
BR2_TARGET_GENERIC_HOSTNAME="batocera"
BR2_TARGET_GENERIC_ISSUE="PLAY AGAIN"
BR2_INIT_SYSV=y
BR2_ROOTFS_DEVICE_CREATION_DYNAMIC_EUDEV=y
BR2_TARGET_GENERIC_ROOT_PASSWD="linux"
BR2_SYSTEM_BIN_SH_BASH=y
BR2_TARGET_GENERIC_GETTY_PORT="tty1"
BR2_TARGET_GENERIC_GETTY_BAUDRATE_115200=y
# BR2_TARGET_GENERIC_REMOUNT_ROOTFS_RW is not set
BR2_ENABLE_LOCALE_WHITELIST="C ar ca de el es es_MX eu_ES fr hu it ja_JP ko nb_NO nl nn_NO pl pt_PT pt_BR ru_RU uk_UK sv_SE tr zh_CN zh_TW"
BR2_GENERATE_LOCALE="en_US.UTF-8 ar_YE.UTF-8 ca_ES.UTF-8 de_DE.UTF-8 el_GR.UTF-8 es_ES.UTF-8 es_MX.UTF-8 eu_ES.UTF-8 fr_FR.UTF-8 hu_HU.UTF-8 it_IT.UTF-8 ja_JP.UTF-8 ko_KR.UTF-8 nb_NO.UTF-8 nl_NL.UTF-8 nn_NO.UTF-8 pl_PL.UTF-8 pt_BR.UTF-8 pt_PT.UTF-8 ru_RU.UTF-8 uk_UK.UTF-8 sv_SE.UTF-8 tr_TR.UTF-8 zh_CN.UTF-8 zh_TW.UTF-8"
BR2_TARGET_TZ_INFO=y
BR2_TARGET_LOCALTIME="Europe/Paris"
BR2_ROOTFS_OVERLAY="$(BR2_EXTERNAL_BATOCERA_PATH)/board/batocera/fsoverlay $(BR2_EXTERNAL_BATOCERA_PATH)/board/batocera/rpi/fsoverlay"
BR2_ROOTFS_POST_BUILD_SCRIPT="$(BR2_EXTERNAL_BATOCERA_PATH)/board/batocera/post-build-script.sh"
BR2_ROOTFS_POST_IMAGE_SCRIPT="$(BR2_EXTERNAL_BATOCERA_PATH)/board/batocera/post-image-script.sh"
BR2_LINUX_KERNEL=y
BR2_LINUX_KERNEL_CUSTOM_TARBALL=y
BR2_LINUX_KERNEL_CUSTOM_TARBALL_LOCATION="$(call github,raspberrypi,linux,raspberrypi-kernel_1.20190925-1)/linux-raspberrypi-kernel_1.20190925-1.tar.gz"
BR2_LINUX_KERNEL_PATCH="$(BR2_EXTERNAL_BATOCERA_PATH)/board/batocera/rpi/linux_patches"
BR2_LINUX_KERNEL_DEFCONFIG="bcmrpi"
BR2_LINUX_KERNEL_CONFIG_FRAGMENT_FILES="$(BR2_EXTERNAL_BATOCERA_PATH)/board/batocera/rpi/linux-defconfig-fragment.config"
BR2_LINUX_KERNEL_DTS_SUPPORT=y
BR2_LINUX_KERNEL_INTREE_DTS_NAME="bcm2708-rpi-b bcm2708-rpi-b-plus bcm2708-rpi-cm bcm2708-rpi-zero-w"
BR2_PACKAGE_BATOCERA_SYSTEM=y
BR2_PACKAGE_BATOCERA_TARGET_RPI1=y
BR2_PACKAGE_BATOCERA_EXTRAS=y
BR2_PACKAGE_BATOCERA_TOOLS=y
BR2_PACKAGE_BATOCERA_ALL_SYSTEMS=y
BR2_PACKAGE_BATOCERA_KODI18=y
BR2_PACKAGE_BATOCERA_LINUX_FIRMWARES=y
BR2_PACKAGE_LIBENET=y
BR2_PACKAGE_PYTHON_RPIGPIO=y
BR2_PACKAGE_BUSYBOX_CONFIG_FRAGMENT_FILES="$(BR2_EXTERNAL_BATOCERA_PATH)/board/batocera/busybox.custom.config"
BR2_PACKAGE_FBDUMP=y
BR2_PACKAGE_FBGRAB=y
BR2_PACKAGE_FBV=y
BR2_PACKAGE_EUDEV_RULES_GEN=y
BR2_PACKAGE_RPI_USERLAND=y
BR2_PACKAGE_PYTHON_PY_PYC=y
BR2_PACKAGE_PYTHON_GOBJECT=y
BR2_PACKAGE_JPEG_TURBO=y
BR2_PACKAGE_BOOST_ATOMIC=y
# BR2_PACKAGE_AVAHI_AUTOIPD is not set
# BR2_TARGET_ROOTFS_TAR is not set
BR2_PACKAGE_LIBCAPSIMAGE=y
BR2_PACKAGE_UTIL_LINUX_LIBSMARTCOLS=y
BR2_PACKAGE_PYTHON_HASHLIB=y
BR2_PACKAGE_PYTHON_PSUTIL=y
BR2_PACKAGE_BATOCERA_AUDIO_RPI=y
BR2_PACKAGE_XARCADE2JSTICK=y

# GPIO Kernel Module
BR2_PACKAGE_MK_ARCADE_JOYSTICK_RPI=y

# Enables ccache, strace and gdb
#BR2_PACKAGE_BATOCERA_DEV=y

# Enable experimental packages
#BR2_PACKAGE_BATOCERA_CORES_EXPERIMENTAL=y
```

## configs/batocera-rpi2_defconfig
```kconfig
# Target definition
BR2_arm=y
BR2_cortex_a7=y
BR2_ARM_EABIHF=y
BR2_ARM_FPU_NEON_VFPV4=y
BR2_PACKAGE_BATOCERA_TARGET_RPI2=y
BR2_ROOTFS_USERS_TABLES="$(BR2_EXTERNAL_BATOCERA_PATH)/board/batocera/users.txt"

# Toolchain definition
BR2_GCC_VERSION_11_X=y
BR2_GCC_ENABLE_GRAPHITE=y
BR2_GCC_ENABLE_LTO=y
BR2_OPTIMIZE_3=y
BR2_SHARED_STATIC_LIBS=y
BR2_TOOLCHAIN_BUILDROOT_GLIBC=y
# required for utf-8
BR2_TOOLCHAIN_GLIBC_GCONV_LIBS_COPY=y
BR2_TOOLCHAIN_BUILDROOT_CXX=y
BR2_TARGET_OPTIMIZATION="-pipe -fsigned-char"
BR2_TARGET_GENERIC_HOSTNAME="batocera"
BR2_TARGET_GENERIC_ISSUE="READY TO RETRO"
BR2_INIT_SYSV=y
BR2_ROOTFS_DEVICE_CREATION_DYNAMIC_EUDEV=y
BR2_TARGET_GENERIC_ROOT_PASSWD="linux"
#BR2_TARGET_GENERIC_GETTY_PORT="tty1"
BR2_TARGET_GENERIC_GETTY_BAUDRATE_115200=y
# BR2_TARGET_GENERIC_REMOUNT_ROOTFS_RW is not set
BR2_ENABLE_LOCALE_WHITELIST="C ar ca cs_CZ cy cy_GB cy de en el es es_MX eu eu_ES fr fr_FR he hu it ja ja_JP ja ko nb nb_NO nl nn nn_NO oc oc_FR pl pt pt_PT pt_BR ru ru_RU uk uk_UA sv sv_SE tr zh zh_CN zh_TW"
BR2_GENERATE_LOCALE="en_US.UTF-8 ar_YE.UTF-8 ca_ES.UTF-8 cs_CZ.UTF-8 cy_GB.UTF-8 de_DE.UTF-8 el_GR.UTF-8 en_GB.UTF-8 es_ES.UTF-8 es_MX.UTF-8 eu_ES.UTF-8 fr_FR.UTF-8 he_IL.UTF-8 hu_HU.UTF-8 it_IT.UTF-8 ja_JP.UTF-8 ko_KR.UTF-8 nb_NO.UTF-8 nl_NL.UTF-8 nn_NO.UTF-8 oc_FR.UTF-8 pl_PL.UTF-8 pt_BR.UTF-8 pt_PT.UTF-8 ru_RU.UTF-8 uk_UA.UTF-8 sv_SE.UTF-8 tr_TR.UTF-8 zh_CN.UTF-8 zh_TW.UTF-8"
BR2_TARGET_TZ_INFO=y
BR2_TARGET_LOCALTIME="Europe/Paris"
BR2_GLOBAL_PATCH_DIR="$(BR2_EXTERNAL_BATOCERA_PATH)/board/batocera/patches $(BR2_EXTERNAL_BATOCERA_PATH)/board/batocera/raspberrypi/rpi2/patches"
BR2_ROOTFS_OVERLAY="$(BR2_EXTERNAL_BATOCERA_PATH)/board/batocera/fsoverlay $(BR2_EXTERNAL_BATOCERA_PATH)/board/batocera/raspberrypi/rpi2/fsoverlay"
BR2_ROOTFS_POST_BUILD_SCRIPT="$(BR2_EXTERNAL_BATOCERA_PATH)/board/batocera/scripts/post-build-script.sh"
BR2_ROOTFS_POST_IMAGE_SCRIPT="$(BR2_EXTERNAL_BATOCERA_PATH)/board/batocera/scripts/post-image-script.sh"
BR2_TARGET_ROOTFS_SQUASHFS4_ZSTD=y

# Linux headers same as kernel, a 5.15 series
BR2_PACKAGE_HOST_LINUX_HEADERS_CUSTOM_5_15=y

# Kernel - Version: 5.15.30
BR2_LINUX_KERNEL=y
BR2_LINUX_KERNEL_CUSTOM_TARBALL=y
BR2_LINUX_KERNEL_CUSTOM_TARBALL_LOCATION="$(call github,raspberrypi,linux,87ed6172fdf2f5502b7c9372d9402ecbb6d78178)/87ed6172fdf2f5502b7c9372d9402ecbb6d78178.tar.gz"
BR2_LINUX_KERNEL_DEFCONFIG="bcm2709"
BR2_LINUX_KERNEL_PATCH="$(BR2_EXTERNAL_BATOCERA_PATH)/board/batocera/raspberrypi/linux_patches"
BR2_LINUX_KERNEL_CONFIG_FRAGMENT_FILES="$(BR2_EXTERNAL_BATOCERA_PATH)/board/batocera/raspberrypi/linux-defconfig-fragment.config"
BR2_LINUX_KERNEL_NEEDS_HOST_OPENSSL=y

# Kernel image
BR2_LINUX_KERNEL_IMAGE_TARGET_CUSTOM=y
BR2_LINUX_KERNEL_IMAGE_TARGET_NAME="Image"

# Build the DTB from the kernel sources
BR2_LINUX_KERNEL_DTS_SUPPORT=y
BR2_LINUX_KERNEL_INTREE_DTS_NAME="bcm2709-rpi-2-b"

BR2_PACKAGE_ESPEAK=y
BR2_PACKAGE_ESPEAK_AUDIO_BACKEND_ALSA=y

# Python and LUA choices
BR2_PACKAGE_PYTHON3_PY_PYC=y
BR2_PACKAGE_PYTHON_HASHLIB=y
BR2_PACKAGE_LUA_5_1=y

# rpi firmware
BR2_PACKAGE_RPI_FIRMWARE=y
BR2_PACKAGE_RPI_FIRMWARE_BOOTCODE_BIN=y
BR2_PACKAGE_RPI_FIRMWARE_VARIANT_PI_X=y
BR2_PACKAGE_RPI_FIRMWARE_CONFIG_FILE="$(BR2_EXTERNAL_BATOCERA_PATH)/board/batocera/raspberrypi/boot/config_mesa3d.txt"
BR2_PACKAGE_BRCMFMAC_SDIO_FIRMWARE_RPI=y
BR2_PACKAGE_BRCMFMAC_SDIO_FIRMWARE_RPI_BT=y
BR2_PACKAGE_BRCMFMAC_SDIO_FIRMWARE_RPI_WIFI=y

# batocera splash screen
BR2_PACKAGE_BATOCERA_SPLASH_MPV=y

# gpu
BR2_PACKAGE_BATOCERA_RPI_MESA3D=y

# Batocera system
BR2_PACKAGE_BATOCERA_SYSTEM=y
BR2_PACKAGE_BATOCERA_EXTRAS=y
BR2_PACKAGE_BATOCERA_TOOLS=y
BR2_PACKAGE_BATOCERA_ALL_SYSTEMS=y
BR2_PACKAGE_BATOCERA_KODI19=y
BR2_PACKAGE_BATOCERA_LINUX_FIRMWARES=y
BR2_PACKAGE_BUSYBOX_CONFIG_FRAGMENT_FILES="$(BR2_EXTERNAL_BATOCERA_PATH)/board/batocera/busybox.custom.config"
BR2_SYSTEM_BIN_SH_DASH=y # /bin/sh implementation; set here because a `choice` cannot be `select`ed, e.g. from batocera-system/Config.in

# Batocera dev
#BR2_PACKAGE_BATOCERA_DEV=y
#BR2_PACKAGE_BATOCERA_DEBUG=y
#BR2_PACKAGE_BATOCERA_CORES_EXPERIMENTAL=y

# Enables ccache
BR2_CCACHE=y
```

## configs/batocera-s905_defconfig
```kconfig
BR2_aarch64=y
BR2_cortex_a53=y
BR2_OPTIMIZE_3=y
BR2_SHARED_STATIC_LIBS=y
BR2_GLOBAL_PATCH_DIR="$(BR2_EXTERNAL_BATOCERA_PATH)/board/batocera/patches $(BR2_EXTERNAL_BATOCERA_PATH)/board/batocera/s905/patches"
BR2_TOOLCHAIN_BUILDROOT_GLIBC=y
BR2_TOOLCHAIN_BUILDROOT_CXX=y
BR2_ENABLE_LOCALE_WHITELIST="C ar ca de el es es_MX eu_ES fr hu it ja_JP ko nb_NO nl nn_NO pl pt_PT pt_BR ru_RU uk_UA sv_SE tr zh_CN zh_TW"
BR2_GENERATE_LOCALE="en_US.UTF-8 ar_YE.UTF-8 ca_ES.UTF-8 de_DE.UTF-8 el_GR.UTF-8 es_ES.UTF-8 es_MX.UTF-8 eu_ES.UTF-8 fr_FR.UTF-8 hu_HU.UTF-8 it_IT.UTF-8 ja_JP.UTF-8 ko_KR.UTF-8 nb_NO.UTF-8 nl_NL.UTF-8 nn_NO.UTF-8 pl_PL.UTF-8 pt_BR.UTF-8 pt_PT.UTF-8 ru_RU.UTF-8 uk_UA.UTF-8 sv_SE.UTF-8 tr_TR.UTF-8 zh_CN.UTF-8 zh_TW.UTF-8"
BR2_TARGET_OPTIMIZATION="-pipe -fsigned-char"
BR2_TARGET_GENERIC_HOSTNAME="batocera"
BR2_TARGET_GENERIC_ISSUE="PLAY AGAIN"
BR2_INIT_SYSV=y
BR2_ROOTFS_DEVICE_CREATION_DYNAMIC_EUDEV=y
BR2_TARGET_GENERIC_ROOT_PASSWD="linux"
BR2_SYSTEM_BIN_SH_BASH=y
BR2_TARGET_GENERIC_GETTY_PORT="tty1"
BR2_TARGET_GENERIC_GETTY_BAUDRATE_115200=y
# BR2_TARGET_GENERIC_REMOUNT_ROOTFS_RW is not set
BR2_TARGET_TZ_INFO=y
BR2_TARGET_LOCALTIME="Europe/Paris"
BR2_ROOTFS_OVERLAY="$(BR2_EXTERNAL_BATOCERA_PATH)/board/batocera/fsoverlay $(BR2_EXTERNAL_BATOCERA_PATH)/board/batocera/s905/fsoverlay"
BR2_ROOTFS_POST_BUILD_SCRIPT="$(BR2_EXTERNAL_BATOCERA_PATH)/board/batocera/post-build-script.sh"
BR2_ROOTFS_POST_IMAGE_SCRIPT="$(BR2_EXTERNAL_BATOCERA_PATH)/board/batocera/post-image-script.sh"
BR2_PACKAGE_HOST_LINUX_HEADERS_CUSTOM_3_14=y
BR2_LINUX_KERNEL=y
BR2_LINUX_KERNEL_CUSTOM_GIT=y
BR2_LINUX_KERNEL_CUSTOM_REPO_URL="https://github.com/kszaq/linux-amlogic-le.git"
BR2_LINUX_KERNEL_CUSTOM_REPO_VERSION="c850c92f5083abfbc0c7377c5f58b2802af69fb7"
BR2_LINUX_KERNEL_PATCH="$(BR2_EXTERNAL_BATOCERA_PATH)/board/batocera/s905/linux_patches"
BR2_LINUX_KERNEL_USE_CUSTOM_CONFIG=y
BR2_LINUX_KERNEL_CUSTOM_CONFIG_FILE="$(BR2_EXTERNAL_BATOCERA_PATH)/board/batocera/s905/linux-defconfig.config"
BR2_LINUX_KERNEL_CONFIG_FRAGMENT_FILES="$(BR2_EXTERNAL_BATOCERA_PATH)/board/batocera/s905/linux-defconfig-fragment.config"
BR2_LINUX_KERNEL_DTS_SUPPORT=y
BR2_LINUX_KERNEL_INTREE_DTS_NAME="amlogic/gxbb_p200 amlogic/gxbb_p200_2G amlogic/gxl_p212_1g amlogic/gxl_p212_2g"
BR2_LINUX_KERNEL_INSTALL_TARGET=y
BR2_PACKAGE_HOST_LZOP=y
BR2_PACKAGE_BUSYBOX_CONFIG_FRAGMENT_FILES="$(BR2_EXTERNAL_BATOCERA_PATH)/board/batocera/busybox.custom.config"
BR2_PACKAGE_BATOCERA_ALL_SYSTEMS=y
BR2_PACKAGE_BATOCERA_TOOLS=y
BR2_PACKAGE_BATOCERA_EXTRAS=y
#BR2_PACKAGE_BATOCERA_KODI18=y
BR2_PACKAGE_BATOCERA_LINUX_FIRMWARES=y
BR2_PACKAGE_BATOCERA_SYSTEM=y
BR2_PACKAGE_BATOCERA_TARGET_S905=y
BR2_PACKAGE_GPU_AML=y
BR2_PACKAGE_GPU_AML_STANDALONE=y
BR2_PACKAGE_FBDUMP=y
BR2_PACKAGE_FBGRAB=y
BR2_PACKAGE_FBV=y
BR2_PACKAGE_EUDEV_RULES_GEN=y
BR2_PACKAGE_MALI_450=y
BR2_PACKAGE_PYTHON_PY_PYC=y
BR2_PACKAGE_PYTHON_GOBJECT=y
BR2_PACKAGE_BOOST_ATOMIC=y
# BR2_PACKAGE_AVAHI_AUTOIPD is not set
BR2_PACKAGE_HOST_UBOOT_TOOLS=y
BR2_PACKAGE_HOST_AML_DTBTOOLS=y
BR2_PACKAGE_HOST_PYTHON_MKBOOTIMG=y
# BR2_TARGET_ROOTFS_TAR is not set
BR2_PACKAGE_LIBCAPSIMAGE=y
BR2_PACKAGE_UTIL_LINUX_LIBSMARTCOLS=y
BR2_PACKAGE_UTIL_LINUX_SETTERM=y
BR2_PACKAGE_PYTHON_HASHLIB=y
BR2_PACKAGE_PYTHON_PSUTIL=y

# device trees
BR2_PACKAGE_DEVICE_TREES_AML_S9XX=y
BR2_PACKAGE_DEVICE_TREES_AML_S9XX_GXBB_P200=y
BR2_PACKAGE_DEVICE_TREES_AML_S9XX_GXBB_P201=y
BR2_PACKAGE_DEVICE_TREES_AML_S9XX_GXL_P212=y
BR2_PACKAGE_DEVICE_TREES_AML_S9XX_GXL_P230=y
BR2_PACKAGE_DEVICE_TREES_AML_S9XX_GXL_P231=y
# BR2_PACKAGE_DEVICE_TREES_AML_S9XX_GXL_P281 is not set

# Enables ccache, strace and gdb
#BR2_PACKAGE_BATOCERA_DEV=y

# Enable experimental packages
#BR2_PACKAGE_BATOCERA_CORES_EXPERIMENTAL=y
```
