## configs/batocera-kernel-exynos5422_defconfig
```kconfig
# Target definition
BR2_arm=y
BR2_cortex_a15=y
BR2_ARM_FPU_NEON_VFPV4=y

# Toolchain definition
BR2_GCC_VERSION_10_X=y
BR2_GCC_ENABLE_GRAPHITE=y
BR2_GCC_ENABLE_LTO=y
BR2_OPTIMIZE_3=y
BR2_SHARED_STATIC_LIBS=y
BR2_TOOLCHAIN_BUILDROOT_GLIBC=y
# required for utf-8
BR2_TOOLCHAIN_GLIBC_GCONV_LIBS_COPY=y
BR2_TOOLCHAIN_BUILDROOT_CXX=y
BR2_ENABLE_LOCALE_WHITELIST="C ar ca cy_GB de el es es_MX eu_ES fr hu it ja_JP ko nb_NO nl nn_NO oc_FR.UTF-8 pl pt_PT pt_BR ru_RU uk_UA sv_SE tr zh_CN zh_TW"
BR2_GENERATE_LOCALE="en_US.UTF-8"
BR2_TARGET_OPTIMIZATION="-pipe -fsigned-char"
BR2_TARGET_GENERIC_HOSTNAME="batocera"
BR2_TARGET_GENERIC_ISSUE="PLAY AGAIN"
BR2_TARGET_ROOTFS_TAR_NONE=y
BR2_ROOTFS_DEVICE_CREATION_DYNAMIC_EUDEV=y
BR2_ROOTFS_POST_BUILD_SCRIPT="$(BR2_EXTERNAL_BATOCERA_PATH)/board/batocera/scripts/package-kernel-modules.sh"
#BR2_ROOTFS_POST_IMAGE_SCRIPT="$(BR2_EXTERNAL_BATOCERA_PATH)/board/batocera/scripts/post-image-script.sh"

# Kernel
BR2_LINUX_KERNEL=y
BR2_LINUX_KERNEL_CUSTOM_VERSION=y
BR2_LINUX_KERNEL_CUSTOM_VERSION_VALUE="5.10.47"
BR2_KERNEL_HEADERS_5_10=y
BR2_LINUX_KERNEL_DTS_SUPPORT=y
BR2_LINUX_KERNEL_INTREE_DTS_NAME="exynos5422-odroidxu4"
BR2_LINUX_KERNEL_NEEDS_HOST_OPENSSL=y
BR2_LINUX_KERNEL_PATCH="$(BR2_EXTERNAL_BATOCERA_PATH)/board/batocera/odroidxu4/linux_patches"
BR2_LINUX_KERNEL_USE_CUSTOM_CONFIG=y
BR2_LINUX_KERNEL_CUSTOM_CONFIG_FILE="$(BR2_EXTERNAL_BATOCERA_PATH)/board/batocera/odroidxu4/linux-defconfig.config"
BR2_LINUX_KERNEL_CONFIG_FRAGMENT_FILES="$(BR2_EXTERNAL_BATOCERA_PATH)/board/batocera/odroidxu4/linux-defconfig-fragment.config"
BR2_PACKAGE_BUSYBOX_CONFIG_FRAGMENT_FILES="$(BR2_EXTERNAL_BATOCERA_PATH)/board/batocera/busybox.custom.config"

# Required to build ??
BR2_PACKAGE_UTIL_LINUX_LIBSMARTCOLS=y
BR2_PACKAGE_UTIL_LINUX_SETTERM=y
BR2_PACKAGE_UTIL_LINUX_LIBMOUNT=y

# Build as zstd squashfs
BR2_PACKAGE_HOST_SQUASHFS=y

# Out-of-tree kernel modules
BR2_PACKAGE_MALI_MIDGARD_MODULE=y
BR2_PACKAGE_RTL8821AU=y
BR2_PACKAGE_RTL8192EU=y
BR2_PACKAGE_RTL8821CE=y

# Enables ccache
BR2_CCACHE=y
```

## configs/batocera-kernel-h616_defconfig
```kconfig
# Target definition
BR2_aarch64=y
BR2_cortex_a53=y
BR2_ARM_FPU_NEON_FP_ARMV8=y

# Toolchain definition
BR2_GCC_VERSION_10_X=y
BR2_GCC_ENABLE_GRAPHITE=y
BR2_GCC_ENABLE_LTO=y
BR2_OPTIMIZE_3=y
BR2_SHARED_STATIC_LIBS=y
BR2_TOOLCHAIN_BUILDROOT_GLIBC=y
# required for utf-8
BR2_TOOLCHAIN_GLIBC_GCONV_LIBS_COPY=y
BR2_TOOLCHAIN_BUILDROOT_CXX=y
BR2_ENABLE_LOCALE_WHITELIST="C ar ca cy_GB de el es es_MX eu_ES fr hu it ja_JP ko nb_NO nl nn_NO oc_FR.UTF-8 pl pt_PT pt_BR ru_RU uk_UA sv_SE tr zh_CN zh_TW"
BR2_GENERATE_LOCALE="en_US.UTF-8"
BR2_TARGET_OPTIMIZATION="-pipe -fsigned-char"
BR2_TARGET_GENERIC_HOSTNAME="batocera"
BR2_TARGET_GENERIC_ISSUE="PLAY AGAIN"
BR2_TARGET_ROOTFS_TAR_NONE=y
BR2_ROOTFS_DEVICE_CREATION_DYNAMIC_EUDEV=y
BR2_ROOTFS_POST_BUILD_SCRIPT="$(BR2_EXTERNAL_BATOCERA_PATH)/board/batocera/scripts/package-kernel-modules.sh"
#BR2_ROOTFS_POST_IMAGE_SCRIPT="$(BR2_EXTERNAL_BATOCERA_PATH)/board/batocera/scripts/post-image-script.sh"

# Hack
BR2_GLOBAL_PATCH_DIR="$(BR2_EXTERNAL_BATOCERA_PATH)/board/batocera/patches $(BR2_EXTERNAL_BATOCERA_PATH)/board/batocera/orangepi-zero2/patches"

# Linux headers same as kernel, a 5.12+ series
BR2_PACKAGE_HOST_LINUX_HEADERS_CUSTOM_5_12=y

# Kernel
BR2_LINUX_KERNEL=y
BR2_LINUX_KERNEL_CUSTOM_GIT=y
BR2_LINUX_KERNEL_CUSTOM_REPO_URL="https://github.com/apritzel/linux"
BR2_LINUX_KERNEL_CUSTOM_REPO_VERSION="d62a3e6540d0f8b2ff5444ba003e2074a714c452"
BR2_LINUX_KERNEL_USE_CUSTOM_CONFIG=y
BR2_LINUX_KERNEL_CUSTOM_CONFIG_FILE="$(BR2_EXTERNAL_BATOCERA_PATH)/board/batocera/orangepi-zero2/linux-defconfig.config"
BR2_LINUX_KERNEL_DTS_SUPPORT=y
BR2_LINUX_KERNEL_INTREE_DTS_NAME="allwinner/sun50i-h616-orangepi-zero2"
BR2_LINUX_KERNEL_NEEDS_HOST_OPENSSL=y
BR2_LINUX_KERNEL_PATCH="$(BR2_EXTERNAL_BATOCERA_PATH)/board/batocera/orangepi-zero2/linux_patches"
BR2_LINUX_KERNEL_CONFIG_FRAGMENT_FILES="$(BR2_EXTERNAL_BATOCERA_PATH)/board/batocera/orangepi-zero2/linux-defconfig-fragment.config"

# Required to build ??
BR2_PACKAGE_UTIL_LINUX_LIBSMARTCOLS=y
BR2_PACKAGE_UTIL_LINUX_SETTERM=y
BR2_PACKAGE_UTIL_LINUX_LIBMOUNT=y

# spi flash support
BR2_PACKAGE_MTD=y

# Build as zstd squashfs
BR2_PACKAGE_HOST_SQUASHFS=y

# Out-of-tree kernel modules
BR2_PACKAGE_RTL8821AU=y
BR2_PACKAGE_RTL8192EU=y
BR2_PACKAGE_RTL8821CE=y

# Enable ccache
BR2_CCACHE=y
```

## configs/batocera-kernel-meson64_defconfig
```kconfig
# Target definition
BR2_aarch64=y
BR2_cortex_a53=y
BR2_ARM_FPU_NEON_FP_ARMV8=y

# Toolchain definition
BR2_GCC_VERSION_10_X=y
BR2_GCC_ENABLE_GRAPHITE=y
BR2_GCC_ENABLE_LTO=y
BR2_OPTIMIZE_3=y
BR2_SHARED_STATIC_LIBS=y
BR2_TOOLCHAIN_BUILDROOT_GLIBC=y
# required for utf-8
BR2_TOOLCHAIN_GLIBC_GCONV_LIBS_COPY=y
BR2_TOOLCHAIN_BUILDROOT_CXX=y
BR2_ENABLE_LOCALE_WHITELIST="C ar ca cy_GB de el es es_MX eu_ES fr hu it ja_JP ko nb_NO nl nn_NO oc_FR.UTF-8 pl pt_PT pt_BR ru_RU uk_UA sv_SE tr zh_CN zh_TW"
BR2_GENERATE_LOCALE="en_US.UTF-8"
BR2_TARGET_OPTIMIZATION="-pipe -fsigned-char"
BR2_TARGET_GENERIC_HOSTNAME="batocera"
BR2_TARGET_GENERIC_ISSUE="PLAY AGAIN"
BR2_TARGET_ROOTFS_TAR_NONE=y
BR2_ROOTFS_DEVICE_CREATION_DYNAMIC_EUDEV=y
BR2_ROOTFS_POST_BUILD_SCRIPT="$(BR2_EXTERNAL_BATOCERA_PATH)/board/batocera/scripts/package-kernel-modules.sh"
#BR2_ROOTFS_POST_IMAGE_SCRIPT="$(BR2_EXTERNAL_BATOCERA_PATH)/board/batocera/scripts/post-image-script.sh"

# Kernel
BR2_LINUX_KERNEL=y
BR2_LINUX_KERNEL_CUSTOM_VERSION=y
BR2_LINUX_KERNEL_CUSTOM_VERSION_VALUE="5.10.46"
BR2_KERNEL_HEADERS_5_10=y
BR2_LINUX_KERNEL_DTS_SUPPORT=y
BR2_LINUX_KERNEL_INTREE_DTS_NAME="amlogic/meson-gxbb-odroidc2 amlogic/meson-gxbb-p200 amlogic/meson-gxbb-nexbox-a95x amlogic/meson-gxl-s905x-p212 amlogic/meson-gxl-s905d-p231 amlogic/meson-gxl-s905d-p230 amlogic/meson-gxl-s905w-tx3-mini amlogic/meson-gxl-s905x-p212 amlogic/meson-gxl-s905x-hwacom-amazetv amlogic/meson-gxl-s905x-khadas-vim amlogic/meson-gxl-s905x-libretech-cc-v2 amlogic/meson-gxl-s905x-libretech-cc amlogic/meson-gxl-s905x-nexbox-a95x amlogic/meson-gxl-s905w-p281 amlogic/meson-gxm-khadas-vim2 amlogic/meson-gxm-nexbox-a1 amlogic/meson-gxm-q200 amlogic/meson-gxm-q201 amlogic/meson-gxm-rbox-pro amlogic/meson-gxm-s912-libretech-pc amlogic/meson-gxm-vega-s96 amlogic/meson-sm1-odroid-c4 amlogic/meson-sm1-khadas-vim3l amlogic/meson-sm1-h96-max amlogic/meson-sm1-sei610 amlogic/meson-sm1-x96-air-2g amlogic/meson-sm1-x96-air-4g amlogic/meson-sm1-a95xf3-air-2g amlogic/meson-sm1-a95xf3-air-4g amlogic/meson-g12b-odroid-n2 amlogic/meson-g12b-odroid-n2-plus amlogic/meson-g12b-a311d-khadas-vim3"
BR2_LINUX_KERNEL_NEEDS_HOST_OPENSSL=y
BR2_LINUX_KERNEL_PATCH="$(BR2_EXTERNAL_BATOCERA_PATH)/board/batocera/amlogic/linux_patches"
BR2_LINUX_KERNEL_USE_CUSTOM_CONFIG=y
BR2_LINUX_KERNEL_CUSTOM_CONFIG_FILE="$(BR2_EXTERNAL_BATOCERA_PATH)/board/batocera/amlogic/linux-meson64-current.config"
BR2_LINUX_KERNEL_CONFIG_FRAGMENT_FILES="$(BR2_EXTERNAL_BATOCERA_PATH)/board/batocera/amlogic/linux-meson64-current-fragment.config"

# Required to build ??
BR2_PACKAGE_UTIL_LINUX_LIBSMARTCOLS=y
BR2_PACKAGE_UTIL_LINUX_SETTERM=y
BR2_PACKAGE_UTIL_LINUX_LIBMOUNT=y

# Build as zstd squashfs
BR2_PACKAGE_HOST_SQUASHFS=y

# Out-of-tree kernel modules
BR2_PACKAGE_RTL8821AU=y
BR2_PACKAGE_RTL8192EU=y
BR2_PACKAGE_RTL8821CE=y

# Enables ccache
BR2_CCACHE=y
```

## configs/batocera-kernel-rk3288_defconfig
```kconfig
# Target definition
BR2_arm=y
BR2_cortex_a17=y
BR2_ARM_FPU_NEON_VFPV4=y

# Toolchain definition
BR2_GCC_VERSION_10_X=y
BR2_GCC_ENABLE_GRAPHITE=y
BR2_GCC_ENABLE_LTO=y
BR2_OPTIMIZE_3=y
BR2_SHARED_STATIC_LIBS=y
BR2_TOOLCHAIN_BUILDROOT_GLIBC=y
# required for utf-8
BR2_TOOLCHAIN_GLIBC_GCONV_LIBS_COPY=y
BR2_TOOLCHAIN_BUILDROOT_CXX=y
BR2_ENABLE_LOCALE_WHITELIST="C ar ca cy_GB de el es es_MX eu_ES fr hu it ja_JP ko nb_NO nl nn_NO oc_FR.UTF-8 pl pt_PT pt_BR ru_RU uk_UA sv_SE tr zh_CN zh_TW"
BR2_GENERATE_LOCALE="en_US.UTF-8"
BR2_TARGET_OPTIMIZATION="-pipe -fsigned-char"
BR2_TARGET_GENERIC_HOSTNAME="batocera"
BR2_TARGET_GENERIC_ISSUE="PLAY AGAIN"
BR2_TARGET_ROOTFS_TAR_NONE=y
BR2_ROOTFS_DEVICE_CREATION_DYNAMIC_EUDEV=y
BR2_ROOTFS_POST_BUILD_SCRIPT="$(BR2_EXTERNAL_BATOCERA_PATH)/board/batocera/scripts/package-kernel-modules.sh"
#BR2_ROOTFS_POST_IMAGE_SCRIPT="$(BR2_EXTERNAL_BATOCERA_PATH)/board/batocera/scripts/post-image-script.sh"

# Kernel
BR2_LINUX_KERNEL=y
BR2_LINUX_KERNEL_CUSTOM_VERSION=y
BR2_LINUX_KERNEL_CUSTOM_VERSION_VALUE="5.10.47"
BR2_KERNEL_HEADERS_5_10=y
BR2_LINUX_KERNEL_DTS_SUPPORT=y
BR2_LINUX_KERNEL_INTREE_DTS_NAME="rk3288-tinker rk3288-miqi"
BR2_LINUX_KERNEL_NEEDS_HOST_OPENSSL=y
BR2_LINUX_KERNEL_PATCH="$(BR2_EXTERNAL_BATOCERA_PATH)/board/batocera/rockchip/rk3288/linux_patches"
BR2_LINUX_KERNEL_USE_CUSTOM_CONFIG=y
BR2_LINUX_KERNEL_CUSTOM_CONFIG_FILE="$(BR2_EXTERNAL_BATOCERA_PATH)/board/batocera/rockchip/rk3288/linux-defconfig.config"
BR2_LINUX_KERNEL_CONFIG_FRAGMENT_FILES="$(BR2_EXTERNAL_BATOCERA_PATH)/board/batocera/rockchip/rk3288/linux-defconfig-fragment.config"
BR2_PACKAGE_BUSYBOX_CONFIG_FRAGMENT_FILES="$(BR2_EXTERNAL_BATOCERA_PATH)/board/batocera/busybox.custom.config"

# Required to build ??
BR2_PACKAGE_UTIL_LINUX_LIBSMARTCOLS=y
BR2_PACKAGE_UTIL_LINUX_SETTERM=y
BR2_PACKAGE_UTIL_LINUX_LIBMOUNT=y

# Build as zstd squashfs
BR2_PACKAGE_HOST_SQUASHFS=y

# Out-of-tree kernel modules
BR2_PACKAGE_RTL8821AU=y
BR2_PACKAGE_RTL8192EU=y
BR2_PACKAGE_RTL8821CE=y
BR2_PACKAGE_RTL8723DS=y

# Enables ccache
BR2_CCACHE=y
```

## configs/batocera-libretech-h5_defconfig
```kconfig
BR2_aarch64=y
BR2_cortex_a53=y
BR2_ARM_FPU_VFPV4=y
BR2_GCC_VERSION_9_X=y
BR2_OPTIMIZE_3=y
BR2_GCC_ENABLE_LTO=y
BR2_SHARED_STATIC_LIBS=y
BR2_GLOBAL_PATCH_DIR="$(BR2_EXTERNAL_BATOCERA_PATH)/board/batocera/patches $(BR2_EXTERNAL_BATOCERA_PATH)/board/batocera/libretech-h5/patches"
BR2_TOOLCHAIN_BUILDROOT_GLIBC=y
# required for utf-8
BR2_TOOLCHAIN_GLIBC_GCONV_LIBS_COPY=y
BR2_TOOLCHAIN_BUILDROOT_CXX=y
BR2_TARGET_OPTIMIZATION="-pipe -fsigned-char"
BR2_TARGET_GENERIC_HOSTNAME="batocera"
BR2_TARGET_GENERIC_ISSUE="PLAY AGAIN"
BR2_INIT_SYSV=y
BR2_ROOTFS_DEVICE_CREATION_DYNAMIC_EUDEV=y
BR2_TARGET_GENERIC_ROOT_PASSWD="linux"
BR2_SYSTEM_BIN_SH_BASH=y
#BR2_TARGET_GENERIC_GETTY_PORT="tty1"
BR2_TARGET_GENERIC_GETTY_BAUDRATE_115200=y
# BR2_TARGET_GENERIC_REMOUNT_ROOTFS_RW is not set
BR2_ENABLE_LOCALE_WHITELIST="C ar ca de el es es_MX eu_ES fr hu it ja_JP ko nb_NO nl nn_NO oc_FR.UTF-8 pl pt_PT pt_BR ru_RU uk_UA sv_SE tr zh_CN zh_TW"
BR2_GENERATE_LOCALE="en_US.UTF-8 ar_YE.UTF-8 ca_ES.UTF-8 de_DE.UTF-8 el_GR.UTF-8 es_ES.UTF-8 es_MX.UTF-8 eu_ES.UTF-8 fr_FR.UTF-8 hu_HU.UTF-8 it_IT.UTF-8 ja_JP.UTF-8 ko_KR.UTF-8 nb_NO.UTF-8 nl_NL.UTF-8 nn_NO.UTF-8 oc_FR.UTF-8 pl_PL.UTF-8 pt_BR.UTF-8 pt_PT.UTF-8 ru_RU.UTF-8 uk_UA.UTF-8 sv_SE.UTF-8 tr_TR.UTF-8 zh_CN.UTF-8 zh_TW.UTF-8"
BR2_TARGET_TZ_INFO=y
BR2_TARGET_LOCALTIME="Europe/Paris"
BR2_ROOTFS_OVERLAY="$(BR2_EXTERNAL_BATOCERA_PATH)/board/batocera/fsoverlay $(BR2_EXTERNAL_BATOCERA_PATH)/board/batocera/libretech-h5/fsoverlay"
BR2_ROOTFS_POST_BUILD_SCRIPT="$(BR2_EXTERNAL_BATOCERA_PATH)/board/batocera/post-build-script.sh"
BR2_ROOTFS_POST_IMAGE_SCRIPT="$(BR2_EXTERNAL_BATOCERA_PATH)/board/batocera/post-image-script.sh"
#BR2_TARGET_ROOTFS_SQUASHFS4_ZSTD=y

# Arm Trusted Firmware
BR2_TARGET_ARM_TRUSTED_FIRMWARE=y
BR2_TARGET_ARM_TRUSTED_FIRMWARE_CUSTOM_VERSION=y
BR2_TARGET_ARM_TRUSTED_FIRMWARE_CUSTOM_VERSION_VALUE="v2.3"
BR2_TARGET_ARM_TRUSTED_FIRMWARE_PLATFORM="sun50i_a64"
BR2_TARGET_ARM_TRUSTED_FIRMWARE_BL31=y
BR2_TARGET_ARM_TRUSTED_FIRMWARE_BL31_UBOOT=y

# Bootloader
BR2_TARGET_UBOOT=y
BR2_TARGET_UBOOT_BUILD_SYSTEM_KCONFIG=y
BR2_TARGET_UBOOT_CUSTOM_VERSION=y
BR2_TARGET_UBOOT_CUSTOM_VERSION_VALUE="2020.10"
BR2_TARGET_UBOOT_BOARD_DEFCONFIG="libretech_all_h3_cc_h5"
BR2_TARGET_UBOOT_NEEDS_DTC=y
BR2_TARGET_UBOOT_NEEDS_PYLIBFDT=y
BR2_TARGET_UBOOT_NEEDS_ATF_BL31=y
BR2_TARGET_UBOOT_SPL=y
BR2_TARGET_UBOOT_SPL_NAME="u-boot-sunxi-with-spl.bin"

# Linux headers same as kernel, a 5.9 series
BR2_PACKAGE_HOST_LINUX_HEADERS_CUSTOM_5_9=y

# Kernel
BR2_LINUX_KERNEL=y
BR2_LINUX_KERNEL_CUSTOM_VERSION=y
BR2_LINUX_KERNEL_CUSTOM_VERSION_VALUE="5.9.11"
BR2_LINUX_KERNEL_USE_CUSTOM_CONFIG=y
BR2_LINUX_KERNEL_CUSTOM_CONFIG_FILE="$(BR2_EXTERNAL_BATOCERA_PATH)/board/batocera/libretech-h5/linux-defconfig.config"
BR2_LINUX_KERNEL_DTS_SUPPORT=y
BR2_LINUX_KERNEL_INTREE_DTS_NAME="allwinner/sun50i-h5-libretech-all-h3-cc"
BR2_LINUX_KERNEL_NEEDS_HOST_OPENSSL=y
BR2_LINUX_KERNEL_PATCH="$(BR2_EXTERNAL_BATOCERA_PATH)/board/batocera/libretech-h5/linux_patches"
BR2_LINUX_KERNEL_CONFIG_FRAGMENT_FILES="$(BR2_EXTERNAL_BATOCERA_PATH)/board/batocera/libretech-h5/linux-defconfig-fragment.config"

BR2_PACKAGE_BATOCERA_SYSTEM=y
BR2_PACKAGE_BATOCERA_TARGET_LIBRETECH_H5=y
BR2_PACKAGE_BATOCERA_EXTRAS=y
BR2_PACKAGE_BATOCERA_TOOLS=y
BR2_PACKAGE_BATOCERA_ALL_SYSTEMS=y
BR2_PACKAGE_BATOCERA_KODI18=y
BR2_PACKAGE_BATOCERA_LINUX_FIRMWARES=y
BR2_PACKAGE_LIBENET=y
BR2_PACKAGE_BUSYBOX_CONFIG_FRAGMENT_FILES="$(BR2_EXTERNAL_BATOCERA_PATH)/board/batocera/busybox.custom.config"
BR2_PACKAGE_FBDUMP=y
BR2_PACKAGE_FBGRAB=y
BR2_PACKAGE_FBV=y

BR2_PACKAGE_EUDEV_RULES_GEN=y
BR2_PACKAGE_PYTHON_PY_PYC=y
BR2_PACKAGE_PYTHON_GOBJECT=y
BR2_PACKAGE_BOOST_ATOMIC=y
BR2_PACKAGE_LIBCAPSIMAGE=y
BR2_PACKAGE_UTIL_LINUX_LIBSMARTCOLS=y
BR2_PACKAGE_PYTHON_HASHLIB=y
BR2_PACKAGE_PYTHON_PSUTIL=y

# GPU
BR2_PACKAGE_MESA3D=y
BR2_PACKAGE_MESA3D_GALLIUM_DRIVER_KMSRO=y
BR2_PACKAGE_MESA3D_GALLIUM_DRIVER_LIMA=y
BR2_PACKAGE_MESA3D_OPENGL_ES=y
BR2_PACKAGE_MESA3D_OPENGL_EGL=y

# Filesystem
# BR2_ROOTFS_DEVICE_CREATION_DYNAMIC_MDEV=y
BR2_PACKAGE_HOST_DOSFSTOOLS=y
BR2_PACKAGE_HOST_GENIMAGE=y
BR2_PACKAGE_HOST_MTOOLS=y

# wireless tools
BR2_PACKAGE_IW=y
BR2_PACKAGE_WPA_SUPPLICANT=y
BR2_PACKAGE_WPA_SUPPLICANT_NL80211=y
BR2_PACKAGE_WPA_SUPPLICANT_AP_SUPPORT=y
BR2_PACKAGE_WPA_SUPPLICANT_PASSPHRASE=y

# spi flash support
BR2_PACKAGE_MTD=y
```
