## configs/batocera-x86_defconfig
```kconfig
BR2_x86_i586=y
BR2_OPTIMIZE_3=y
BR2_SHARED_STATIC_LIBS=y
BR2_GLOBAL_PATCH_DIR="$(BR2_EXTERNAL_BATOCERA_PATH)/board/batocera/patches $(BR2_EXTERNAL_BATOCERA_PATH)/board/batocera/x86/patches"
BR2_TOOLCHAIN_BUILDROOT_GLIBC=y
# required for utf-8
BR2_TOOLCHAIN_GLIBC_GCONV_LIBS_COPY=y
BR2_TOOLCHAIN_BUILDROOT_CXX=y
BR2_TARGET_OPTIMIZATION="-pipe -fsigned-char"
BR2_TARGET_GENERIC_HOSTNAME="batocera"
BR2_TARGET_GENERIC_ISSUE="PLAY AGAIN"
BR2_INIT_SYSV=y
BR2_ROOTFS_DEVICE_CREATION_DYNAMIC_EUDEV=y
BR2_TARGET_GENERIC_ROOT_PASSWD="linux"
BR2_SYSTEM_BIN_SH_BASH=y
BR2_TARGET_GENERIC_GETTY_PORT="tty1"
BR2_TARGET_GENERIC_GETTY_BAUDRATE_115200=y
# BR2_TARGET_GENERIC_REMOUNT_ROOTFS_RW is not set
BR2_ENABLE_LOCALE_WHITELIST="C ar ca de el es es_MX eu_ES fr hu it ja_JP ko nb_NO nl nn_NO pl pt_PT pt_BR ru_RU uk_UK sv_SE tr zh_CN zh_TW"
BR2_GENERATE_LOCALE="en_US.UTF-8 ar_YE.UTF-8 ca_ES.UTF-8 de_DE.UTF-8 el_GR.UTF-8 es_ES.UTF-8 es_MX.UTF-8 eu_ES.UTF-8 fr_FR.UTF-8 hu_HU.UTF-8 it_IT.UTF-8 ja_JP.UTF-8 ko_KR.UTF-8 nb_NO.UTF-8 nl_NL.UTF-8 nn_NO.UTF-8 pl_PL.UTF-8 pt_BR.UTF-8 pt_PT.UTF-8 ru_RU.UTF-8 uk_UK.UTF-8 sv_SE.UTF-8 tr_TR.UTF-8 zh_CN.UTF-8 zh_TW.UTF-8"
BR2_TARGET_TZ_INFO=y
BR2_TARGET_LOCALTIME="Europe/Paris"
BR2_ROOTFS_OVERLAY="$(BR2_EXTERNAL_BATOCERA_PATH)/board/batocera/fsoverlay $(BR2_EXTERNAL_BATOCERA_PATH)/board/batocera/x86/fsoverlay"
BR2_ROOTFS_POST_BUILD_SCRIPT="$(BR2_EXTERNAL_BATOCERA_PATH)/board/batocera/post-build-script.sh"
BR2_ROOTFS_POST_IMAGE_SCRIPT="$(BR2_EXTERNAL_BATOCERA_PATH)/board/batocera/post-image-script.sh"
BR2_LINUX_KERNEL=y
BR2_LINUX_KERNEL_LATEST_VERSION=y
BR2_LINUX_KERNEL_PATCH="$(BR2_EXTERNAL_BATOCERA_PATH)/board/batocera/x86/linux_patches"
BR2_LINUX_KERNEL_USE_CUSTOM_CONFIG=y
BR2_LINUX_KERNEL_CUSTOM_CONFIG_FILE="$(BR2_EXTERNAL_BATOCERA_PATH)/board/batocera/x86/linux_x86-defconfig.config"
BR2_PACKAGE_BATOCERA_SYSTEM=y
BR2_PACKAGE_BATOCERA_TARGET_X86=y
BR2_PACKAGE_BATOCERA_EXTRAS=y
BR2_PACKAGE_BATOCERA_TOOLS=y
BR2_PACKAGE_BATOCERA_ALL_SYSTEMS=y
BR2_PACKAGE_BATOCERA_KODI18=y
BR2_PACKAGE_BATOCERA_LINUX_FIRMWARES=y
BR2_PACKAGE_BATOCERA_SYSLINUX=y
BR2_PACKAGE_BUSYBOX_CONFIG_FRAGMENT_FILES="$(BR2_EXTERNAL_BATOCERA_PATH)/board/batocera/busybox.custom.config"
BR2_PACKAGE_FBDUMP=y
BR2_PACKAGE_FBGRAB=y
BR2_PACKAGE_FBV=y
BR2_PACKAGE_SDL2_OPENGL=y
BR2_PACKAGE_EUDEV_RULES_GEN=y
BR2_PACKAGE_PYTHON_PY_PYC=y
BR2_PACKAGE_PYTHON_HASHLIB=y
BR2_PACKAGE_PYTHON_GOBJECT=y
BR2_PACKAGE_LIBSVG_CAIRO=y
BR2_PACKAGE_TSLIB=y
BR2_PACKAGE_BOOST_ATOMIC=y
# BR2_PACKAGE_AVAHI_AUTOIPD is not set
BR2_PACKAGE_UTIL_LINUX_LIBSMARTCOLS=y
# BR2_TARGET_ROOTFS_TAR is not set
BR2_PACKAGE_BATOCERA_SYSLINUX_EFI=y
BR2_TARGET_SYSLINUX=y
BR2_TARGET_SYSLINUX_MBR=y
BR2_TARGET_SYSLINUX_C32="menu.c32 libutil.c32"
BR2_PACKAGE_SDL_X11=y
BR2_PACKAGE_PYTHON_PSUTIL=y
BR2_LINUX_KERNEL_NEEDS_HOST_LIBELF=y
BR2_PACKAGE_XARCADE2JSTICK=y

# Enables ccache, strace and gdb
#BR2_PACKAGE_BATOCERA_DEV=y

# Enable experimental packages
#BR2_PACKAGE_BATOCERA_CORES_EXPERIMENTAL=y
```

## configs/recalbox-arcade_defconfig
```kconfig
BR2_arm=y
BR2_arm1176jzf_s=y
BR2_ARM_EABIHF=y
BR2_OPTIMIZE_3=y
BR2_SHARED_STATIC_LIBS=y
BR2_KERNEL_HEADERS_3_12=y
BR2_TOOLCHAIN_BUILDROOT_GLIBC=y
BR2_GCC_VERSION_4_9_X=y
BR2_TOOLCHAIN_BUILDROOT_CXX=y
BR2_ENABLE_LOCALE_PURGE=y
BR2_ENABLE_LOCALE_WHITELIST="C en fr es pt de"
BR2_GENERATE_LOCALE="fr_FR.UTF-8 en_US.UTF-8 es_ES.UTF-8 pt_BR.UTF-8 de_DE.UTF-8"
BR2_TOOLCHAIN_GLIBC_GCONV_LIBS_COPY=y
BR2_TARGET_OPTIMIZATION="-pipe -march=armv6 -mfloat-abi=hard -mfpu=vfp"
BR2_TARGET_GENERIC_HOSTNAME="RECALBOX"
BR2_TARGET_GENERIC_ISSUE="PLAY AGAIN"
BR2_ROOTFS_DEVICE_CREATION_DYNAMIC_EUDEV=y
BR2_TARGET_GENERIC_ROOT_PASSWD="recalboxroot"
BR2_TARGET_GENERIC_GETTY_PORT="tty1"
BR2_TARGET_GENERIC_GETTY_BAUDRATE_115200=y
BR2_ROOTFS_OVERLAY="board/recalbox/fsoverlay"
BR2_LINUX_KERNEL=y
BR2_LINUX_KERNEL_CUSTOM_GIT=y
BR2_LINUX_KERNEL_CUSTOM_REPO_URL="https://github.com/raspberrypi/linux"
BR2_LINUX_KERNEL_CUSTOM_REPO_VERSION="353043394c99ed37a4075da228af64468fdf6c06"
BR2_LINUX_KERNEL_USE_CUSTOM_CONFIG=y
BR2_LINUX_KERNEL_CUSTOM_CONFIG_FILE="board/recalbox/kernel.config"
BR2_LINUX_KERNEL_ZIMAGE=y
BR2_PACKAGE_BUSYBOX_SHOW_OTHERS=y
BR2_PACKAGE_ALSA_UTILS=y
BR2_PACKAGE_ALSA_UTILS_AMIXER=y
BR2_PACKAGE_BINUTILS=y
BR2_PACKAGE_QTSIXA=y
BR2_PACKAGE_MK_ARCADE_JOYSTICK_RPI=y
BR2_PACKAGE_RECALBOX_EMULATIONSTATION2=y
BR2_PACKAGE_PIFBA=y
BR2_PACKAGE_RETROARCH=y
BR2_PACKAGE_RETROARCH_RPI1=y
BR2_PACKAGE_ARMSNES=y
BR2_PACKAGE_LIBRETRO_POCKETSNES=y
BR2_PACKAGE_LIBRETRO_CATSFC=y
BR2_PACKAGE_LIBRETRO_PICODRIVE=y
BR2_PACKAGE_LIBRETRO_GENESISPLUSGX=y
BR2_PACKAGE_LIBRETRO_GAMBATTE=y
BR2_PACKAGE_LIBRETRO_STELLA=y
BR2_PACKAGE_LIBRETRO_PCSX=y
BR2_PACKAGE_LIBRETRO_FCEUMM=y
BR2_PACKAGE_LIBRETRO_FCEUNEXT=y
BR2_PACKAGE_LIBRETRO_NESTOPIA=y
BR2_PACKAGE_LIBRETRO_IMAME=y
BR2_PACKAGE_LIBRETRO_BEETLE_PCE=y
BR2_PACKAGE_LIBRETRO_BEETLE_PCFX=y
BR2_PACKAGE_LIBRETRO_METEOR=y
BR2_PACKAGE_LIBRETRO_VIRTUALJAGUAR=y
BR2_PACKAGE_LIBRETRO_FMSX=y
BR2_PACKAGE_LIBRETRO_GPSP=y
BR2_PACKAGE_LIBRETRO_4DO=y
BR2_PACKAGE_SDL=y
BR2_PACKAGE_SDL2=y
BR2_PACKAGE_SDL2_MIXER=y
BR2_PACKAGE_RPI_FIRMWARE=y
BR2_PACKAGE_EUDEV_RULES_GEN=y
BR2_PACKAGE_INPUT_TOOLS=y
# BR2_PACKAGE_INPUT_TOOLS_INPUTATTACH is not set
# BR2_PACKAGE_INPUT_TOOLS_JSCAL is not set
BR2_PACKAGE_RPI_USERLAND=y
BR2_PACKAGE_LIBVORBIS=y
BR2_PACKAGE_LIBPNG=y
BR2_PACKAGE_LIBUSB_COMPAT=y
BR2_PACKAGE_BOOST=y
BR2_PACKAGE_BLUEZ_UTILS=y
BR2_PACKAGE_BLUEZ_UTILS_COMPAT=y
BR2_PACKAGE_BLUEZ_UTILS_AUDIO=y
BR2_PACKAGE_BLUEZ_UTILS_USB=y
BR2_PACKAGE_BLUEZ_UTILS_GATT=y
BR2_PACKAGE_DROPBEAR=y
BR2_PACKAGE_RSYNC=y
BR2_PACKAGE_SAMBA=y
BR2_PACKAGE_WGET=y
BR2_PACKAGE_BASH=y
BR2_PACKAGE_NANO=y
BR2_TARGET_ROOTFS_TAR_XZ=y
```

## configs/recalbox-rpi1_defconfig
```kconfig
BR2_arm=y
BR2_arm1176jzf_s=y
BR2_OPTIMIZE_3=y
BR2_SHARED_STATIC_LIBS=y
BR2_KERNEL_HEADERS_3_12=y
BR2_TOOLCHAIN_BUILDROOT_GLIBC=y
BR2_TOOLCHAIN_BUILDROOT_CXX=y
BR2_ENABLE_LOCALE_PURGE=y
BR2_ENABLE_LOCALE_WHITELIST="C en fr es pt de it"
BR2_GENERATE_LOCALE="fr_FR.UTF-8 en_US.UTF-8 es_ES.UTF-8 pt_BR.UTF-8 de_DE.UTF-8 it_IT.UTF-8"
BR2_TARGET_OPTIMIZATION="-pipe -march=armv6 -mfloat-abi=hard -mfpu=vfp"
BR2_TARGET_GENERIC_HOSTNAME="RECALBOX"
BR2_TARGET_GENERIC_ISSUE="PLAY AGAIN"
BR2_ROOTFS_DEVICE_CREATION_DYNAMIC_EUDEV=y
BR2_TARGET_GENERIC_ROOT_PASSWD="recalboxroot"
BR2_SYSTEM_BIN_SH_BASH=y
BR2_TARGET_GENERIC_GETTY_PORT="tty1"
BR2_TARGET_GENERIC_GETTY_BAUDRATE_115200=y
BR2_TARGET_TZ_INFO=y
BR2_TARGET_LOCALTIME="Europe/Paris"
BR2_ROOTFS_OVERLAY="board/recalbox/fsoverlay"
BR2_ROOTFS_POST_IMAGE_SCRIPT="board/recalbox/copy-recalbox-archives.sh"
BR2_LINUX_KERNEL=y
BR2_LINUX_KERNEL_CUSTOM_GIT=y
BR2_LINUX_KERNEL_CUSTOM_REPO_URL="https://github.com/raspberrypi/linux"
BR2_LINUX_KERNEL_CUSTOM_REPO_VERSION="353043394c99ed37a4075da228af64468fdf6c06"
BR2_LINUX_KERNEL_PATCH="board/recalbox/kernel_patches_3.12"
BR2_LINUX_KERNEL_USE_CUSTOM_CONFIG=y
BR2_LINUX_KERNEL_CUSTOM_CONFIG_FILE="board/recalbox/kernel.3.12.rpi1.config"
BR2_LINUX_KERNEL_ZIMAGE=y
BR2_PACKAGE_BUSYBOX_SHOW_OTHERS=y
BR2_PACKAGE_ALSA_UTILS=y
BR2_PACKAGE_ALSA_UTILS_AMIXER=y
BR2_PACKAGE_KODI=y
BR2_PACKAGE_KODI_ALSA_LIB=y
BR2_PACKAGE_KODI_DBUS=y
BR2_PACKAGE_KODI_LIBCEC=y
BR2_PACKAGE_KODI_LIRC=y
BR2_PACKAGE_KODI_LIBMICROHTTPD=y
BR2_PACKAGE_KODI_LIBNFS=y
BR2_PACKAGE_KODI_RTMPDUMP=y
BR2_PACKAGE_KODI_LIBSMBCLIENT=y
BR2_PACKAGE_KODI_LIBTHEORA=y
BR2_PACKAGE_KODI_LIBUSB=y
BR2_PACKAGE_KODI_LIBVA=y
BR2_PACKAGE_KODI_WAVPACK=y
BR2_PACKAGE_KODI_AUDIODECODER_MODPLUG=y
BR2_PACKAGE_KODI_AUDIODECODER_NOSEFART=y
BR2_PACKAGE_KODI_AUDIODECODER_SIDPLAY=y
BR2_PACKAGE_KODI_AUDIODECODER_SNESAPU=y
BR2_PACKAGE_KODI_AUDIODECODER_STSOUND=y
BR2_PACKAGE_KODI_AUDIODECODER_TIMIDITY=y
BR2_PACKAGE_KODI_AUDIODECODER_VGMSTREAM=y
BR2_PACKAGE_KODI_AUDIOENCODER_FLAC=y
BR2_PACKAGE_KODI_AUDIOENCODER_LAME=y
BR2_PACKAGE_KODI_AUDIOENCODER_VORBIS=y
BR2_PACKAGE_KODI_AUDIOENCODER_WAV=y
BR2_PACKAGE_KODI_ADDON_XVDR=y
BR2_PACKAGE_KODI_PVR_ARGUSTV=y
BR2_PACKAGE_KODI_PVR_DVBLINK=y
BR2_PACKAGE_KODI_PVR_DVBVIEWER=y
BR2_PACKAGE_KODI_PVR_FILMON=y
BR2_PACKAGE_KODI_PVR_HTS=y
BR2_PACKAGE_KODI_PVR_IPTVSIMPLE=y
BR2_PACKAGE_KODI_PVR_MEDIAPORTAL_TVSERVER=y
BR2_PACKAGE_KODI_PVR_MYTHTV=y
BR2_PACKAGE_KODI_PVR_NEXTPVR=y
BR2_PACKAGE_KODI_PVR_NJOY=y
BR2_PACKAGE_KODI_PVR_PCTV=y
BR2_PACKAGE_KODI_PVR_STALKER=y
BR2_PACKAGE_KODI_PVR_VBOX=y
BR2_PACKAGE_KODI_PVR_VDR_VNSI=y
BR2_PACKAGE_KODI_PVR_VUPLUS=y
BR2_PACKAGE_KODI_PVR_WMC=y
BR2_PACKAGE_MPLAYER=y
BR2_PACKAGE_BINUTILS=y
BR2_PACKAGE_CIFS_UTILS=y
BR2_PACKAGE_EXFAT=y
BR2_PACKAGE_EXFAT_UTILS=y
BR2_PACKAGE_NTFS_3G=y
BR2_PACKAGE_NTFS_3G_NTFSPROGS=y
BR2_PACKAGE_RECALBOX_SYSTEM=y
BR2_PACKAGE_RECALBOX_CONFIGGEN=y
BR2_PACKAGE_MOONLIGHT_EMBEDDED=y
BR2_PACKAGE_RECALBOX_EMULATIONSTATION2=y
BR2_PACKAGE_PYTHON_ES_SCRAPER=y
BR2_PACKAGE_QTSIXA=y
BR2_PACKAGE_MK_ARCADE_JOYSTICK_RPI=y
BR2_PACKAGE_DB9_GPIO_RPI=y
BR2_PACKAGE_GAMECON_GPIO_RPI=y
BR2_PACKAGE_XBOXDRV=y
BR2_PACKAGE_RECALBOX_RETROGAME=y
BR2_PACKAGE_VIRTUALGAMEPADS=y
BR2_PACKAGE_PIFBA=y
BR2_PACKAGE_RETROARCH=y
BR2_PACKAGE_SCUMMVM_VANFANEL=y
BR2_PACKAGE_ARMSNES=y
BR2_PACKAGE_LIBRETRO_POCKETSNES=y
BR2_PACKAGE_LIBRETRO_CATSFC=y
BR2_PACKAGE_LIBRETRO_BEETLE_VB=y
BR2_PACKAGE_LIBRETRO_SNES9X_NEXT=y
BR2_PACKAGE_LIBRETRO_PICODRIVE=y
BR2_PACKAGE_LIBRETRO_GENESISPLUSGX=y
BR2_PACKAGE_LIBRETRO_GAMBATTE=y
BR2_PACKAGE_LIBRETRO_STELLA=y
BR2_PACKAGE_LIBRETRO_PCSX=y
BR2_PACKAGE_LIBRETRO_FCEUMM=y
BR2_PACKAGE_LIBRETRO_FCEUNEXT=y
BR2_PACKAGE_LIBRETRO_NESTOPIA=y
BR2_PACKAGE_LIBRETRO_IMAME=y
BR2_PACKAGE_LIBRETRO_BEETLE_PCE=y
BR2_PACKAGE_LIBRETRO_BEETLE_PCFX=y
BR2_PACKAGE_LIBRETRO_METEOR=y
BR2_PACKAGE_LIBRETRO_VIRTUALJAGUAR=y
BR2_PACKAGE_LIBRETRO_FMSX=y
BR2_PACKAGE_LIBRETRO_BLUEMSX=y
BR2_PACKAGE_LIBRETRO_GPSP=y
BR2_PACKAGE_LIBRETRO_4DO=y
BR2_PACKAGE_LIBRETRO_FBA=y
BR2_PACKAGE_LIBRETRO_GW=y
BR2_PACKAGE_LIBRETRO_PRBOOM=y
BR2_PACKAGE_LIBRETRO_BEETLE_NGP=y
BR2_PACKAGE_LIBRETRO_VECX=y
BR2_PACKAGE_LIBRETRO_BEETLE_LYNX=y
BR2_PACKAGE_LIBRETRO_LUTRO=y
BR2_PACKAGE_LIBRETRO_BEETLE_WSWAN=y
BR2_PACKAGE_LIBRETRO_MUPEN64=y
BR2_PACKAGE_LIBRETRO_BEETLE_SUPERGRAFX=y
BR2_PACKAGE_LIBRETRO_NXENGINE=y
BR2_PACKAGE_LIBRETRO_PROSYSTEM=y
BR2_PACKAGE_LIBRETRO_TGBDUAL=y
BR2_PACKAGE_LIBRETRO_MGBA=y
BR2_PACKAGE_LIBRETRO_MAME2003=y
BR2_PACKAGE_RASPI2PNG=y
BR2_PACKAGE_FBDUMP=y
BR2_PACKAGE_FBGRAB=y
BR2_PACKAGE_FBV=y
BR2_PACKAGE_SDL=y
BR2_PACKAGE_SDL2_MIXER=y
BR2_PACKAGE_SDL_MIXER=y
BR2_PACKAGE_SDL_NET=y
BR2_PACKAGE_LINUX_FIRMWARE=y
BR2_PACKAGE_LINUX_FIRMWARE_ATHEROS_6002=y
BR2_PACKAGE_LINUX_FIRMWARE_ATHEROS_6003=y
BR2_PACKAGE_LINUX_FIRMWARE_ATHEROS_6004=y
BR2_PACKAGE_LINUX_FIRMWARE_ATHEROS_7010=y
BR2_PACKAGE_LINUX_FIRMWARE_ATHEROS_9170=y
BR2_PACKAGE_LINUX_FIRMWARE_ATHEROS_9271=y
BR2_PACKAGE_LINUX_FIRMWARE_BRCM_BCM43XX=y
BR2_PACKAGE_LINUX_FIRMWARE_BRCM_BCM43XXX=y
BR2_PACKAGE_LINUX_FIRMWARE_IWLWIFI_3160=y
BR2_PACKAGE_LINUX_FIRMWARE_IWLWIFI_5000=y
BR2_PACKAGE_LINUX_FIRMWARE_IWLWIFI_7260=y
BR2_PACKAGE_LINUX_FIRMWARE_IWLWIFI_7265=y
BR2_PACKAGE_LINUX_FIRMWARE_LIBERTAS_SD8686_V8=y
BR2_PACKAGE_LINUX_FIRMWARE_LIBERTAS_SD8686_V9=y
BR2_PACKAGE_LINUX_FIRMWARE_LIBERTAS_SD8688=y
BR2_PACKAGE_LINUX_FIRMWARE_MWIFIEX_SD8787=y
BR2_PACKAGE_LINUX_FIRMWARE_RALINK_RT61=y
BR2_PACKAGE_LINUX_FIRMWARE_RALINK_RT73=y
BR2_PACKAGE_LINUX_FIRMWARE_RALINK_RT2XX=y
BR2_PACKAGE_LINUX_FIRMWARE_RTL_81XX=y
BR2_PACKAGE_LINUX_FIRMWARE_RTL_87XX=y
BR2_PACKAGE_LINUX_FIRMWARE_RTL_88XX=y
BR2_PACKAGE_LINUX_FIRMWARE_TI_WL128X=y
BR2_PACKAGE_LINUX_FIRMWARE_TI_WL18XX=y
BR2_PACKAGE_RPI_FIRMWARE=y
BR2_PACKAGE_EUDEV_RULES_GEN=y
BR2_PACKAGE_EVTEST=y
BR2_PACKAGE_INPUT_TOOLS=y
# BR2_PACKAGE_INPUT_TOOLS_INPUTATTACH is not set
BR2_PACKAGE_KBD=y
BR2_PACKAGE_RPI_USERLAND=y
BR2_PACKAGE_USBMOUNT=y
BR2_PACKAGE_NODEJS=y
BR2_PACKAGE_NODEJS_MODULES_COFFEESCRIPT=y
BR2_PACKAGE_NODEJS_MODULES_ADDITIONAL="request"
BR2_PACKAGE_PYTHON_PSUTIL=y
BR2_PACKAGE_CA_CERTIFICATES=y
BR2_PACKAGE_MYSQL=y
BR2_PACKAGE_LIBDAEMON=y
# BR2_PACKAGE_AVAHI_AUTOIPD is not set
BR2_PACKAGE_BLUEZ_UTILS=y
BR2_PACKAGE_BLUEZ_UTILS_COMPAT=y
BR2_PACKAGE_BLUEZ_UTILS_AUDIO=y
BR2_PACKAGE_BLUEZ_UTILS_USB=y
BR2_PACKAGE_BLUEZ_UTILS_GATT=y
BR2_PACKAGE_DROPBEAR=y
BR2_PACKAGE_NTP=y
BR2_PACKAGE_RSYNC=y
BR2_PACKAGE_WGET=y
BR2_PACKAGE_WPA_SUPPLICANT=y
BR2_PACKAGE_NANO=y
BR2_TARGET_ROOTFS_TAR_XZ=y
```
